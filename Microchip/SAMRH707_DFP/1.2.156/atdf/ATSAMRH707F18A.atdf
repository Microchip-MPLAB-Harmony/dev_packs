# ATSAMRH707F18A device description
Architecture: CORTEX-M7; Family: SAMRH; Series: SAMRH707
Parameters: __CM7_REV=0x0101 (CM7 Core Revision), __NVIC_PRIO_BITS=3 (Number of Bits used for Priority Levels), __Vendor_SysTickConfig=0 (Set to 1 if different SysTick Config is used), __MPU_PRESENT=1 (MPU present or not), __VTOR_PRESENT=1 (Vector Table Offset Register present or not), __FPU_PRESENT=1 (FPU present or not), __FPU_DP=1 (Double Precision FPU), __ICACHE_PRESENT=1 (Instruction Cache present), __DCACHE_PRESENT=1 (Data Cache present), __ITCM_PRESENT=1 (Instruction TCM present), __DTCM_PRESENT=1 (Data TCM present), __DEBUG_LVL=1, __TRACE_LVL=1, LITTLE_ENDIAN=1, __ARCH_ARM=1, __ARCH_ARM_CORTEX_M=1
Programming and debug interfaces: SWD
Registers are 32-bit, read-write, no defined reset value unless marked. A register's access mark holds for its fields unless they carry their own. Offsets are from the block's base; lines under a group give offsets from that group; [hi:lo] are bit positions; {n}, {i} and the like mark numbered series; 'fields as' and 'values as' point back to an identical list; <NAME> marks a mode.

## Ordering variants
SAMRH707F18A-DRB-E: CQFP164, up to 50 MHz, +25 to +25 C, 1.62 to 3.6 V

## Memory
base space: start 0 size 0x100000000, little endian
  0x40000000 PERIPHERALS size 0x20000000 io, rw
  0xE0000000 SYSTEM size 0x10000000 io, rw
  0x22000000 AXIMX size 0x00100000 other, rw
  0x00000000 ITCM size 0x00010000 other, rw, executable
  0x10000000 IFLASH size 0x00020000 flash, rw, executable, page 256
  0x11000000 IROM size 0x00020000 rom, ro
  0x20000000 DTCM size 0x00020000 other, rw, executable
  0x21000000 FlexRAM size 0x00020000 ram, rw, executable
  0x60000000 EBI_CSHEMC size 0x00200000 other, rw, executable
fuses space: start 0 size 0x10, little endian
lockbits space: start 0 size 0x4, little endian

## Peripheral instances (address, pins/pin function, parameters)
ADC at 0x40200000
  pins: ADTRG PC30/A; AD{n} PA{n}/X1 (n=0..15)
  parameters: INSTANCE_ID=23, CLOCK_ID=23, DMAC_ID_RX=26
CHIPID at 0x40100000
CRCCU at 0x40018000
  parameters: INSTANCE_ID=22, CLOCK_ID=22, DMA_DESC_LEN=36
DACC at 0x40014000
  pins: DAC0 PD31/X1; DAC1N PD30/X1; DAC1P PD29/X1; DAC2 PD28/X1; DATRG PC29/A
  parameters: INSTANCE_ID=24, CLOCK_ID=24, DMAC_ID_TX=27
FLEXCOM0 at 0x40020000 (FLEXCOM)
  pins: FLEXCOM0_IO0 PA21/A; FLEXCOM0_IO1 PA22/A; FLEXCOM0_IO2 PA17/A or PA26/A; FLEXCOM0_IO3 PA18/A or PA28/A; FLEXCOM0_IO4 PA25/A; FLEXCOM0_IO5 PA24/A or PA27/A; FLEXCOM0_IO6 PA20/A or PA23/A
  parameters: INSTANCE_ID=7, CLOCK_ID=7, DMAC_ID_TX=0, DMAC_ID_RX=1, USART_FIFO_SIZE=8, SPI_FIFO_SIZE=16, TWI_FIFO_SIZE=8
FLEXCOM1 at 0x40024000 (FLEXCOM)
  pins: FLEXCOM1_IO0 PB4/B; FLEXCOM1_IO1 PB5/B; FLEXCOM1_IO2 PA30/B; FLEXCOM1_IO3 PA29/B; FLEXCOM1_IO4 PB3/B; FLEXCOM1_IO5 PA15/B or PA16/B; FLEXCOM1_IO6 PA14/B or PA31/B
  parameters: INSTANCE_ID=8, CLOCK_ID=8, DMAC_ID_TX=2, DMAC_ID_RX=3, USART_FIFO_SIZE=8, SPI_FIFO_SIZE=16, TWI_FIFO_SIZE=8
FLEXCOM2 at 0x40028000 (FLEXCOM)
  pins: FLEXCOM2_IO0 PD8/C; FLEXCOM2_IO1 PD9/C; FLEXCOM2_IO2 PC16/A or PD13/B or PD26/A; FLEXCOM2_IO3 PC17/A or PD17/B or PD27/A; FLEXCOM2_IO4 PC18/A or PC31/A or PD11/B; FLEXCOM2_IO5 PC19/A; FLEXCOM2_IO6 PC20/A or PD15/B
  parameters: INSTANCE_ID=13, CLOCK_ID=13, DMAC_ID_TX=4, DMAC_ID_RX=5, USART_FIFO_SIZE=8, SPI_FIFO_SIZE=16, TWI_FIFO_SIZE=8
FLEXCOM3 at 0x4002C000 (FLEXCOM)
  pins: FLEXCOM3_IO0 PB22/B; FLEXCOM3_IO1 PB21/B; FLEXCOM3_IO2 PB17/B or PB30/B; FLEXCOM3_IO3 PB18/B or PB31/B; FLEXCOM3_IO4 PB20/B; FLEXCOM3_IO5 PB16/B or PB29/B; FLEXCOM3_IO6 PB19/B
  parameters: INSTANCE_ID=14, CLOCK_ID=14, DMAC_ID_TX=6, DMAC_ID_RX=7, USART_FIFO_SIZE=8, SPI_FIFO_SIZE=16, TWI_FIFO_SIZE=8
FLEXRAMECC at 0x40100600
HEFC at 0x40004000
  parameters: FLASH_SIZE=131072, PAGE_SIZE=256, INSTANCE_ID=50, CLOCK_ID=50, PAGES_PR_REGION=512
HEMC at 0x40080000
  pins: A{n} PC{n+8}/B (n=0..20); BOOT_MODE0 PC30/X1; BOOT_MODE1 PC29/X1; CFG2 PA25/X1; D{n} PC{n}/B (n=0..7); NCS0 PD5/B; NCS1 PD4/B; NRD PD6/B; NWAIT PD8/B; NWE PD7/B
  parameters: INSTANCE_ID=59, CLOCK_ID=59, ID_HEMC_INTFIX=60, ID_HEMC_INTNOFIX=61
HSMC at 0x40081000
ICM at 0x4008C000
  parameters: INSTANCE_ID=33, CLOCK_ID=33
IP1553 at 0x4003C000
  pins: ARXINN PB28/A; ARXINP PB27/A; ATXOUTN PB26/A; ATXOUTP PB25/A; BRXINN PC3/A or PD3/A; BRXINP PC2/A or PD2/A; BTXOUTN PC1/A or PD1/A; BTXOUTP PC0/A or PD0/A
  parameters: INSTANCE_ID=68, CLOCK_ID=68
MATRIX0 at 0x40000000 (MATRIX)
  parameters: INSTANCE_ID=6
MCAN0 at 0x40058000 (MCAN)
  pins: CANRX0 PB8/A; CANTX0 PB7/A
  parameters: INSTANCE_ID=36, CLOCK_ID=36, ID_MCAN0_INT0=36, ID_MCAN0_INT1=37
MCAN1 at 0x4005C000 (MCAN)
  pins: CANRX1 PB9/A or PC12/A; CANTX1 PB10/A or PC13/A
  parameters: INSTANCE_ID=38, CLOCK_ID=38, ID_MCAN1_INT0=38, ID_MCAN1_INT1=39
NMIC at 0x400A8000
  parameters: INSTANCE_ID=9, CLOCK_ID=9, NUM_NMIC_SOURCE=9, NMIC_SOURCE_NMI=0 (External Pin NMI), NMIC_SOURCE_CPU_FAIL=1 (Wrong CPU Frequency Monitor Detection), NMIC_SOURCE_EXT_MAINCK_FAIL=2 (External MAIN Clock Failure Detection), NMIC_SOURCE_XTAL_32K_FAIL=3 (Slow XTAL 32KHZ Clock Failure Detection), NMIC_SOURCE_VDDCORE_FAIL=4 (VDDCORE Failure Detection), NMIC_SOURCE_NOFIX_TCM=5 (TCM non fixable error Detection), NMIC_SOURCE_NOFIX_HEMC=6 (HEMC non fixable error detection), NMIC_SOURCE_NOFIX_HEFC=7 (HEFC non fixable error detection), NMIC_SOURCE_NOFIX_FLEXRAM=8 (FlexRAM non fixable error detection), NMIC_READ_ONLY_GLFEN=0 (NMIC Glitch filter is read only)
PCC at 0x4001C000
  pins: PCCCLK PA20/D; PCCDATA{n} PA{n}/D (n=0..15); PCCDEN1 PA27/D; PCCDEN2 PA25/D
  parameters: INSTANCE_ID=45, CLOCK_ID=45, DMAC_ID_RX=28
PIO at 0x40008000
  pins: P{n} PA{n} (n=0..31); P{n} PB{n-32} (n=32..63); P{n} PC{n-64} (n=64..95); P{n} PD{n-96} (n=96..127)
  parameters: CLOCK_ID=10, DEBOUNCE_GLITCH_ACTIVE=1
PIOA
  parameters: INSTANCE_ID=10
PIOB
  parameters: INSTANCE_ID=11
PIOC
  parameters: INSTANCE_ID=12
PIOD
  parameters: INSTANCE_ID=16
PMC at 0x4000C000
  pins: PCK0 PA19/A; PCK1 PA30/A or PA31/A; PCK2 PD8/A
  parameters: INSTANCE_ID=5
PWM0 at 0x40068000 (PWM)
  pins: PWMC0_PWMEXTRG0 PA19/B; PWMC0_PWMEXTRG1 PB1/B; PWMC0_PWMFI0 PA29/D; PWMC0_PWMFI1 PA30/D; PWMC0_PWMFI2 PA16/C; PWMC0_PWMH0 PB11/A; PWMC0_PWMH1 PB13/A; PWMC0_PWMH2 PB15/A; PWMC0_PWMH3 PB17/A; PWMC0_PWML0 PB12/A; PWMC0_PWML1 PB14/A; PWMC0_PWML2 PB16/A; PWMC0_PWML3 PB18/A
  parameters: INSTANCE_ID=31, CLOCK_ID=31, DMAC_ID_TX=8, FAULT_PWM_ID0=0x0 (Fault 0 - PWM0_PWMFI0 Input pin), FAULT_PWM_ID1=0x1 (Fault 1 - PWM0_PWMFI1 Input pin), FAULT_PWM_ID2=0x2 (Fault 2 - PWM0_PWMFI2 Input pin), FAULT_PWM_ID3=0x3 (Fault 3 - MAIN_OSC_PMC), FAULT_PWM_ID4=0x4 (Fault 4 - ADC), FAULT_PWM_ID6=0x6 (Fault 6 - TC0)
PWM1 at 0x4006C000 (PWM)
  pins: PWMC1_PWMEXTRG0 PD5/A; PWMC1_PWMEXTRG1 PC19/C; PWMC1_PWMFI0 PD4/A; PWMC1_PWMFI1 PC16/C; PWMC1_PWMFI2 PC18/C; PWMC1_PWMH0 PC4/A; PWMC1_PWMH1 PC6/A; PWMC1_PWMH2 PC8/A; PWMC1_PWMH3 PC10/A; PWMC1_PWML0 PC5/A; PWMC1_PWML1 PC7/A; PWMC1_PWML2 PC9/A; PWMC1_PWML3 PC11/A
  parameters: INSTANCE_ID=32, CLOCK_ID=32, DMAC_ID_TX=9, FAULT_PWM_ID0=0x0 (Fault 0 - PWM1_PWMFI0 Input pin), FAULT_PWM_ID1=0x1 (Fault 1 - PWM1_PWMFI1 Input pin), FAULT_PWM_ID2=0x2 (Fault 2 - PWM1_PWMFI2 Input pin), FAULT_PWM_ID3=0x3 (Fault 3 - MAIN_OSC_PMC), FAULT_PWM_ID4=0x4 (Fault 4 - ADC), FAULT_PWM_ID6=0x6 (Fault 6 - TC0)
RSTC at 0x40100200
  parameters: INSTANCE_ID=1
RSWDT at 0x40100300
  parameters: INSTANCE_ID=47
RTC at 0x40100260
  pins: RTCOUT0 PB2/A; RTCOUT1 PD6/A or PD9/B
  parameters: INSTANCE_ID=2
RTT at 0x40100230
  parameters: INSTANCE_ID=3
SFR at 0x400A0000
  parameters: INSTANCE_ID=62
SHA at 0x40094000
  parameters: INSTANCE_ID=44, CLOCK_ID=44, DMAC_ID_TX=13
SPW at 0x40040000
  pins: SPWDINN0 PD11/A; SPWDINN1 PD19/A; SPWDINP0 PD10/A; SPWDINP1 PD18/A; SPWDOUTN0 PD13/A; SPWDOUTN1 PD21/A; SPWDOUTP0 PD12/A; SPWDOUTP1 PD20/A; SPWSINN0 PD17/A; SPWSINN1 PD25/A; SPWSINP0 PD16/A; SPWSINP1 PD24/A; SPWSOUTN0 PD15/A; SPWSOUTN1 PD23/A; SPWSOUTP0 PD14/A; SPWSOUTP1 PD22/A
  parameters: INSTANCE_ID_SPW=65, INSTANCE_ID_SPW_TIMETICK=66, CLOCK_ID_SPWCLK=65, CLOCK_ID_TIMETICK=66
SUPC at 0x40100210
  parameters: INSTANCE_ID=0
TC0 at 0x40070000 (TC)
  pins: TCLK0 PB18/C; TCLK1 PA20/C; TCLK2 PA25/C or PB19/C; TIOA0 PA29/C; TIOA1 PA27/C; TIOA2 PA28/C or PB0/C; TIOB0 PA30/C; TIOB1 PB17/C; TIOB2 PA26/C
  parameters: DMAC_ID_RX=10, DMAC_ID_CPA=14, DMAC_ID_CPB=17, DMAC_ID_CPC=20, DMAC_ID_ETRG=23, INSTANCE_ID_CHANNEL0=25, INSTANCE_ID_CHANNEL1=26, INSTANCE_ID_CHANNEL2=27, CLOCK_ID_CHANNEL0=25, CLOCK_ID_CHANNEL1=26, CLOCK_ID_CHANNEL2=27, TCCLKS_=0 (MCK), TCCLKS_TIMER_CLOCK1=1 (GCLK), TCCLKS_TIMER_CLOCK2=2 (MCK/8), TCCLKS_TIMER_CLOCK3=3 (MCK/32), TCCLKS_TIMER_CLOCK4=4 (MCK/128), TCCLKS_TIMER_CLOCK5=5 (SLCK), TCCLKS_XC0=6 (XC0), TCCLKS_XC1=7 (XC1), TCCLKS_XC2=8 (XC2), NUM_INTERRUPT_LINES=3, TIMER_WIDTH=32
TC1 at 0x40074000 (TC)
  pins: TCLK3 PB11/C; TCLK4 PB12/C; TCLK5 PB1/C; TIOA3 PB7/C; TIOA4 PB13/C; TIOA5 PB16/C; TIOB3 PB8/C; TIOB4 PB14/C; TIOB5 PB15/C
  parameters: DMAC_ID_RX=11, DMAC_ID_CPA=15, DMAC_ID_CPB=18, DMAC_ID_CPC=21, DMAC_ID_ETRG=24, INSTANCE_ID_CHANNEL0=28, INSTANCE_ID_CHANNEL1=29, INSTANCE_ID_CHANNEL2=30, CLOCK_ID_CHANNEL0=28, CLOCK_ID_CHANNEL1=29, CLOCK_ID_CHANNEL2=30, TCCLKS_=0 (MCK), TCCLKS_TIMER_CLOCK1=1 (GCLK), TCCLKS_TIMER_CLOCK2=2 (MCK/8), TCCLKS_TIMER_CLOCK3=3 (MCK/32), TCCLKS_TIMER_CLOCK4=4 (MCK/128), TCCLKS_TIMER_CLOCK5=5 (SLCK), TCCLKS_XC0=6 (XC0), TCCLKS_XC1=7 (XC1), TCCLKS_XC2=8 (XC2), NUM_INTERRUPT_LINES=3, TIMER_WIDTH=32
TC2 at 0x40078000 (TC)
  pins: TCLK6 PC11/C; TCLK7 PC10/C; TCLK8 PC26/C; TIOA6 PC8/C; TIOA7 PC14/C; TIOA8 PC27/C; TIOB6 PC9/C; TIOB7 PC15/C; TIOB8 PC28/C
  parameters: DMAC_ID_RX=12, DMAC_ID_CPA=16, DMAC_ID_CPB=19, DMAC_ID_CPC=22, DMAC_ID_ETRG=25, INSTANCE_ID_CHANNEL0=53, INSTANCE_ID_CHANNEL1=54, INSTANCE_ID_CHANNEL2=55, CLOCK_ID_CHANNEL0=53, CLOCK_ID_CHANNEL1=54, CLOCK_ID_CHANNEL2=55, TCCLKS_=0 (MCK), TCCLKS_TIMER_CLOCK1=1 (GCLK), TCCLKS_TIMER_CLOCK2=2 (MCK/8), TCCLKS_TIMER_CLOCK3=3 (MCK/32), TCCLKS_TIMER_CLOCK4=4 (MCK/128), TCCLKS_TIMER_CLOCK5=5 (SLCK), TCCLKS_XC0=6 (XC0), TCCLKS_XC1=7 (XC1), TCCLKS_XC2=8 (XC2), NUM_INTERRUPT_LINES=3, TIMER_WIDTH=32
TCMECC at 0x40100400
TRNG at 0x40090000
  parameters: INSTANCE_ID=63, CLOCK_ID=63
WDT at 0x40100250
  parameters: INSTANCE_ID=4
XDMAC at 0x40098000
  parameters: INSTANCE_ID=64, CLOCK_ID=64
FUSES at GPNVMBITS 0 in fuses
LOCKBIT at 0 in lockbits
SCnSCB at 0xE000E000
SCB at 0xE000ED00
SysTick at 0xE000E010
NVIC at 0xE000E100
MPU at 0xE000ED90
FPU at 0xE000EF30
ITM at 0xE0000000
DWT at 0xE0001000
FPB at 0xE0002000
  parameters: __BKPT_NUM=8 (Number of FPB breakpoint comparators)
CoreDebug at 0xE000EDF0
ETM at 0xE0041000
ICE
  pins: TDI PA26/E; TDO PA25/E; TRACESWO PA25/E; TMS PB23/A; SWDIO PB23/A; TCK PB24/A; SWDCLK PB24/A
TPIU at 0xE0040000
  pins: TRACECLK PA20/E; TRACED0 PA29/E; TRACED1 PA30/E; TRACED2 PA28/E; TRACED3 PA27/E

## Interrupts
-15 Reset — Reset Vector, invoked on Power up and warm reset
-14 NonMaskableInt — Non maskable Interrupt, cannot be stopped or preempted
-13 HardFault — Hard Fault, all classes of Fault
-12 MemoryManagement — Memory Management, MPU mismatch, including Access Violation and No Match
-11 BusFault — Bus Fault, Pre-Fetch-, Memory Access Fault, other address/memory related Fault
-10 UsageFault — Usage Fault, i.e. Undef Instruction, Illegal State Transition
-5 SVCall — System Service Call via SVC instruction
-4 DebugMonitor
-2 PendSV — Pendable request for system service
-1 SysTick — System Tick Timer
0 SUPC — Supply Controller
1 RSTC — Reset Controller
2 RTC — Real Time Clock
3 RTT — Real Time Timer
4 WDT — Watchdog Timer 0
5 PMC — Power Management Controller
6 MATRIX0
7 FLEXCOM0
8 FLEXCOM1
9 NMIC — NMI Controller
10 PIOA — Parallel I/O Controller A
11 PIOB — Parallel I/O Controller B
12 PIOC — Parallel I/O Controller C
13 FLEXCOM2
14 FLEXCOM3
16 PIOD — Parallel I/O Controller D
18 CCW (SCB) — Cache ECC Warning
19 CCF (SCB) — Cache ECC Fault
20 FPU — Floating Point Unit
21 IXC (FPU) — Floating Point Unit IXC
22 CRCCU — CRCCU_HCBDMA
23 ADC — ADC controller
24 DACC — DAC Controller
25 TC0 — Timer/Counter 0
26 TC1 (TC0) — Timer/Counter 1
27 TC2 (TC0) — Timer/Counter 2
28 TC3 (TC1) — Timer/Counter 3
29 TC4 (TC1) — Timer/Counter 4
30 TC5 (TC1) — Timer/Counter 5
31 PWM0 — Pulse Width Modulation 0
32 PWM1 — Pulse Width Modulation 1
33 ICM — Integrity Check Monitor
36 MCAN0_INT0 (MCAN0) — MCAN Controller 0 Interrupt 0
37 MCAN0_INT1 (MCAN0) — MCAN Controller 0 Interrupt 1
38 MCAN1_INT0 (MCAN1) — MCAN Controller 1 Interrupt 0
39 MCAN1_INT1 (MCAN1) — MCAN Controller 1 Interrupt 1
40 TCMECC_INTFIX (TCMECC) — TCM ECC Fixable error detected
41 TCMECC_INTNOFIX (TCMECC) — TCM ECC Un-Fixable error detected
42 FLEXRAMECC_INTFIX (FLEXRAMECC) — FlexRAM ECC Fixable error detected
43 FLEXRAMECC_INTNOFIX (FLEXRAMECC) — FlexRAM ECC Un-Fixable error detected
44 SHA — Secure Hash Algorithm
45 PCC — PCC controller
47 RSWDT — Reinforced Secure Watchdog Timer
50 HEFC_INT0 (HEFC) — HEFC Flash Interrupts
51 HEFC_INTFIX (HEFC) — HEFC ECC Fixable error detected
52 HEFC_INTNOFIX (HEFC) — HEFC ECC Un-Fixable error detected
53 TC6 (TC2) — Timer/Counter 6
54 TC7 (TC2) — Timer/Counter 7
55 TC8 (TC2) — Timer/Counter 8
59 HEMC_INTHEMC (HEMC) — HEMC Controller
60 HEMC_INTFIX (HEMC) — HEMC ECC Fixable error detected
61 HEMC_INTNOFIX (HEMC) — HEMC ECC Un-Fixable error detected
62 SFR — Special Function Register
63 TRNG — True Random Generator
64 XDMAC — eXtended DMA Controller
65 SPW — SpaceWire
68 IP1553 — MIL 1553

## Properties
SIGNATURES: JTAGID=0x05D0603F, CHIPID_CIDR=0xB1770700, CHIPID_EXID=0x00000001

## Pinouts (pin number, pad)
CQFP164: 1 GNDCORE, 2 VDDCORE, 3 PA20, 4 PA21, 5 PA22, 6 PA23, 7 PA24, 8 PA25, 9 PA26, 10 PA27, 11 PA28, 12 PA29, 13 PA30, 14 PA31, 15 PB0, 16 PB1, 17 PB2, 18 VDDPLLA_PLLB, 19 GND_PLLA_PLLB, 20 XIN, 21 PB3, 22 PB4, 23 PB5, 24 PB6, 25 VDDIO, 26 GNDIO, 27 PB7, 28 PB8, 29 PB9, 30 PB10, 31 PB11, 32 PB12, 33 PB13, 34 PB14, 35 PB15, 36 PB16, 37 PB17, 38 PB18, 39 PB19, 40 VDDCORE, 41 GNDCORE, 42 GNDCORE, 43 VDDCORE, 44 PB20, 45 PB21, 46 PB22, 47 PB23, 48 PB24, 49 PB25, 50 PB26, 51 PB27, 52 PB28, 53 PD0, 54 PD1, 55 PD2, 56 PD3, 57 TST, 58 JTAGSEL, 59 NMIC_NMI, 60 NRST, 61 VDDIO, 62 GNDIO, 63 PD4, 64 PD5, 65 PD6, 66 PD7, 67 PC0, 68 PC1, 69 PC2, 70 PC3, 71 PC4, 72 PC5, 73 PC6, 74 PC7, 75 PC8, 76 PC9, 77 PC10, 78 PC11, 79 PD8, 80 PD9, 81 VDDCORE, 82 GNDCORE, 83 GNDCORE, 84 VDDCORE, 85 PC12, 86 PC13, 87 PC14, 88 PC15, 89 PC16, 90 PC17, 91 PC18, 92 PC19, 93 PC20, 94 PC21, 95 PC22, 96 PC23, 97 PC24, 98 PC25, 99 PC26, 100 PC27, 101 PC28, 102 VDDIO, 103 GNDIO, 104 PD10, 105 PD11, 106 PD12, 107 PD13, 108 SPWREF0, 109 PD14, 110 PD15, 111 PD16, 112 PD17, 113 PD18, 114 PD19, 115 PD20, 116 PD21, 117 SPWREF1, 118 PD22, 119 PD23, 120 PD24, 121 PD25, 122 VDDCORE, 123 GNDCORE, 124 GNDCORE, 125 VDDCORE, 126 PD28, 127 PD29, 128 PD30, 129 PD31, 130 VDDIO_DAC, 131 GNDIO_DAC, 132 AD_DAC_GNDREF, 133 AD_DAC_VREFIN, 134 ANA_GND, 135 ANA_3V3, 136 VDDIO_ADC, 137 GNDIO_ADC, 138 PA0, 139 PA1, 140 PA2, 141 PA3, 142 PA4, 143 VDDIO, 144 GNDIO, 145 PA5, 146 PA6, 147 PA7, 148 PA8, 149 PA9, 150 PA10, 151 PA11, 152 PA12, 153 PA13, 154 PA14, 155 PA15, 156 PA16, 157 XIN32, 158 PC29, 159 PC30, 160 PA17, 161 PA18, 162 PA19, 163 VDDCORE, 164 GNDCORE

## Notices in the file
Copyright (c) 2018 Microchip Technology Inc.
SPDX-License-Identifier: Apache-2.0
Licensed under the Apache License, Version 2.0 (the "License");
you may not use this file except in compliance with the License.
You may obtain a copy of the License at
http://www.apache.org/licenses/LICENSE-2.0
Unless required by applicable law or agreed to in writing, software
distributed under the License is distributed on an "AS IS" BASIS,
WITHOUT WARRANTIES OR CONDITIONS OF ANY KIND, either express or implied.
See the License for the specific language governing permissions and
limitations under the License.
