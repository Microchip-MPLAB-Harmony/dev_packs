# WLR089U0 register map
Vendor: Microchip
Architecture arm32bit. Special function registers and configuration words.
Registers are 32-bit, read-write, reset 0x0 unless marked. A register's access mark holds for its fields unless they carry their own. Addresses are absolute, and some are shared; only a register's first bit layout is shown; lines under a group give offsets from that group; [hi:lo] are bit positions; {n}, {i} and the like mark numbered series; 'fields as' and 'values as' point back to an identical list; <NAME> marks a mode.

## Further device data
pins=1: PB16/EXTINT0/PAD0/WO0/WO4/IO2/IN11; 2: PA11/EXTINT11/AIN19/X3/Y9/PAD3/PAD3/WO1/WO3/IO5/OUT1; 3: PA12/EXTINT12/PAD0/PAD0/WO0/WO6/CMP0; 4: PB17/EXTINT1/PAD1/WO1/WO5/IO3/OUT3; 5: PA10/EXTINT10/AIN18/X2/Y8/PAD2/PAD2/WO0/WO2/IO4/IN5; 6: PB00/EXTINT0/AIN8/PAD2/WO0/PSOK/IN1; 7: PC19; 8: PB30/EXTINT14/PAD0/WO0/WO2; 9: PB15/EXTINT15/X15/PAD3/WO1/IO1/IN10; 10: PB31/EXTINT15/PAD1/WO1/WO3; 11: PC18; 12: RFI_HF; 13: GND_RF; 14: PA00/XIN32; 15: PA01/XOUT32; 16: VDDCORE; 17: VSW; 18: VDDIN; 19: VDDIO; 20: RFO_HF; 21: GND_HF; 22: GNDANA; 23: PB02/EXTINT2/AIN10/PAD0/WO0/OUT1/OUT0; 24: GNDIO; 25: RESET_N; 26: GNDIO; 27: PA24/EXTINT12/PAD2/PAD2/WO0/WO2/DM/IN8; 28: VDDIN_RF; 29: VDDANA; 30: PB03/EXTINT3/AIN11/PAD1/WO1/VBAT; 31: PA05/EXTINT5/EXTWAKE5/AIN1/AIN5/VOUT1/PAD1/WO1/IN1; 32: PA30/EXTINT10/PAD2/WO0/IO0/IN3; 33: PA28/EXTINT8/IO0; 34: PB23/EXTINT7/PAD3/WO1/IO1/OUT0; 35: PA25/EXTINT13/PAD3/PAD3/WO1/WO3/DP/OUT2; 36: VRPA_RF; 37: RXTX_RF; 38: PA04/EXTINT4/EXTWAKE4/AIN0/AIN4/VREFP/PAD0/WO0/IN0; 39: GNDIO; 40: PA31/EXTINT11/PAD3/WO1/OUT1; 41: GNDIO; 42: PA23/EXTINT7/X11/PAD1/PAD1/WO1/WO5/SOF_1KHZ/IO7/IN7; 43: PA22/EXTINT6/X10/PAD0/PAD0/WO0/WO4/IO6/IN6; 44: GND_PA; 45: GNDANA; 46: PA06/EXTINT6/EXTWAKE6/AIN2/AIN6/Y4/PAD2/WO0/IN2; 47: PA27/EXTINT15/IO0; 48: PB22/EXTINT6/PAD2/WO0/IO0/IN0; 49: PA17/EXTINT1/X5/PAD1/PAD1/WO1/WO7/IO3/IN1; 50: PA18/EXTINT2/X6/PAD2/PAD2/WO0/WO2/CMP0/IN2; 51: PA19/EXTINT3/X7/PAD3/PAD3/WO1/WO3/CMP1/OUT0; 52: PA_BOOST; 53: GND_RF; 54: PA07/EXTINT7/EXTWAKE7/AIN3/AIN7/PAD3/WO1/OUT0; 55: PA08/NMI/AIN16/X0/Y6/PAD0/PAD0/WO0/WO2/IN3; 56: PA09; 57: PA13; 58: PA16/EXTINT0/X4/PAD0/PAD0/WO0/WO6/IO2/IN0; 59: PA14/EXTINT14/PAD2/PAD2/WO0/WO4/IO0/XIN; 60: RFO_LF; 61: GND_RF; 62: SCAN_MODE; 63: VDDIO; 64: GND_RF; 65: GND_RF; 66: GND_RF; 67: PA15/EXTINT15/PAD3/PAD3/WO1/WO5/IO1/XOUT; 68: RFI_RF; 69: VRANA_RF; 70: VDDANA_RF; 71: VRDIG_RF; 72: GND_RF; 73: RF_XTA; 74: RF_XTB; 75: VDDDIG_RF, interrupts=-15 Reset — Reset Vector, invoked on Power up and warm reset; -14 NonMaskableInt — Non maskable Interrupt, cannot be stopped or preempted; -13 HardFault — Hard Fault, all classes of Fault; -5 SVCall — System Service Call via SVC instruction; -2 PendSV — Pendable request for system service; -1 SysTick — System Tick Timer; 0 SYSTEM — System peripherals shared interrupt; 1 WDT — Watchdog Timer; 2 RTC — Real Time Counter; 3 EIC — External Interrupt Controller; 4 NVMCTRL — Non-Volatile Memory Controller; 5 DMAC — Direct Memory Controller; 6 USB — Universal Serial Bus; 7 EVSYS — Event Systems; 8 SERCOM0 — Serial Communication Interface 0; 9 SERCOM1 — Serial Communication Interface 1; 10 SERCOM2 — Serial Communication Interface 2; 11 SERCOM3 — Serial Communication Interface 3; 12 SERCOM4 — Serial Communication Interface 4; 13 SERCOM5 — Serial Communication Interface 5; 14 TCC0 — Timer/Counter for Control Applications 0; 15 TCC1 — Timer/Counter for Control Applications 1; 16 TCC2 — Timer/Counter for Control Applications 2; 17 TC0 — Timer/Counter 0; 18 TC1 — Timer/Counter 1; 19 TC2 — Timer/Counter 2; 20 TC3 — Timer/Counter 3; 21 TC4 — Timer/Counter 4; 22 ADC — Analog-to-Digital Converter; 23 AC — Analog Comparators; 24 DAC — Digital-to-Analog Converter; 25 PTC — Peripheral Touch Controller; 26 AES — Advanced Encryption Standard; 27 TRNG — True Random Number Generator
