# PIC32MZ2048EFM064 register map
Vendor: Microchip
Architecture 32xxxx. Special function registers and configuration words.
Registers are 32-bit, read-write, reset 0x0 unless marked. A register's access mark holds for its fields unless they carry their own. Addresses are absolute, and some are shared; only a register's first bit layout is shown; lines under a group give offsets from that group; [hi:lo] are bit positions; {n}, {i} and the like mark numbered series; 'fields as' and 'values as' point back to an identical list; <NAME> marks a mode.

## Further device data
pins=1: RE5/PMD5/RPE5/ETXEN/AN17; 2: RE6/PMD6/ETXD0/AN16; 3: RE7/PMD7/ETXD1/AN15; 4: RG6/PMA5/SCK2/RPG6/C1IND/AN14; 5: RG7/PMA4/SDA4/RPG7/C1INC/AN13; 6: RG8/PMA3/SCL4/RPG8/C2IND/AN12; 7: VSS; 8: VDD; 9: MCLR; 10: RG9/PMA2/RPG9/C2INC/AN11; 11: RB5/RPB5/C1INA/AN45; 12: RB4/C1INB/AN4; 13: RB3/RPB3/C2INA/AN3; 14: RB2/RPB2/C2INB/AN2; 15: RB1/RPB1/AN1/VREF-/PGEC1; 16: RB0/PMA6/RPB0/AN0/VREF+/PGED1; 17: RB6/RPB6/AN46/PGEC2; 18: RB7/RPB7/AN47/PGED2; 19: AVDD; 20: AVSS; 21: RB8/PMA10/RPB8/AN48; 22: RB9/PMA7/RPB9/AN49; 23: RB10/PMA13/RPB10/AN5/CVREFOUT/TMS; 24: RB11/PMA12/AN6/TDO; 25: VSS; 26: VDD; 27: RB12/PMA11/AN7/TCK; 28: RB13/AN8/TDI; 29: RB14/PMA1/SCK3/RPB14/AN9; 30: RB15/PMA0/OCFB/RPB15/AEMDC/EMDC/AN10; 31: RC12/CLKI/OSC1; 32: RC15/CLKO/OSC2; 33: VBUS; 34: VUSB3V3; 35: VSS; 36: D-; 37: D+; 38: RF3/RPF3/USBID; 39: VDD; 40: VSS; 41: RF4/PMA9/SDA5/RPF4; 42: RF5/PMA8/SCL5/RPF5; 43: RD9/PMA15/PMCS2/SDA1/RPD9/ETXD2/AERXD0; 44: RD10/SCK4/SCL1/RPD10/ECOL; 45: RD11/PMA14/PMCS1/RPD11/ECRS/AEREFCLK/AERXCLK; 46: RD0/INT0/RTCC/RPD0/ETXD3/AERXD1; 47: RC13/RPC13/SOSCI; 48: RC14/T1CK/RPC14/SOSCO; 49: RD1/SCK1/RPD1/AEMDIO/EMDIO; 50: RD2/SDA3/RPD2/AETXEN/ETXERR; 51: RD3/SCL3/RPD3/ETXCLK/AERXERR; 52: RD4/PMWR/RPD4/SQICS0; 53: RD5/PMRD/RPD5/SQICS1; 54: VDD; 55: VSS; 56: RF0/RPF0/AETXD1/ERXD3; 57: RF1/RPF1/AETXD0/ERXD2/SQICLK/TRCLK; 58: RE0/PMD0/ERXD1/SQID0/TRD0; 59: VSS; 60: VDD; 61: RE1/PMD1/ERXD0/SQID1/TRD1; 62: RE2/PMD2/AECRSDV/ECRSDV/ERXDV/SQID2/TRD2; 63: RE3/PMD3/RPE3/EREFCLK/ERXCLK/SQID3/TRD3; 64: RE4/PMD4/ERXERR/AN18, interrupts=0 CORE_TIMER — Core Timer; 1 CORE_SOFTWARE_0 — Core Software 0; 2 CORE_SOFTWARE_1 — Core Software 1; 3 EXTERNAL_0 — Ext INT 0; 4 TIMER_1 — Timer1; 5 INPUT_CAPTURE_1_ERROR — Input Capture 1 Error; 6 INPUT_CAPTURE_1 — Input Capture 1; 7 OUTPUT_COMPARE_1 — Output Compare 1; 8 EXTERNAL_1 — Ext INT 1; 9 TIMER_2 — Timer2; 10 INPUT_CAPTURE_2_ERROR — Input Capture 2 Error; 11 INPUT_CAPTURE_2 — Input Capture 2; 12 OUTPUT_COMPARE_2 — Output Compare 2; 13 EXTERNAL_2 — Ext INT 2; 14 TIMER_3 — Timer3; 15 INPUT_CAPTURE_3_ERROR — Input Capture 3 Error; 16 INPUT_CAPTURE_3 — Input Capture 3; 17 OUTPUT_COMPARE_3 — Output Compare 3; 18 EXTERNAL_3 — Ext INT 3; 19 TIMER_4 — Timer4; 20 INPUT_CAPTURE_4_ERROR — Input Capture 4 Error; 21 INPUT_CAPTURE_4 — Input Capture 4; 22 OUTPUT_COMPARE_4 — Output Compare 4; 23 EXTERNAL_4 — Ext INT 4; 24 TIMER_5 — Timer5; 25 INPUT_CAPTURE_5_ERROR — Input Capture 5 Error; 26 INPUT_CAPTURE_5 — Input Capture 5; 27 OUTPUT_COMPARE_5 — Output Compare 5; 28 TIMER_6 — Timer6; 29 INPUT_CAPTURE_6_ERROR — Input Capture 6 Error; 30 INPUT_CAPTURE_6 — Input Capture 6; 31 OUTPUT_COMPARE_6 — Output Compare 6; 32 TIMER_7 — Timer7; 33 INPUT_CAPTURE_7_ERROR — Input Capture 7 Error; 34 INPUT_CAPTURE_7 — Input Capture 7; 35 OUTPUT_COMPARE_7 — Output Compare 7; 36 TIMER_8 — Timer8; 37 INPUT_CAPTURE_8_ERROR — Input Capture 8 Error; 38 INPUT_CAPTURE_8 — Input Capture 8; 39 OUTPUT_COMPARE_8 — Output Compare 8; 40 TIMER_9 — Timer9; 41 INPUT_CAPTURE_9_ERROR — Input Capture 9 Error; 42 INPUT_CAPTURE_9 — Input Capture 9; 43 OUTPUT_COMPARE_9 — Output Compare 9; 44 ADC — ADC Global; 45 ADC_FIFO — ADC FIFO; 46 ADC_DC1 — ADC Digital Comparator 1; 47 ADC_DC2 — ADC Digital Comparator 2; 48 ADC_DC3 — ADC Digital Comparator 3; 49 ADC_DC4 — ADC Digital Comparator 4; 50 ADC_DC5 — ADC Digital Comparator 5; 51 ADC_DC6 — ADC Digital Comparator 6; 52 ADC_DF1 — ADC Digital Filter 1; 53 ADC_DF2 — ADC Digital Filter 2; 54 ADC_DF3 — ADC Digital Filter 3; 55 ADC_DF4 — ADC Digital Filter 4; 56 ADC_DF5 — ADC Digital Filter 5; 57 ADC_DF6 — ADC Digital Filter 6; 58 ADC_FAULT — ADC Fault; 59 ADC_DATA0 — ADC Data 0; 60 ADC_DATA1 — ADC Data 1; 61 ADC_DATA2 — ADC Data 2; 62 ADC_DATA3 — ADC Data 3; 63 ADC_DATA4 — ADC Data 4; 64 ADC_DATA5 — ADC Data 5; 65 ADC_DATA6 — ADC Data 6; 66 ADC_DATA7 — ADC Data 7; 67 ADC_DATA8 — ADC Data 8; 68 ADC_DATA9 — ADC Data 9; 69 ADC_DATA10 — ADC Data 10; 70 ADC_DATA11 — ADC Data 11; 71 ADC_DATA12 — ADC Data 12; 72 ADC_DATA13 — ADC Data 13; 73 ADC_DATA14 — ADC Data 14; 74 ADC_DATA15 — ADC Data 15; 75 ADC_DATA16 — ADC Data 16; 76 ADC_DATA17 — ADC Data 17; 77 ADC_DATA18 — ADC Data 18; 102 ADC_DATA43 — ADC Data 43; 103 ADC_DATA44 — ADC Data 44; 104 CORE_PERF_COUNT — Core Performance Counter; 105 CORE_FAST_DEBUG_CHAN — Core Fast Debug Channel; 106 SYSTEM_BUS_PROTECTION — System Bus Protection Violation; 107 CRYPTO — Crypto Engine Event; 109 SPI1_FAULT — SPI1 Fault; 110 SPI1_RX — SPI1 Receive Done; 111 SPI1_TX — SPI1 Transmit Done; 112 UART1_FAULT — UART1 Fault; 113 UART1_RX — UART1 Receive Done; 114 UART1_TX — UART1 Transmit Done; 115 I2C1_BUS — I2C1 Bus Collision Event; 116 I2C1_SLAVE — I2C1 Slave Event; 117 I2C1_MASTER — I2C1 Master Event; 119 CHANGE_NOTICE_B — PORTB Input Change; 120 CHANGE_NOTICE_C — PORTC Input Change; 121 CHANGE_NOTICE_D — PORTD Input Change; 122 CHANGE_NOTICE_E — PORTE Input Change; 123 CHANGE_NOTICE_F — PORTF Input Change; 124 CHANGE_NOTICE_G — PORTG Input Change; 128 PMP — Parallel Master Port; 129 PMP_ERROR — Parallel Master Port Error; 130 COMPARATOR_1 — Comparator 1; 131 COMPARATOR_2 — Comparator 2; 132 USB — USB General Event; 133 USB_DMA — USB DMA Event; 134 DMA0 — DMA Channel 0; 135 DMA1 — DMA Channel 1; 136 DMA2 — DMA Channel 2; 137 DMA3 — DMA Channel 3; 138 DMA4 — DMA Channel 4; 139 DMA5 — DMA Channel 5; 140 DMA6 — DMA Channel 6; 141 DMA7 — DMA Channel 7; 142 SPI2_FAULT — SPI2 Fault; 143 SPI2_RX — SPI2 Receive Done; 144 SPI2_TX — SPI2 Transmit Done; 145 UART2_FAULT — UART2 Fault; 146 UART2_RX — UART2 Receive Done; 147 UART2_TX — UART2 Transmit Done; 151 CAN1 — Control Area Network 1; 152 CAN2 — Control Area Network 2; 153 ETHERNET — Ethernet; 154 SPI3_FAULT — SPI3 Fault; 155 SPI3_RX — SPI3 Receive Done; 156 SPI3_TX — SPI3 Transmit Done; 157 UART3_FAULT — UART3 Fault; 158 UART3_RX — UART3 Receive Done; 159 UART3_TX — UART3 Transmit Done; 160 I2C3_BUS — I2C3 Bus Collision Event; 161 I2C3_SLAVE — I2C3 Slave Event; 162 I2C3_MASTER — I2C3 Master Event; 163 SPI4_FAULT — SPI4 Fault; 164 SPI4_RX — SPI4 Receive Done; 165 SPI4_TX — SPI4 Transmit Done; 166 RTCC — Real Time Clock; 167 FLASH_CONTROL — Flash Control Event; 168 PREFETCH — Prefetch Module SEC Event; 169 SQI1 — SQI1 Event; 170 UART4_FAULT — UART4 Fault; 171 UART4_RX — UART4 Receive Done; 172 UART4_TX — UART4 Transmit Done; 173 I2C4_BUS — I2C4 Bus Collision Event; 174 I2C4_SLAVE — I2C4 Slave Event; 175 I2C4_MASTER — I2C4 Master Event; 179 UART5_FAULT — UART5 Fault; 180 UART5_RX — UART5 Receive Done; 181 UART5_TX — UART5 Transmit Done; 182 I2C5_BUS — I2C5 Bus Collision Event; 183 I2C5_SLAVE — I2C5 Slave Event; 184 I2C5_MASTER — I2C5 Master Event; 188 UART6_FAULT — UART6 Fault; 189 UART6_RX — UART6 Receive Done; 190 UART6_TX — UART6 Transmit Done; 192 ADC_EOS — ADC End of Scan Ready; 193 ADC_ARDY — ADC Analog Circuits Ready; 194 ADC_URDY — ADC Update Ready; 196 ADC_EARLY — ADC Group Early Interrupt Request; 198 ADC0_EARLY — ADC0 Early Interrupt Request; 199 ADC1_EARLY — ADC1 Early Interrupt Request; 200 ADC2_EARLY — ADC2 Early Interrupt Request; 201 ADC3_EARLY — ADC3 Early Interrupt Request; 202 ADC4_EARLY — ADC4 Early Interrupt Request; 205 ADC7_EARLY — ADC7 Early Interrupt Request; 206 ADC0_WARM — ADC0 Warm Interrupt Request; 207 ADC1_WARM — ADC1 Warm Interrupt Request; 208 ADC2_WARM — ADC2 Warm Interrupt Request; 209 ADC3_WARM — ADC3 Warm Interrupt Request; 210 ADC4_WARM — ADC4 Warm Interrupt Request; 213 ADC7_WARM — ADC7 Warm Interrupt Request
