# CEC1712H_B2_SX device description
Architecture: CORTEX-M4; Family: CEC1712H_B2_SX; Series: CEC1712H_B2_SX
Registers are 32-bit, read-write, reset 0x0 unless marked. A register's access mark holds for its fields unless they carry their own. Offsets are from the block's base; [hi:lo] are bit positions; lines under a group give offsets from that group.

## ECIA — The ECIA works in conjunction with the processor interrupt interface to handle hardware interrupts andd exceptions.
Instances: ECIA 0x4000E000
0x00 SRC8 — GIRQ8 Source Register
0x04 EN_SET8 (atomic set of EN_SET) — GIRQ8 Enable Set Register
0x08 RESULT8 ro — GIRQ8 Result Register
0x0C EN_CLR8 (atomic clear of EN_CLR) — GIRQ8 Enable Clear Register
0x14 SRC9 — GIRQ9 Source Register
0x18 EN_SET9 (atomic set of EN_SET) — GIRQ9 Enable Set Register
0x1C RESULT9 ro — GIRQ9 Result Register
0x20 EN_CLR9 (atomic clear of EN_CLR) — GIRQ9 Enable Clear Register
0x28 SRC10 — GIRQ10 Source Register
0x2C EN_SET10 (atomic set of EN_SET) — GIRQ10 Enable Set Register
0x30 RESULT10 ro — GIRQ10 Result Register
0x34 EN_CLR10 (atomic clear of EN_CLR) — GIRQ10 Enable Clear Register
0x3C SRC11 — GIRQ11 Source Register
0x40 EN_SET11 (atomic set of EN_SET) — GIRQ11 Enable Set Register
0x44 RESULT11 ro — GIRQ11 Result Register
0x48 EN_CLR11 (atomic clear of EN_CLR) — GIRQ11 Enable Clear Register
0x50 SRC12 — GIRQ12 Source Register
0x54 EN_SET12 (atomic set of EN_SET) — GIRQ12 Enable Set Register
0x58 RESULT12 ro — GIRQ12 Result Register
0x5C EN_CLR12 (atomic clear of EN_CLR) — GIRQ12 Enable Clear Register
0x64 SRC13 — GIRQ13 Source Register
0x68 EN_SET13 (atomic set of EN_SET) — GIRQ13 Enable Set Register
0x6C RESULT13 ro — GIRQ13 Result Register
0x70 EN_CLR13 (atomic clear of EN_CLR) — GIRQ13 Enable Clear Register
0x78 SRC14 — GIRQ14 Source Register
0x7C EN_SET14 (atomic set of EN_SET) — GIRQ14 Enable Set Register
0x80 RESULT14 ro — GIRQ14 Result Register
0x84 EN_CLR14 (atomic clear of EN_CLR) — GIRQ14 Enable Clear Register
0x8C SRC15 — GIRQ15 Source Register
0x90 EN_SET15 (atomic set of EN_SET) — GIRQ15 Enable Set Register
0x94 RESULT15 ro — GIRQ15 Result Register
0x98 EN_CLR15 (atomic clear of EN_CLR) — GIRQ15 Enable Clear Register
0xA0 SRC16 — GIRQ16 Source Register
0xA4 EN_SET16 (atomic set of EN_SET) — GIRQ16 Enable Set Register
0xA8 RESULT16 ro — GIRQ16 Result Register
0xAC EN_CLR16 (atomic clear of EN_CLR) — GIRQ16 Enable Clear Register
0xB4 SRC17 — GIRQ17 Source Register
0xB8 EN_SET17 (atomic set of EN_SET) — GIRQ17 Enable Set Register
0xBC RESULT17 ro — GIRQ17 Result Register
0xC0 EN_CLR17 (atomic clear of EN_CLR) — GIRQ17 Enable Clear Register
0xC8 SRC18 — GIRQ18 Source Register
0xCC EN_SET18 (atomic set of EN_SET) — GIRQ18 Enable Set Register
0xD0 RESULT18 ro — GIRQ18 Result Register
0xD4 EN_CLR18 (atomic clear of EN_CLR) — GIRQ18 Enable Clear Register
0xDC SRC19 — GIRQ19 Source Register
0xE0 EN_SET19 (atomic set of EN_SET) — GIRQ19 Enable Set Register
0xE4 RESULT19 ro — GIRQ19 Result Register
0xE8 EN_CLR19 (atomic clear of EN_CLR) — GIRQ19 Enable Clear Register
0xF0 SRC20 — GIRQ20 Source Register
0xF4 EN_SET20 (atomic set of EN_SET) — GIRQ20 Enable Set Register
0xF8 RESULT20 ro — GIRQ20 Result Register
0xFC EN_CLR20 (atomic clear of EN_CLR) — GIRQ20 Enable Clear Register
0x104 SRC21 — GIRQ21 Source Register
0x108 EN_SET21 (atomic set of EN_SET) — GIRQ21 Enable Set Register
0x10C RESULT21 ro — GIRQ21 Result Register
0x110 EN_CLR21 (atomic clear of EN_CLR) — GIRQ21 Enable Clear Register
0x118 SRC22 — GIRQ22 Source Register
0x11C EN_SET22 (atomic set of EN_SET) — GIRQ22 Enable Set Register
0x120 RESULT22 ro — GIRQ22 Result Register
0x124 EN_CLR22 (atomic clear of EN_CLR) — GIRQ22 Enable Clear Register
0x12C SRC23 — GIRQ23 Source Register
0x130 EN_SET23 (atomic set of EN_SET) — GIRQ23 Enable Set Register
0x134 RESULT23 ro — GIRQ23 Result Register
0x138 EN_CLR23 (atomic clear of EN_CLR) — GIRQ23 Enable Clear Register
0x140 SRC24 — GIRQ24 Source Register
0x144 EN_SET24 (atomic set of EN_SET) — GIRQ24 Enable Set Register
0x148 RESULT24 ro — GIRQ24 Result Register
0x14C EN_CLR24 (atomic clear of EN_CLR) — GIRQ24 Enable Clear Register
0x154 SRC25 — GIRQ25 Source Register
0x158 EN_SET25 (atomic set of EN_SET) — GIRQ25 Enable Set Register
0x15C RESULT25 ro — GIRQ25 Result Register
0x160 EN_CLR25 (atomic clear of EN_CLR) — GIRQ25 Enable Clear Register
0x168 SRC26 — GIRQ26 Source Register
0x16C EN_SET26 (atomic set of EN_SET) — GIRQ26 Enable Set Register
0x170 RESULT26 ro — GIRQ26 Result Register
0x174 EN_CLR26 (atomic clear of EN_CLR) — GIRQ26 Enable Clear Register
0x200 BLK_EN_SET (atomic set of BLOCK_ENABLE_SET) — Block Enable Set Register
  [30:0] VTOR_EN_SET — Each GIRQx bit can be individually enabled to assert an interrupt event. Reads always return the current value of the internal GIRQX_ENABLE bit. The state of the GIRQX_ENABLE bit is determined by the corresponding GIRQX_ENABLE_SET bit and the GIRQX_ENABLE_CLEAR bit. (0=disabled, 1=enabled) (R/WS). 1=Interrupts in the GIRQx Source Register may be enabled. 0=No effect.
0x204 BLK_EN_CLR — Block Enable Clear Register.
  [30:0] VTOR_EN_CLR — Each GIRQx bit can be individually disabled to inhibit an interrupt event. Reads always return the current value of the internal GIRQX_ENABLE bit. The state of the GIRQX_ENABLE bit is determined by the corresponding GIRQX_ENABLE_SET bit and the GIRQX_ENABLE_CLEAR bit. (0=disabled, 1=enabled) (R/WC). 1=All interrupts in the GIRQx Source Register are disabled. 0=No effect.
0x208 BLK_IRQ_VTOR ro — Block IRQ Vector Register
  [24:0] VTOR — Each bit in this field reports the status of the group GIRQ interrupt assertion to the NVIC. If the GIRQx interrupt is disabled as a group, by the Block Enable Clear Register, then the corresponding bit will be '0'b and no interrupt will be asserted.
