# PIC32CX1025SG41128 device description
Architecture: CORTEX-M4; Family: PIC32CX; Series: PIC32CXSG41
Parameters: NUM_IRQ=137 (Number of interrupt request lines), __CM4_REV=0x0001 (Cortex-M4 Core Revision), __DEBUG_LVL=3 (Debug Level), __FPU_PRESENT=1 (FPU present or not), __MPU_PRESENT=1 (MPU present or not), __NVIC_PRIO_BITS=3 (Number of Bits used for Priority Levels), __TRACE_LVL=2 (Trace Level), __VTOR_PRESENT=1 (Vector Table Offset Register present or not), __Vendor_SysTickConfig=0 (Set to 1 if different SysTick Config is used), __ARCH_ARM=1, __ARCH_ARM_CORTEX_M=1, __DEVICE_IS_SAM=1
Programming and debug interfaces: SWD
Registers are 32-bit, read-write, reset 0x0 unless marked. A register's access mark holds for its fields unless they carry their own. Offsets are from the block's base; lines under a group give offsets from that group; [hi:lo] are bit positions; {n}, {i} and the like mark numbered series; 'fields as' and 'values as' point back to an identical list; <NAME> marks a mode.

## Ordering variants
PIC32CX1025SG41128-I/Z2X: TQFP128, up to 120 MHz, -40 to 85 C, 1.71 to 3.63 V
PIC32CX1025SG41128-E/Z2X: TQFP128, up to 100 MHz, -40 to 125 C, 1.71 to 3.63 V

## Memory
base space: start 0 size 0x100000000, little endian
  0x00000000 FLASH size 0x100000 flash, rw, executable, page 512
  0x00800030 BOCOR size 0x4 fuses, rw
  0x00800080 SW0 size 0x8 fuses, ro
  0x00804000 USER_PAGE size 0x200 user_page, rw, page 512
  0x03000000 CMCC size 0x1000000 io, rw
  0x3000000 CMCC_DATARAM size 0x1000 io, rw
  0x3001000 CMCC_TAGRAM size 0x400 io, rw
  0x3002000 CMCC_VALIDRAM size 0x40 io, rw
  0x04000000 QSPI size 0x1000000 other, rw, executable, external
  0x20000000 HSRAM size 0x40000 ram, rw, executable
  0x20000000 HSRAM_ETB size 0x8000 ram, rw, executable
  0x20000000 HSRAM_RET1 size 0x8000 ram, rw, executable
  0x40000000 HPB0 size 0x4400 io, rw
  0x41000000 HPB1 size 0x22000 io, rw
  0x42000000 HPB2 size 0x3C00 io, rw
  0x43000000 HPB3 size 0x3000 io, rw
  0x44000000 SEEPROM size 0x20000 io, rw
  0x45000000 SDHC0 size 0xC00 io, rw
  0x46000000 SDHC1 size 0xC00 io, rw
  0x47000000 BKUPRAM size 0x2000 ram, rw, executable
  0xE0000000 PPB size 0x100000 io, rw
  0xE000E000 SCS size 0x00001000 io, rw
  0x40000000 PERIPHERALS size 0x20000000 io, rw
fuses space: start 0x00000000 size 0x20000000, little endian

## Peripheral instances (address, pins/pin function, parameters)
AC at 0x42002000
  pins: AIN0 PA04/B; AIN1 PA05/B; AIN2 PA06/B; AIN3 PA07/B; CMP0 PA12/M set 1 or PA18/M set 2 or PB24/M set 3; CMP1 PA13/M set 1 or PA19/M set 2 or PB25/M set 3
  parameters: COMPCTRL_MUXNEG_OPAMP=7 (OPAMP selection for MUXNEG), GCLK_ID=32 (Index of Generic Clock), IMPLEMENTS_VDBLR=0 (VDoubler implemented ?), NUM_CMP=2 (Number of comparators), PAIRS=1 (Number of pairs of comparators), SPEED_LEVELS=2 (Number of speed values), INSTANCE_ID=72 (Instance index for AC)
ADC0 at 0x43001C00 (ADC)
  pins: AIN0 PA02/B; AIN1 PA03/B; AIN2 PB08/B; AIN3 PB09/B; AIN{n} PA{n:02}/B (n=4..11); AIN12 PB00/B; AIN13 PB01/B; AIN14 PB02/B; AIN15 PB03/B; X0 PA03/B; Y0 PA03/B; X1 PB08/B; Y1 PB08/B; X2 PB09/B; Y2 PB09/B; X3 PA04/B; Y3 PA04/B; X4 PA06/B; Y4 PA06/B; X5 PA07/B; Y5 PA07/B; X6 PA08/B; Y6 PA08/B; X7 PA09/B; Y7 PA09/B; X8 PA10/B; Y8 PA10/B; X9 PA11/B; Y9 PA11/B; X{n} PA{n+6}/B (n=10..17); Y{n} PA{n+6}/B (n=10..17); X18 PA27/B; Y18 PA27/B; X19 PA30/B; Y19 PA30/B; X20 PB02/B; Y20 PB02/B; X21 PB03/B; Y21 PB03/B; X22 PB04/B; Y22 PB04/B; X23 PB05/B; Y23 PB05/B; X24 PB06/B; Y24 PB06/B; X25 PB07/B; Y25 PB07/B; X26 PB12/B; Y26 PB12/B; X27 PB13/B; Y27 PB13/B; X28 PB14/B; Y28 PB14/B; X29 PB15/B; Y29 PB15/B; X30 PB00/B; Y30 PB00/B; X31 PB01/B; Y31 PB01/B; VREFA PA03/B; VREFB PA04/B; VREFC PA06/B
  parameters: BANDGAP=27 (MUXPOS value to select BANDGAP), DMAC_ID_RESRDY=68 (index of DMA RESRDY trigger), DMAC_ID_SEQ=69 (Index of DMA SEQ trigger), EXTCHANNEL_MSB=15 (Number of external channels), GCLK_ID=40 (index of Generic Clock), MASTER_SLAVE_MODE=1 (ADC Master/Slave Mode), OPAMP2=0 (MUXPOS value to select OPAMP2), OPAMP01=0 (MUXPOS value to select OPAMP01), TOUCH_IMPLEMENTED=1 (TOUCH implemented or not), TOUCH_LINES_NUM=32 (Number of touch lines), INSTANCE_ID=103 (Instance index for ADC0)
ADC1 at 0x43002000 (ADC)
  pins: AIN0 PB08/B; AIN1 PB09/B; AIN2 PA08/B; AIN3 PA09/B; AIN4 PC02/B; AIN5 PC03/B; AIN6 PB04/B; AIN7 PB05/B; AIN8 PB06/B; AIN9 PB07/B; AIN10 PC00/B; AIN11 PC01/B; AIN12 PC30/B; AIN13 PC31/B; AIN14 PD00/B; AIN15 PD01/B
  parameters: BANDGAP=27 (MUXPOS value to select BANDGAP), DMAC_ID_RESRDY=70 (Index of DMA RESRDY trigger), DMAC_ID_SEQ=71 (Index of DMA SEQ trigger), EXTCHANNEL_MSB=15 (Number of external channels), GCLK_ID=41 (Index of Generic Clock), MASTER_SLAVE_MODE=2 (ADC Master/Slave Mode), OPAMP2=0 (MUXPOS value to select OPAMP2), OPAMP01=0 (MUXPOS value to select OPAMP01), TOUCH_IMPLEMENTED=0 (TOUCH implemented or not), TOUCH_LINES_NUM=1 (Number of touch lines), INSTANCE_ID=104 (Instance index for ADC1)
AES at 0x42002400
  parameters: DMAC_ID_RD=82 (DMA DATA Read trigger), DMAC_ID_WR=81 (DMA DATA Write trigger), FOUR_BYTE_OPERATION=1 (Byte Operation), GCM=1, KEYLEN=2 (Key Length), INSTANCE_ID=73 (Instance index for AES)
CAN0 at 0x42000000 (CAN)
  pins: RX PA23/I or PA25/I; TX PA22/I or PA24/I
  parameters: DMAC_ID_DEBUG=20 (DMA CAN Debug Req), GCLK_ID=27 (Index of Generic Clock), MSG_RAM_ADDR=0x20000000, QOS_RESET_VAL=1 (QOS reset value), INSTANCE_ID=64 (Instance index for CAN0)
CAN1 at 0x42000400 (CAN)
  pins: RX PB13/H or PB15/H; TX PB12/H or PB14/H
  parameters: DMAC_ID_DEBUG=21 (DMA CAN Debug Req), GCLK_ID=28 (Index of Generic Clock), MSG_RAM_ADDR=0x20000000, QOS_RESET_VAL=1 (QOS reset value), INSTANCE_ID=65 (Instance index for CAN1)
CCL at 0x42003800
  pins: IN0 PA04/N or PA16/N or PB22/N; IN1 PA05/N or PA17/N or PB00/N; IN2 PA06/N or PA18/N or PB01/N; IN3 PA08/N or PA30/N; IN4 PA09/N or PC27/N; IN5 PA10/N or PC28/N; IN6 PA22/N or PB06/N; IN7 PA23/N or PB07/N; IN8 PA24/N or PB08/N; IN9 PB14/N or PC20/N; IN10 PB15/N or PC21/N; IN11 PB10/N or PB16/N; OUT0 PA07/N or PA19/N or PB02/N or PB23/N; OUT1 PA11/N or PA31/N or PB11/N; OUT2 PA25/N or PB09/N; OUT3 PB17/N
  parameters: GCLK_ID=33 (GCLK index for CCL), LUT_NUM=4 (Number of LUT in a CCL), SEQ_NUM=2 (Number of SEQ in a CCL), INSTANCE_ID=78 (Instance index for CCL)
CMCC at 0x41006000
  parameters: INSTANCE_ID=35 (Instance index for CMCC)
DAC at 0x43002400
  pins: VOUT0 PA02/B; VOUT1 PA05/B
  parameters: CHANNEL_SIZE=2 (Number of DACs), DATA_SIZE=12 (Number of bits in data), DMAC_ID_EMPTY0=72 (Index of DMA DAC Channel 0 Empty request), DMAC_ID_EMPTY1=73 (Index of DMA DAC Channel 1 Empty request), DMAC_ID_RESRDY0=74 (Index of DMA DAC Channel 0 Result Ready request), DMAC_ID_RESRDY1=75 (Index of DMA DAC Channel 1 Result Ready request), GCLK_ID=42 (Index of Generic Clock), STEP=7 (Number of steps to reach full scale), INSTANCE_ID=105 (Instance index for DAC)
DMAC at 0x4100A000
  parameters: BURST=1 (0: no burst support; 1: burst support), CH_BITS=5 (Number of bits to select channel), CH_NUM=32 (Number of channels), EVIN_NUM=8 (Number of input events), EVOUT_NUM=4 (Number of output events), FIFO_SIZE=16 (FIFO size for burst mode.), LVL_BITS=2 (Number of bits to select level priority), LVL_NUM=4 (Enable priority level number), QOSCTRL_D_RESETVALUE=2 (QOS dmac ahb interface reset value), QOSCTRL_F_RESETVALUE=2 (QOS dmac fetch interface reset value), QOSCTRL_WRB_RESETVALUE=2 (QOS dmac write back interface reset value), TRIG_BITS=7 (Number of bits to select trigger source), TRIG_NUM=85 (Number of peripheral triggers), CHANNEL{n}_INT_SRC={n+31} (DMA Channel {n} Interrupt) (n=0..4), CHANNEL{n}_INT_SRC=35 (DMA Channel {n} Interrupt) (n=5..31), INSTANCE_ID=37 (Instance index for DMAC)
DSU at 0x41002000
  parameters: DMAC_ID_DCC0=2 (DMAC ID for DCC0 register), DMAC_ID_DCC1=3 (DMAC ID for DCC1 register), INSTANCE_ID=33 (Instance index for DSU)
EIC at 0x40002800
  pins: EXTINT0 PA00/A or PA16/A or PB00/A or PB16/A or PC00/A or PC16/A or PD00/A; EXTINT1 PA01/A or PA17/A or PB01/A or PB17/A or PC01/A or PC17/A or PD01/A; EXTINT2 PA02/A or PA18/A or PB02/A or PB18/A or PC02/A or PC18/A; EXTINT3 PA03/A or PA19/A or PB03/A or PB19/A or PC03/A or PC19/A or PD08/A; EXTINT4 PA04/A or PA20/A or PB04/A or PB20/A or PC04/A or PC20/A or PD09/A; EXTINT5 PA05/A or PA21/A or PB05/A or PB21/A or PC05/A or PC21/A or PD10/A; EXTINT6 PA06/A or PA22/A or PB06/A or PB22/A or PC06/A or PC22/A or PD11/A; EXTINT7 PA07/A or PA23/A or PB07/A or PB23/A or PC23/A or PD12/A; EXTINT8 PA24/A or PB08/A or PB24/A or PC24/A; EXTINT9 PA09/A or PA25/A or PB09/A or PB25/A or PC07/A or PC25/A; EXTINT10 PA10/A or PB10/A or PC10/A or PC26/A or PD20/A; EXTINT11 PA11/A or PA27/A or PB11/A or PC11/A or PC27/A or PD21/A; EXTINT12 PA12/A or PB12/A or PB26/A or PC12/A or PC28/A; EXTINT13 PA13/A or PB13/A or PB27/A or PC13/A; EXTINT14 PA30/A or PB14/A or PB28/A or PB30/A or PC14/A or PC30/A or PA14/A; EXTINT15 PA15/A or PA31/A or PB15/A or PB29/A or PB31/A or PC15/A or PC31/A; NMI PA08/A
  parameters: EXTINT_NUM=16 (Number of external interrupts), GCLK_ID=4 (Generic Clock index), NUMBER_OF_CONFIG_REGS=2 (Number of CONFIG registers), NUMBER_OF_DPRESCALER_REGS=2 (Number of DPRESCALER pin groups), NUMBER_OF_INTERRUPTS=16 (Number of external interrupts (obsolete)), INSTANCE_ID=10 (Instance index for EIC)
EVSYS at 0x4100E000
  parameters: ASYNCHRONOUS_CHANNELS=0xFFFFF000 (Mask of Only Asynchronous Channels), CHANNELS=32 (Total Number of Channels), CHANNELS_BITS=5 (Number of bits to select Channel), EXTEVT_NUM=0 (Number of External Event Generators), GCLK_ID_{n}={n+11} (Index of Generic Clock {n}) (n=0..11), GENERATORS=119 (Total Number of Event Generators), GENERATORS_BITS=7 (Number of bits to select Event Generator), SYNCH_NUM=12 (Number of Synchronous Channels), SYNCH_NUM_BITS=4 (Number of bits to select Synchronous Channels), USERS=67 (Total Number of Event Users), USERS_BITS=7 (Number of bits to select Event User), INSTANCE_ID=39 (Instance index for EVSYS)
FREQM at 0x40002C00
  parameters: GCLK_ID_MSR=5 (Index of measure generic clock), GCLK_ID_REF=6 (Index of reference generic clock), INSTANCE_ID=11 (Instance index for FREQM)
GCLK at 0x40001C00
  pins: IO0 PA30/M or PB14/M or PA14/M or PB22/M; IO1 PB15/M or PA15/M or PB23/M or PA27/M; IO2 PA16/M or PB16/M; IO3 PA17/M or PB17/M; IO4 PA10/M or PB10/M or PB18/M; IO5 PA11/M or PB11/M or PB19/M; IO6 PB12/M or PB20/M; IO7 PB13/M or PB21/M
  parameters: GENCTRL0_RESETVALUE=106 (Default specific reset value for generator 0), GENDIV_BITS=16, GEN_BITS=4, GEN_NUM=12 (Number of Generic Clock Generators), GEN_NUM_MSB=11 (Number of Generic Clock Generators - 1), GEN_SOURCE_NUM_MSB=8 (Number of Generic Clock Sources - 1), IO_NUM=8 (Number of Generic Clock I/Os), NUM=48 (Number of Generic Clock Users), SOURCE_BITS=4, SOURCE_NUM=9 (Number of Generic Clock Sources), INSTANCE_ID=7 (Instance index for GCLK)
GMAC at 0x42000800
  pins: GCOL PC21/L; GCRS PA16/L; GMDC PA20/L set 4 or PB14/L set 1 or PC11/L set 2 or PC22/L set 3; GMDIO PA21/L set 4 or PB15/L set 1 or PC12/L set 2 or PC23/L set 3; GRX0 PA13/L; GRX1 PA12/L; GRX2 PC15/L; GRX3 PC14/L; GRXCK PC18/L; GRXDV PC20/L; GRXER PA15/L; GTX0 PA18/L; GTX1 PA19/L; GTX2 PC16/L; GTX3 PC17/L; GTXCK PA14/L; GTXEN PA17/L; GTXER PC19/L
  parameters: INSTANCE_ID=66 (Instance index for GMAC)
HMATRIX at 0x4100C000 (HMATRIXB)
  parameters: MASTER_NUM=8, MASTER_CM4_S=0, MASTER_CMCC=1, MASTER_PICOP_MEM=2, MASTER_PICOP_IO=3, MASTER_DMAC_DTWR=4, MASTER_DMAC_DTRD=5, MASTER_ICM=6, MASTER_DSU=7, SLAVE_NUM=15, SLAVE_FLASH=0, SLAVE_FLASH_ALT=1, SLAVE_SEEPROM=2, SLAVE_RAMCM4S=3, SLAVE_RAMPPPDSU=4, SLAVE_RAMDMAWR=5, SLAVE_RAMDMACICM=6, SLAVE_HPB0=7, SLAVE_HPB1=8, SLAVE_HPB2=9, SLAVE_HPB3=10, SLAVE_SDHC0=12, SLAVE_SDHC1=13, SLAVE_QSPI=14, SLAVE_BKUPRAM=15, INSTANCE_ID=38 (Instance index for HMATRIX)
ICM at 0x42002C00
  parameters: INSTANCE_ID=75
I2S at 0x43002800
  pins: FS0 PA09/J set 1 or PA20/J set 2; FS1 PA23/J set 2 or PB11/J set 1; MCK0 PA08/J set 1 or PB17/J set 2; MCK1 PB29/J set 2 or PB13/J set 1; SCK0 PA10/J set 1 or PB16/J set 2; SCK1 PB28/J set 2 or PB12/J set 1; SDI PA22/J set 2 or PB10/J set 1; SDO PA11/J set 1 or PA21/J set 2
  parameters: CLK_NUM=2 (Number of clock units), GCLK_ID_0=43 (Index of Generic Clock 0), GCLK_ID_1=44 (Index of Generic Clock 1), DMAC_ID_RX_0=76 (Index of DMA RX Trigger 0), DMAC_ID_RX_1=77 (Index of DMA RX Trigger 1), DMAC_ID_TX_0=78 (Index of DMA TX Trigger 0), DMAC_ID_TX_1=79 (Index of DMA TX Trigger 1), MAX_SLOTS=8 (Max number of data slots in frame), MAX_WL_BITS=32 (Max number of bits in data samples), SER_NUM=2 (Number of serializers), INSTANCE_ID=106 (Instance index for I2S)
MCLK at 0x40000800
  parameters: SYSTEM_CLOCK=48000000 (System Clock Frequency at Reset), INSTANCE_ID=2 (Instance index for MCLK)
  clocks: AHB HPB0 bit 0, HPB1 bit 1, HPB2 bit 2, HPB3 bit 3, DSU bit 4, HMATRIX bit 5, NVMCTRL bit 6, HSRAM bit 7, CMCC bit 8, DMAC bit 9, USB bit 10, BKUPRAM bit 11, PAC bit 12, QSPI bit 13, GMAC bit 14, SDHC0 bit 15, SDHC1 bit 16, CAN0 bit 17, CAN1 bit 18, ICM bit 19, PUKCC bit 20, QSPI_2X bit 21, NVMCTRL_SMEEPROM bit 22, NVMCTRL_CACHE bit 23
NVMCTRL at 0x41004000
  parameters: BLOCK_SIZE=8192 (Size Of Block (Bytes, Smallest Granularity for Erase Operation)), FLASH_SIZE=1048576, PAGES=2048, PAGES_PR_REGION=128, PSM_0_FRMFW_FWS_1_MAX_FREQ=12000000, PSM_0_FRMLP_FWS_0_MAX_FREQ=18000000, PSM_0_FRMLP_FWS_1_MAX_FREQ=36000000, PSM_0_FRMHS_FWS_0_MAX_FREQ=25000000, PSM_0_FRMHS_FWS_1_MAX_FREQ=50000000, PSM_1_FRMFW_FWS_1_MAX_FREQ=12000000, PSM_1_FRMLP_FWS_0_MAX_FREQ=8000000, PSM_1_FRMLP_FWS_1_MAX_FREQ=12000000, INSTANCE_ID=34 (Instance index for NVMCTRL)
FUSES at BOCOR_FUSES 0x00800030 in fuses, SW0_FUSES 0x00800080 in fuses, USER_FUSES 0x00804000 in fuses
OSCCTRL at 0x40001000
  pins: XIN0 PA14/XIN0; XIN1 PB22/XIN1; XOUT0 PA15/XOUT0; XOUT1 PB23/XOUT1
  parameters: DFLLS_NUM=1 (Number of DFLLs), DFLL_IMPLEMENTED=1, DFLL48M_BIASTESTPT_IMPLEMENTED=0 (DFLL48M bias test mode implemented), DFLL48M_CDACSTEPSIZE_SIZE=2 (Size COARSE DAC STEP), DFLL48M_COARSE_RESET_VALUE=32 (DFLL48M Frequency Coarse Reset Value (Before Calibration)), DFLL48M_COARSE_SIZE=6 (Size COARSE CALIBRATION), DFLL48M_ENABLE_RESET_VALUE=1 (Run oscillator at reset), DFLL48M_FDACSTEPSIZE_SIZE=2 (Size FINE DAC STEP), DFLL48M_FINE_RESET_VALUE=128 (DFLL48M Frequency Fine Reset Value (Before Calibration)), DFLL48M_FINE_SIZE=8 (Size FINE CALIBRATION), DFLL48M_ONDEMAND_RESET_VALUE=1 (Run oscillator always or only when requested), DFLL48M_RUNSTDBY_RESET_VALUE=0 (Run oscillator even if standby mode), DFLL48M_TCAL_SIZE=4 (Size TEMP CALIBRATION), DFLL48M_TCBIAS_SIZE=2 (Size TC BIAS CALIBRATION), DFLL48M_TESTPTSEL_SIZE=3 (Size TEST POINT SELECTOR), DFLL48M_WAITLOCK_ACTIVE=1 (Enable Wait Lock Feature), DPLLS_NUM=2 (Number of DPLLs), DPLL0_IMPLEMENTED=1, DPLL0_I12ND_I12NDFRAC_PAD_CONTROL=0 (NOT_IMPLEMENTED: The ND and NDFRAC pad tests are not used, use registers instead), DPLL0_OCC_IMPLEMENTED=1, DPLL1_IMPLEMENTED=1, DPLL1_I12ND_I12NDFRAC_PAD_CONTROL=0 (NOT_IMPLEMENTED: The ND and NDFRAC pad tests are not used, use registers instead), DPLL1_OCC_IMPLEMENTED=0, GCLK_ID_DFLL48=0 (Index of Generic Clock for DFLL48), GCLK_ID_FDPLL0=1 (Index of Generic Clock for DPLL0), GCLK_ID_FDPLL1=2 (Index of Generic Clock for DPLL1), GCLK_ID_FDPLL032K=3 (Index of Generic Clock for DPLL0 32K), GCLK_ID_FDPLL132K=3 (Index of Generic Clock for DPLL1 32K), OSC16M_IMPLEMENTED=0, OSC48M_IMPLEMENTED=0, OSC48M_NUM=1, RCOSCS_NUM=1 (Number of RCOSCs (min 1)), XOSCS_NUM=2 (Number of XOSCs), XOSC0_CFD_CLK_SELECT_SIZE=4 (Clock fail prescaler size), XOSC0_CFD_IMPLEMENTED=1 (Clock fail detected for xosc implemented), XOSC0_IMPLEMENTED=1, XOSC0_ONDEMAND_RESET_VALUE=1 (Run oscillator always or only when requested), XOSC0_RUNSTDBY_RESET_VALUE=0 (Run oscillator even if standby mode), XOSC1_CFD_CLK_SELECT_SIZE=4 (Clock fail prescaler size), XOSC1_CFD_IMPLEMENTED=1 (Clock fail detected for xosc implemented), XOSC1_IMPLEMENTED=1, XOSC1_ONDEMAND_RESET_VALUE=1 (Run oscillator always or only when requested), XOSC1_RUNSTDBY_RESET_VALUE=0 (Run oscillator even if standby mode), DFLL48M_VERSION=0x100, FDPLL_VERSION=0x100, XOSC_VERSION=0x100, INSTANCE_ID=4 (Instance index for OSCCTRL)
OSC32KCTRL at 0x40001400
  pins: XIN32 PA00/XIN32; XOUT32 PA01/XOUT32
  parameters: OSC32K_COARSE_CALIB_MSB=0 (OSC32K coarse calibration size), INSTANCE_ID=5 (Instance index for OSC32KCTRL)
PAC at 0x40000000
  parameters: HPB_NUM=4 (Number of bridges AHB/APB), INSTANCE_ID=0 (Instance index for PAC)
PCC at 0x43002C00
  pins: CLK PA14/K; DATA{n} PA{n+16}/K (n=0..7); DATA8 PB14/K; DATA9 PB15/K; DATA10 PC12/K; DATA11 PC13/K; DATA12 PC14/K; DATA13 PC15/K; DEN1 PA12/K; DEN2 PA13/K
  parameters: DATA_SIZE=14, DMAC_ID_RX=80, INSTANCE_ID=107 (Instance index for PCC)
PDEC at 0x42001C00
  pins: QDI0 PB18/G set 2 or PB23/G set 4 or PC16/G set 1 or PA24/G set 3; QDI1 PB19/G set 2 or PB24/G set 4 or PC17/G set 1 or PA25/G set 3; QDI2 PB20/G set 2 or PB25/G set 4 or PC18/G set 1 or PB22/G set 3
  parameters: CC_NUM=2 (Number of Compare Channels units), GCLK_ID=31, INSTANCE_ID=71 (Instance index for PDEC)
PM at 0x40000400
  pins: RESET_N RESET_N
  parameters: PD_NUM=0 (Number of switchable Power Domains), INSTANCE_ID=1 (Instance index for PM)
PORT at 0x41008000
  pins: P{n} PA{n:02} (n=0..25); P27 PA27; P30 PA30; P31 PA31; P{n} PB{n-32:02} (n=32..63); P{n} PC{n-64:02} (n=64..71); P{n} PC{n-64} (n=74..92); P94 PC30; P95 PC31; P96 PD00; P97 PD01; P104 PD08; P105 PD09; P106 PD10; P107 PD11; P108 PD12; P116 PD20; P117 PD21
  parameters: BITS=118, DRVSTR=1 (DRVSTR supported), EV_NUM=4, GROUPS=4, ODRAIN=0 (ODRAIN supported), SLEWLIM=0 (SLEWLIM supported), INSTANCE_ID=36 (Instance index for PORT)
PUKCC
  parameters: RAM_ADDR_SIZE=12, ROM_ADDR_SIZE=16, INSTANCE_ID=76 (Instance index for PUKCC)
QSPI at 0x42003400
  pins: CS PB11/H; DATA0 PA08/H; DATA1 PA09/H; DATA2 PA10/H; DATA3 PA11/H; SCK PB10/H
  parameters: DMAC_ID_RX=83, DMAC_ID_TX=84, HADDR_MSB=23, OCMS=1, INSTANCE_ID=77 (Instance index for QSPI)
RAMECC at 0x41020000
  parameters: RAMADDR_BITS=13 (Number of RAM address bits), RAMBANK_NUM=4 (Number of RAM banks), INSTANCE_ID=48 (Instance index for RAMECC)
RSTC at 0x40000C00
  parameters: BACKUP_IMPLEMENTED=1, HIB_IMPLEMENTED=1, NUMBER_OF_EXTWAKE=0 (number of external wakeup line), NVMRST_IMPLEMENTED=1, INSTANCE_ID=3 (Instance index for RSTC)
RTC at 0x40002400
  pins: IN0 PB00; IN1 PB02; IN2 PA02; IN3 PC00; IN4 PC01; OUT PB01
  parameters: DMAC_ID_TIMESTAMP=1 (DMA RTC timestamp trigger), GPR_NUM=4 (Number of General-Purpose Registers), NUM_OF_ALARMS=2 (Number of Alarms), NUM_OF_BKREGS=8 (Number of Backup Registers), NUM_OF_COMP16=4 (Number of 16-bit Comparators), NUM_OF_COMP32=2 (Number of 32-bit Comparators), NUM_OF_TAMPERS=5 (Number of Tamper Inputs), PER_NUM=8 (Number of Periodic Intervals), INSTANCE_ID=9 (Instance index for RTC)
SDHC0 at 0x45000000 (SDHC)
  pins: SDCD PA06/I or PA12/I or PB12/I or PC06/I; SDCK PB11/I; SDCMD PA08/I; SDDAT0 PA09/I; SDDAT1 PA10/I; SDDAT2 PA11/I; SDDAT3 PB10/I; SDWP PA07/I or PA13/I or PB13/I or PC07/I
  parameters: CARD_DATA_SIZE=4, GCLK_ID=45, GCLK_ID_SLOW=3, NB_OF_DEVICES=1, NB_REG_PVR=8, NB_REG_RR=4
SDHC1 at 0x46000000 (SDHC)
  pins: SDCD PB16/I or PC20/I or PD20/I; SDCK PA21/I; SDCMD PA20/I; SDDAT0 PB18/I; SDDAT1 PB19/I; SDDAT2 PB20/I; SDDAT3 PB21/I; SDWP PB17/I or PC21/I or PD21/I
  parameters: CARD_DATA_SIZE=4, GCLK_ID=46, GCLK_ID_SLOW=3, NB_OF_DEVICES=1, NB_REG_PVR=8, NB_REG_RR=4
SERCOM0 at 0x40003000 (SERCOM)
  pins: PAD0 PA04/D set 3 or PC17/D set 4 or PA08/C set 1 or PB24/C set 2; PAD1 PA05/D set 3 or PC16/D set 4 or PA09/C set 1 or PB25/C set 2; PAD2 PA06/D set 3 or PC18/D set 4 or PA10/C set 1 or PC24/C set 2; PAD3 PA07/D set 3 or PC19/D set 4 or PA11/C set 1 or PC25/C set 2
  parameters: CLK_REDUCTION=1 (Reduce clock options to pin 1 for SPI and USART), DLY_COMPENSATION=1 (Compensates for a fast DLY50 element. Assuming 20ns), DMA=1 (DMA support implemented?), DMAC_ID_RX=4 (Index of DMA RX trigger), DMAC_ID_TX=5 (Index of DMA TX trigger), FIFO_DEPTH_POWER=1 (2^FIFO_DEPTH_POWER gives rx FIFO depth.), GCLK_ID_CORE=7, GCLK_ID_SLOW=3, INT_MSB=6, PMSB=3, RETENTION_SUPPORT=0 (Retention supported?), SE_CNT=1 (SE counter included?), SPI=1 (SPI mode implemented?), SPI_HW_SS_CTRL=1 (Master _SS hardware control implemented?), SPI_ICSPACE_EXT=1 (SPI inter character space implemented?), SPI_OZMO=0 (OZMO features implemented?), SPI_WAKE_ON_SSL=1 (_SS low detect implemented?), SPI_TX_READY_INT_SRC=46 (SPI TX READY Interrupt), SPI_TX_COMPLETE_INT_SRC=47 (SPI TX COMPLETE Interrupt), SPI_RX_INT_SRC=48 (SPI RX Interrupt), SPI_ERROR_INT_SRC=49 (SPI ERROR Interrupt), TTBIT_EXTENSION=1 (32-bit extension implemented?), I2CM=1 (I2C Master mode implemented?), I2CS=1 (I2C Slave mode implemented?), I2CS_AUTO_ACK=1 (I2C slave automatic acknowledge implemented?), I2CS_GROUP_CMD=1 (I2C slave group command implemented?), I2CS_SDASETUP_CNT_SIZE=8 (I2CS sda setup count size), I2CS_SDASETUP_SIZE=4, I2CS_SUDAT=1 (I2C slave SDA setup implemented?), I2C_FASTMP=1 (I2C fast mode plus implemented?), I2C_HSMODE=1 (USART mode implemented?), I2C_SCLSM_MODE=1 (I2C SCL clock stretch mode implemented?), I2C_SMB_TIMEOUTS=1 (I2C SMBus timeouts implemented?), I2C_TENBIT_ADR=1 (I2C ten bit enabled?), I2C_0_INT_SRC=46 (I2C 0 Interrupt), I2C_1_INT_SRC=47 (I2C 1 Interrupt), I2C_2_INT_SRC=48 (I2C 2 Interrupt), I2C_3_INT_SRC=49 (I2C 3 Interrupt), USART=1 (USART mode implemented?), USART_AUTOBAUD=1 (USART autobaud implemented?), USART_COLDET=1 (USART collision detection implemented?), USART_FLOW_CTRL=1 (USART flow control implemented?), USART_FRAC_BAUD=1 (USART fractional BAUD implemented?), USART_IRDA=1 (USART IrDA implemented?), USART_ISO7816=1 (USART ISO7816 mode implemented?), USART_LIN_MASTER=1 (USART LIN Master mode implemented?), USART_RS485=1 (USART RS485 mode implemented?), USART_SAMPA_EXT=1 (USART sample adjust implemented?), USART_SAMPR_EXT=1 (USART oversampling adjustment implemented?), USART_TX_READY_INT_SRC=46 (USART TX READY Interrupt), USART_TX_COMPLETE_INT_SRC=47 (USART TX COMPLETE Interrupt), USART_RX_INT_SRC=48 (USART RX Interrupt), USART_ERROR_INT_SRC=49 (USART ERROR Interrupt), INSTANCE_ID=12 (Instance index for SERCOM0)
SERCOM1 at 0x40003400 (SERCOM)
  pins: PAD0 PA00/D set 4 or PA16/C set 1 or PC22/C set 2 or PC27/C set 3; PAD1 PA01/D set 4 or PA17/C set 1 or PC23/C set 2 or PC28/C set 3; PAD2 PA30/D set 4 or PA18/C set 1 or PB22/C set 3 or PD20/C set 2; PAD3 PA31/D set 4 or PA19/C set 1 or PB23/C set 3 or PD21/C set 2
  parameters: CLK_REDUCTION=1 (Reduce clock options to pin 1 for SPI and USART), DLY_COMPENSATION=1 (Compensates for a fast DLY50 element. Assuming 20ns), DMA=1 (DMA support implemented?), DMAC_ID_RX=6 (Index of DMA RX trigger), DMAC_ID_TX=7 (Index of DMA TX trigger), FIFO_DEPTH_POWER=1 (2^FIFO_DEPTH_POWER gives rx FIFO depth.), GCLK_ID_CORE=8, GCLK_ID_SLOW=3, INT_MSB=6, PMSB=3, RETENTION_SUPPORT=0 (Retention supported?), SE_CNT=1 (SE counter included?), SPI=1 (SPI mode implemented?), SPI_HW_SS_CTRL=1 (Master _SS hardware control implemented?), SPI_ICSPACE_EXT=1 (SPI inter character space implemented?), SPI_OZMO=0 (OZMO features implemented?), SPI_WAKE_ON_SSL=1 (_SS low detect implemented?), SPI_TX_READY_INT_SRC=50 (SPI TX READY Interrupt), SPI_TX_COMPLETE_INT_SRC=51 (SPI TX COMPLETE Interrupt), SPI_RX_INT_SRC=52 (SPI RX Interrupt), SPI_ERROR_INT_SRC=53 (SPI ERROR Interrupt), TTBIT_EXTENSION=1 (32-bit extension implemented?), I2CM=1 (I2C Master mode implemented?), I2CS=1 (I2C Slave mode implemented?), I2CS_AUTO_ACK=1 (I2C slave automatic acknowledge implemented?), I2CS_GROUP_CMD=1 (I2C slave group command implemented?), I2CS_SDASETUP_CNT_SIZE=8 (I2CS sda setup count size), I2CS_SDASETUP_SIZE=4, I2CS_SUDAT=1 (I2C slave SDA setup implemented?), I2C_FASTMP=1 (I2C fast mode plus implemented?), I2C_HSMODE=1 (USART mode implemented?), I2C_SCLSM_MODE=1 (I2C SCL clock stretch mode implemented?), I2C_SMB_TIMEOUTS=1 (I2C SMBus timeouts implemented?), I2C_TENBIT_ADR=1 (I2C ten bit enabled?), I2C_0_INT_SRC=50 (I2C 0 Interrupt), I2C_1_INT_SRC=51 (I2C 1 Interrupt), I2C_2_INT_SRC=52 (I2C 2 Interrupt), I2C_3_INT_SRC=53 (I2C 3 Interrupt), USART=1 (USART mode implemented?), USART_AUTOBAUD=1 (USART autobaud implemented?), USART_COLDET=1 (USART collision detection implemented?), USART_FLOW_CTRL=1 (USART flow control implemented?), USART_FRAC_BAUD=1 (USART fractional BAUD implemented?), USART_IRDA=1 (USART IrDA implemented?), USART_ISO7816=1 (USART ISO7816 mode implemented?), USART_LIN_MASTER=1 (USART LIN Master mode implemented?), USART_RS485=1 (USART RS485 mode implemented?), USART_SAMPA_EXT=1 (USART sample adjust implemented?), USART_SAMPR_EXT=1 (USART oversampling adjustment implemented?), USART_TX_READY_INT_SRC=50 (USART TX READY Interrupt), USART_TX_COMPLETE_INT_SRC=51 (USART TX COMPLETE Interrupt), USART_RX_INT_SRC=52 (USART RX Interrupt), USART_ERROR_INT_SRC=53 (USART ERROR Interrupt), INSTANCE_ID=13 (Instance index for SERCOM1)
SERCOM2 at 0x41012000 (SERCOM)
  pins: PAD0 PA09/D set 3 or PB25/D set 4 or PA12/C set 1 or PB26/C set 2; PAD1 PA08/D set 3 or PB24/D set 4 or PA13/C set 1 or PB27/C set 2; PAD2 PA10/D set 3 or PC24/D set 4 or PB28/C set 2 or PA14/C set 1; PAD3 PA11/D set 3 or PC25/D set 4 or PB29/C set 2 or PA15/C set 1
  parameters: CLK_REDUCTION=1 (Reduce clock options to pin 1 for SPI and USART), DLY_COMPENSATION=1 (Compensates for a fast DLY50 element. Assuming 20ns), DMA=1 (DMA support implemented?), DMAC_ID_RX=8 (Index of DMA RX trigger), DMAC_ID_TX=9 (Index of DMA TX trigger), FIFO_DEPTH_POWER=1 (2^FIFO_DEPTH_POWER gives rx FIFO depth.), GCLK_ID_CORE=23, GCLK_ID_SLOW=3, INT_MSB=6, PMSB=3, RETENTION_SUPPORT=0 (Retention supported?), SE_CNT=1 (SE counter included?), SPI=1 (SPI mode implemented?), SPI_HW_SS_CTRL=1 (Master _SS hardware control implemented?), SPI_ICSPACE_EXT=1 (SPI inter character space implemented?), SPI_OZMO=0 (OZMO features implemented?), SPI_WAKE_ON_SSL=1 (_SS low detect implemented?), SPI_TX_READY_INT_SRC=54 (SPI TX READY Interrupt), SPI_TX_COMPLETE_INT_SRC=55 (SPI TX COMPLETE Interrupt), SPI_RX_INT_SRC=56 (SPI RX Interrupt), SPI_ERROR_INT_SRC=57 (SPI ERROR Interrupt), TTBIT_EXTENSION=1 (32-bit extension implemented?), I2CM=1 (I2C Master mode implemented?), I2CS=1 (I2C Slave mode implemented?), I2CS_AUTO_ACK=1 (I2C slave automatic acknowledge implemented?), I2CS_GROUP_CMD=1 (I2C slave group command implemented?), I2CS_SDASETUP_CNT_SIZE=8 (I2CS sda setup count size), I2CS_SDASETUP_SIZE=4, I2CS_SUDAT=1 (I2C slave SDA setup implemented?), I2C_FASTMP=1 (I2C fast mode plus implemented?), I2C_HSMODE=1 (USART mode implemented?), I2C_SCLSM_MODE=1 (I2C SCL clock stretch mode implemented?), I2C_SMB_TIMEOUTS=1 (I2C SMBus timeouts implemented?), I2C_TENBIT_ADR=1 (I2C ten bit enabled?), I2C_0_INT_SRC=54 (I2C 0 Interrupt), I2C_1_INT_SRC=55 (I2C 1 Interrupt), I2C_2_INT_SRC=56 (I2C 2 Interrupt), I2C_3_INT_SRC=57 (I2C 3 Interrupt), USART=1 (USART mode implemented?), USART_AUTOBAUD=1 (USART autobaud implemented?), USART_COLDET=1 (USART collision detection implemented?), USART_FLOW_CTRL=1 (USART flow control implemented?), USART_FRAC_BAUD=1 (USART fractional BAUD implemented?), USART_IRDA=1 (USART IrDA implemented?), USART_ISO7816=1 (USART ISO7816 mode implemented?), USART_LIN_MASTER=1 (USART LIN Master mode implemented?), USART_RS485=1 (USART RS485 mode implemented?), USART_SAMPA_EXT=1 (USART sample adjust implemented?), USART_SAMPR_EXT=1 (USART oversampling adjustment implemented?), USART_TX_READY_INT_SRC=54 (USART TX READY Interrupt), USART_TX_COMPLETE_INT_SRC=55 (USART TX COMPLETE Interrupt), USART_RX_INT_SRC=56 (USART RX Interrupt), USART_ERROR_INT_SRC=57 (USART ERROR Interrupt), INSTANCE_ID=41 (Instance index for SERCOM2)

## Notices in the file
Copyright (c) 2021 Microchip Technology Inc.
SPDX-License-Identifier: Apache-2.0
Licensed under the Apache License, Version 2.0 (the "License");
you may not use this file except in compliance with the License.
You may obtain a copy of the License at
http://www.apache.org/licenses/LICENSE-2.0
Unless required by applicable law or agreed to in writing, software
distributed under the License is distributed on an "AS IS" BASIS,
WITHOUT WARRANTIES OR CONDITIONS OF ANY KIND, either express or implied.
See the License for the specific language governing permissions and
limitations under the License.
