# SAMA7G54D1G device description
Architecture: CORTEX-A7; Family: SAMA; Series: SAMA7G
Parameters: __CA_REV=0x0005 (CA7 Core Revision(r0p5)), __CORTEX_A=7 (Core type number (Cortex-A7)), __FPU_PRESENT=1 (FPU is present on core), __GIC_PRESENT=1 (GIC is present on core), GIC_DISTRIBUTOR_BASE=0xE8C11000 (Base address for GIC distributor interface), GIC_INTERFACE_BASE=0xE8C12000 (Base address for GIC CPU interface), __TIM_PRESENT=1 (Generic Timer capability is present), __L2C_PRESENT=0 (L2C-310 cache controller is absent)
Programming and debug interfaces: JTAG, SWD
Registers are 32-bit, read-write, reset 0x0 unless marked. A register's access mark holds for its fields unless they carry their own. Offsets are from the block's base; lines under a group give offsets from that group; [hi:lo] are bit positions; {n}, {i} and the like mark numbered series; 'fields as' and 'values as' point back to an identical list; <NAME> marks a mode.

## Ordering variants
SAMA7G54D1-GU: TFBGA427, -40 to 85 C, 1.62 to 3.63 V

## Memory
base space: start 0 size 0x100000000, little endian
  0x00000000 IROM size 0x14000 rom, ro, executable
  0x00020000 ECC_ROM size 0x18000 rom, ro, executable
  0x00040000 CPKCC_ROM size 0x10000 rom, ro, executable
  0x00051000 CPKCC_RAM size 0x1000 other, rw, executable
  0x00100000 IRAM size 0x20000 ram, rw, executable
  0x00200000 UDPHS_RAMA size 0x100000 other, rw, executable
  0x00300000 UDPHS_RAMB size 0x100000 other, rw, executable
  0x00400000 UHPHS_OHCI size 0x1000 other, rw, executable
  0x00500000 UHPHS_EHCI size 0x100000 other, rw, executable
  0x00600000 NFC_RAM size 0x3000 other, rw, executable
  0x10000000 NFC size 0x8000000 other, rw, executable
  0x20000000 QSPIMEM0 size 0x10000000 other, rw, executable
  0x30000000 QSPIMEM1 size 0x10000000 other, rw, executable
  0x40000000 EBI_CS0 size 0x8000000 other, rw, executable, external
  0x48000000 EBI_CS1 size 0x8000000 other, rw, executable, external
  0x50000000 EBI_CS2 size 0x8000000 other, rw, executable, external
  0x58000000 EBI_CS3 size 0x8000000 other, rw, executable, external
  0x60000000 DDR_CS size 0x80000000 other, rw, executable
  0xE0000000 SECURAM size 0x4000 other, rw, executable
  0xE1204000 SDMMC0 size 0x4000 other, rw, executable
  0xE1208000 SDMMC1 size 0x4000 other, rw, executable
  0xE120C000 SDMMC2 size 0x4000 other, rw, executable
  0xE8800000 APB_DBG_S size 0x60000 other, rw, executable
  0xE8900000 APB_DBG size 0x1000 other, rw, executable
  0xE8B00000 NICGPV size 0x100000 other, rw, executable
  0xE8C00000 OTPC size 0x1000 other, rw, executable
  0xE8C02000 CSI2DC_META size 0x2000 other, rw, executable
  0xE8C10000 ARM_PERIPH size 0x8000 io, rw, executable
  0xE0000000 PERIPHERALS size 0x10000000 io, rw

## Peripheral instances (address, pins/pin function, parameters)
ACC at 0xE1600000
  pins: ACC_INP0 PC6/X1; ACC_INN1 PC7/X1; ACC_INP1 PC8/X1; ACC_INN2 PC9/X1; ACC_INP2 PC10/X1; ACC_INN3 PC11/X1; ACC_INP3 PC12/X1
  parameters: INSTANCE_ID=25 (Analog Comparator Controller), CLOCK_ID=25
ADC at 0xE1000000
  pins: ADTRG PB2/C set 1 or PB28/B set 2 or PD26/C set 3; AD{n} PC{n+13}/X1 (n=0..11); AD12 PC30/X1; AD13 PC31/X1; AD14 PD0/X1; AD15 PD1/X1
  parameters: INSTANCE_ID=26 (Analog-to-Digital Converter), DMAC_ID_RX=0
AES at 0xE1810000
  parameters: INSTANCE_ID=27 (Advanced Encryption Standard), CLOCK_ID=27, INSTANCE_ID_SINT=115 (Advanced Encryption Standard, Secure INTerrupt), DMAC_ID_TX=1, DMAC_ID_RX=2
ASRC at 0xE1610000
  parameters: INSTANCE_ID=30 (Asynchronous Sample Rate Converter), CLOCK_ID=30
BSC at 0xE001D054
CHIPID at 0xE0020000
  parameters: INSTANCE_ID=9 (Chip Identifier)
CSI at 0xE1400000
  parameters: INSTANCE_ID=33 (Camera Serial Interface 2 between ISC and MIPI PHY), CLOCK_ID=33
CPKCC at 0xE000C000
  parameters: INSTANCE_ID=32 (Classic Public Key Cryptography Controller), CLOCK_ID=32
CSI2DC at 0xE1404000
  parameters: INSTANCE_ID=34 (CSI to Demultiplexer Controller), CLOCK_ID=34
DDRPUBL at 0xE3804000 (DDR3PHY)
  parameters: INSTANCE_ID=35 (DDR SDRAM PHY Utility Block "Lite" aka PUBL)
DWDT at 0xE001C000
  parameters: INSTANCE_ID_SW=0 (Dual Watchdog Timer, Secure World), INSTANCE_ID_NSW=1 (Dual Watchdog Timer, Non Secure World, interrupt), INSTANCE_ID_NSW_ALARM=2 (Dual Watchdog Timer, Non Secure World Alarm, interrupt)
EBI
  pins: D14 PA1/D set 1 2; D15 PA2/D set 1 2; NWR1 PA3/D set 1 2; NBS1 PA3/D set 1 2; NCS2 PA4/D set 1 2; A23 PA5/D set 1 2; A24 PA6/D set 1 2; NWAIT PA7/D set 1 2; NCS0 PA8/D set 1 2; SMCK PA9/D set 1 2; NCS1 PA10/D set 1 2; A0 PA11/D set 1 2; NBS0 PA11/D set 1 2; A25 PA14/D set 1 2; A{n} PA{n+14}/D set 1 2 (n=1..17); A18 PB0/D set 1 2; A19 PB1/D set 1 2; A20 PB2/D set 1 2; D8 PB3/D set 1 2; D9 PB4/D set 1 2; D10 PB5/D set 1 2; D11 PB6/D set 1 2; D12 PB7/D set 1 2; D13 PB8/D set 1 2; NCS3 PB9/D set 1 or PD4/D set 2; NANDCS PB9/D set 1 or PD4/D set 2; NWE PB10/D set 1 or PD5/D set 2; NWR0 PB10/D set 1 or PD5/D set 2; NANDWE PB10/D set 1 or PD5/D set 2; NRD PB11/D set 1 or PD6/D set 2; NANDOE PB11/D set 1 or PD6/D set 2; A21 PB12/D set 1 or PD7/D set 2; NANDALE PB12/D set 1 or PD7/D set 2; A22 PB13/D set 1 or PD8/D set 2; NANDCLE PB13/D set 1 or PD8/D set 2; D0 PB14/D set 1 or PD9/D set 2; D1 PB15/D set 1 or PD10/D set 2; D2 PB16/D set 1 or PD11/D set 2; D3 PB17/D set 1 or PC21/D set 2; D4 PB18/D set 1 or PC22/D set 2; D5 PB19/D set 1 or PC23/D set 2; D6 PB20/D set 1 or PC24/D set 2; D7 PB21/D set 1 or PD2/D set 2; NANDRDY PB22/D set 1 or PD3/D set 2
EIC at 0xE1628000
  pins: EXT_IRQ0 PB0/C set 1 or PB16/F set 2 or PC17/B set 3; EXT_IRQ1 PB1/C set 1 or PB17/F set 2 or PC24/C set 3
  parameters: INSTANCE_ID=37 (External Interrupt Controller), CLOCK_ID=37, INSTANCE_ID_EXT_IRQ0=153 (External Interrupt ID0 (FIQ)), INSTANCE_ID_EXT_IRQ1=154 (External Interrupt ID1 (IRQ))
FLEXCOM0 at 0xE1818000 (FLEXCOM)
  pins: FLEXCOM0_IO0 PA0/B set 1 or PD3/B set 2 or PD10/F set 3 or PE3/B set 4; FLEXCOM0_IO1 PA1/B set 1 or PD4/B set 2 or PD11/F set 3 or PE4/B set 4; FLEXCOM0_IO2 PA2/B set 1 or PD5/B set 2 3 or PE5/B set 4; FLEXCOM0_IO3 PA3/B set 1 or PD6/B set 2 3 or PE6/B set 4; FLEXCOM0_IO4 PA4/B set 1 or PD7/B set 2 3 or PE7/B set 4; FLEXCOM0_IO5 PA24/E set 1 or PB29/C set 2 or PC23/B set 3; FLEXCOM0_IO6 PA25/E set 1 or PB30/C set 2 or PC24/B set 3
  parameters: INSTANCE_ID=38 (Flexcom 0), CLOCK_ID=38, DMAC_ID_RX=5, DMAC_ID_TX=6, USART_FIFO_SIZE=32, SPI_FIFO_SIZE=32, TWI_FIFO_SIZE=32
FLEXCOM1 at 0xE181C000 (FLEXCOM)
  pins: FLEXCOM1_IO0 PA2/F set 3 or PA5/B set 1 or PC9/F set 4 or PD12/B set 2; FLEXCOM1_IO1 PA3/F set 3 or PA6/B set 1 or PC10/F set 4 or PD13/B set 2; FLEXCOM1_IO3 PA12/B set 1 or PD15/B set 2 3 4; FLEXCOM1_IO2 PA13/B set 1 or PD14/B set 2 3 4; FLEXCOM1_IO4 PA14/B set 1 or PD16/B set 2 3 4
  parameters: INSTANCE_ID=39 (Flexcom 1), CLOCK_ID=39, DMAC_ID_RX=7, DMAC_ID_TX=8, USART_FIFO_SIZE=32, SPI_FIFO_SIZE=32, TWI_FIFO_SIZE=32
FLEXCOM2 at 0xE1820000 (FLEXCOM)
  pins: FLEXCOM2_IO0 PA4/F set 3 or PA7/B set 1 or PC11/F set 4 or PD14/F set 5 or PD17/B set 2; FLEXCOM2_IO1 PA5/F set 3 or PA8/B set 1 or PC12/F set 4 or PD15/F set 5 or PD18/B set 2; FLEXCOM2_IO2 PA9/B set 1 or PD19/B set 2 3 4 5; FLEXCOM2_IO3 PA10/B set 1 or PD20/B set 2 3 4 5; FLEXCOM2_IO4 PA11/B set 1 or PD21/B set 2 3 4 5
  parameters: INSTANCE_ID=40 (Flexcom 2), CLOCK_ID=40, DMAC_ID_RX=9, DMAC_ID_TX=10, USART_FIFO_SIZE=32, SPI_FIFO_SIZE=32, TWI_FIFO_SIZE=32
FLEXCOM3 at 0xE1824000 (FLEXCOM)
  pins: FLEXCOM3_IO0 PA6/F set 3 or PA15/B set 1 or PC0/B set 2 or PC13/F set 4 or PD16/F set 5; FLEXCOM3_IO1 PA7/F set 3 or PA16/B set 1 or PC1/B set 2 or PC14/F set 4 or PD17/F set 5; FLEXCOM3_IO5 PA12/D set 1 or PB7/C set 2 3 4 5; FLEXCOM3_IO6 PA13/D set 1 or PB8/C set 2 3 4 5; FLEXCOM3_IO2 PA17/B set 1 or PB29/B set 2 3 4 5; FLEXCOM3_IO3 PA18/B set 1 or PB30/B set 2 3 4 5; FLEXCOM3_IO4 PA19/B set 1 or PB31/B set 2 3 4 5
  parameters: INSTANCE_ID=41 (Flexcom 3), CLOCK_ID=41, DMAC_ID_RX=11, DMAC_ID_TX=12, USART_FIFO_SIZE=32, SPI_FIFO_SIZE=32, TWI_FIFO_SIZE=32
FLEXCOM4 at 0xE2018000 (FLEXCOM)
  pins: FLEXCOM4_IO0 PA8/F set 3 or PA20/B set 1 or PC2/B set 2 or PC15/F set 4 or PD18/F set 5; FLEXCOM4_IO1 PA9/F set 3 or PA21/B set 1 or PC3/B set 2 or PC16/F set 4 or PD19/F set 5; FLEXCOM4_IO2 PA22/B set 1 or PC4/B set 2 3 4 5; FLEXCOM4_IO3 PA23/B set 1 or PC5/B set 2 3 4 5; FLEXCOM4_IO4 PA24/B set 1 or PC6/B set 2 3 4 5
  parameters: INSTANCE_ID=42 (Flexcom 4), CLOCK_ID=42, DMAC_ID_RX=13, DMAC_ID_TX=14, USART_FIFO_SIZE=32, SPI_FIFO_SIZE=32, TWI_FIFO_SIZE=32
FLEXCOM5 at 0xE201C000 (FLEXCOM)
  pins: FLEXCOM5_IO0 PA10/F set 3 or PA28/B set 1 or PC17/F set 4 or PD20/F set 5 or PD25/B set 2; FLEXCOM5_IO1 PA11/F set 3 or PA29/B set 1 or PC18/F set 4 or PD21/F set 5 or PD26/B set 2; FLEXCOM5_IO4 PA25/B set 1 or PD29/B set 2 3 4 5; FLEXCOM5_IO2 PA26/B set 1 or PD27/B set 2 3 4 5; FLEXCOM5_IO3 PA27/B set 1 or PD28/B set 2 3 4 5
  parameters: INSTANCE_ID=43 (Flexcom 5), CLOCK_ID=43, DMAC_ID_RX=15, DMAC_ID_TX=16, USART_FIFO_SIZE=32, SPI_FIFO_SIZE=32, TWI_FIFO_SIZE=32
FLEXCOM6 at 0xE2020000 (FLEXCOM)
  pins: FLEXCOM6_IO0 PA12/F set 3 or PB2/B set 1 or PC19/F set 4 or PC21/F set 5 or PD30/B set 2; FLEXCOM6_IO1 PA13/F set 3 or PB1/B set 1 or PC20/F set 4 or PC22/F set 5 or PD31/B set 2; FLEXCOM6_IO4 PA30/B set 1 or PE2/B set 2 3 4 5; FLEXCOM6_IO2 PA31/B set 1 or PE0/B set 2 3 4 5; FLEXCOM6_IO3 PB0/B set 1 or PE1/B set 2 3 4 5; FLEXCOM6_IO5 PB12/C set 1 or PC5/C set 2 3 4 5; FLEXCOM6_IO6 PB13/C set 1 or PC6/C set 2 3 4 5
  parameters: INSTANCE_ID=44 (Flexcom 6), CLOCK_ID=44, DMAC_ID_RX=17, DMAC_ID_TX=18, USART_FIFO_SIZE=32, SPI_FIFO_SIZE=32, TWI_FIFO_SIZE=32
FLEXCOM7 at 0xE2024000 (FLEXCOM)
  pins: FLEXCOM7_IO0 PA25/F set 3 or PB23/B set 1 or PB28/F set 4 or PC7/B set 2 or PC23/F set 5; FLEXCOM7_IO1 PA26/F set 3 or PB24/B set 1 or PB29/F set 4 or PC8/B set 2 or PC24/F set 5; FLEXCOM7_IO2 PB25/B set 1 or PC9/B set 2 3 4 5; FLEXCOM7_IO3 PB26/B set 1 or PC10/B set 2 3 4 5; FLEXCOM7_IO4 PB27/B set 1 or PC11/B set 2 3 4 5
  parameters: INSTANCE_ID=45 (Flexcom 7), CLOCK_ID=45, DMAC_ID_RX=19, DMAC_ID_TX=20, USART_FIFO_SIZE=32, SPI_FIFO_SIZE=32, TWI_FIFO_SIZE=32
FLEXCOM8 at 0xE2818000 (FLEXCOM)
  pins: FLEXCOM8_IO0 PA27/F set 3 or PB8/B set 1 or PB30/F set 4 or PC14/B set 2 or PD2/F set 5; FLEXCOM8_IO1 PA28/F set 3 or PB9/B set 1 or PB31/F set 4 or PC13/B set 2 or PD3/F set 5; FLEXCOM8_IO2 PB10/B set 1 or PC12/B set 2 3 4 5; FLEXCOM8_IO3 PB11/B set 1 or PC15/B set 2 3 4 5; FLEXCOM8_IO4 PB12/B set 1 or PC16/B set 2 3 4 5
  parameters: INSTANCE_ID=46 (Flexcom 8), CLOCK_ID=46, DMAC_ID_RX=21, DMAC_ID_TX=22, USART_FIFO_SIZE=32, SPI_FIFO_SIZE=32, TWI_FIFO_SIZE=32
FLEXCOM9 at 0xE281C000 (FLEXCOM)
  pins: FLEXCOM9_IO0 PA29/F set 3 or PB13/B set 1 or PC0/F set 4 or PC18/B set 2 or PD4/F set 5; FLEXCOM9_IO1 PA30/F set 3 or PB14/B set 1 or PC1/F set 4 or PC19/B set 2 or PD5/F set 5; FLEXCOM9_IO2 PB15/B set 1 or PC21/B set 2 3 4 5; FLEXCOM9_IO3 PB16/B set 1 or PC22/B set 2 3 4 5; FLEXCOM9_IO4 PB17/B set 1 or PC20/B set 2 3 4 5; FLEXCOM9_IO5 PB21/C set 1 or PB31/C set 2 3 4 5; FLEXCOM9_IO6 PB22/C set 1 or PC4/C set 2 3 4 5
  parameters: INSTANCE_ID=47 (Flexcom 9), CLOCK_ID=47, DMAC_ID_RX=23, DMAC_ID_TX=24, USART_FIFO_SIZE=32, SPI_FIFO_SIZE=32, TWI_FIFO_SIZE=32
FLEXCOM10 at 0xE2820000 (FLEXCOM)
  pins: FLEXCOM10_IO0 PA31/F set 3 or PB18/B set 1 or PC2/F set 4 or PC30/B set 2 or PD6/F set 5; FLEXCOM10_IO1 PB0/F set 3 or PB19/B set 1 or PC3/F set 4 or PC31/B set 2 or PD7/F set 5; FLEXCOM10_IO2 PB20/B set 1 2 3 4 5; FLEXCOM10_IO3 PB21/B set 1 2 3 4 5; FLEXCOM10_IO4 PB22/B set 1 2 3 4 5
  parameters: INSTANCE_ID=48 (Flexcom 10), CLOCK_ID=48, DMAC_ID_RX=25, DMAC_ID_TX=26, USART_FIFO_SIZE=32, SPI_FIFO_SIZE=32, TWI_FIFO_SIZE=32
FLEXCOM11 at 0xE2824000 (FLEXCOM)
  pins: FLEXCOM11_IO0 PB1/F set 3 or PB3/B set 1 or PC4/F set 4 or PD0/B set 2 or PD8/F set 5; FLEXCOM11_IO1 PB2/F set 3 or PB4/B set 1 or PC5/F set 4 or PD1/B set 2 or PD9/F set 5; FLEXCOM11_IO2 PB5/B set 1 2 3 4 5; FLEXCOM11_IO3 PB6/B set 1 2 3 4 5; FLEXCOM11_IO4 PB7/B set 1 2 3 4 5
  parameters: INSTANCE_ID=49 (Flexcom 11), CLOCK_ID=49, DMAC_ID_RX=27, DMAC_ID_TX=28, USART_FIFO_SIZE=32, SPI_FIFO_SIZE=32, TWI_FIFO_SIZE=32
GMAC0 at 0xE2800000 (GMAC)
  pins: G0_TXEN PA15/A set 1; G0_TX0 PA16/A set 1; G0_TX1 PA17/A set 1; G0_RXDV PA18/A set 1; G0_RX0 PA19/A set 1; G0_RX1 PA20/A set 1; G0_RXER PA21/A set 1; G0_MDC PA22/A set 1; G0_MDIO PA23/A set 1; G0_TXCK PA24/A set 1; G0_125CK PA25/A set 1; G0_TX2 PA26/A set 1; G0_TX3 PA27/A set 1; G0_RX2 PA28/A set 1; G0_RX3 PA29/A set 1; G0_RXCK PA30/A set 1; G0_TXER PA31/A set 1; G0_COL PB0/A set 1; G0_CRS PB1/A set 1; G0_TSUCOMP PB2/A set 1
  parameters: INSTANCE_ID=51 (Gigabit Ethernet MAC), CLOCK_ID=51, INSTANCE_ID_TSU=53 (Gigabit Ethernet MAC - Time Stamp Unit Generic Clock - No Interrupt), INSTANCE_ID_Q{n}={n+115} (GMAC0 Queue {n} Interrupt signal toggled on a DMA write to the first word of each DMA data buffer associated with queue {n}) (n=1..5)
GMAC1 at 0xE2804000 (GMAC)
  pins: G1_TXEN PD21/G set 1; G1_TX0 PD22/G set 1; G1_TX1 PD23/G set 1; G1_RXDV PD24/G set 1; G1_RX0 PD25/G set 1; G1_RX1 PD26/G set 1; G1_RXER PD27/G set 1; G1_MDC PD28/G set 1; G1_MDIO PD29/G set 1; G1_TXCK PD30/G set 1; G1_TX2 PD31/G set 1; G1_TX3 PE0/G set 1; G1_RX2 PE1/G set 1; G1_RX3 PE2/G set 1; G1_RXCK PE3/G set 1; G1_TXER PE4/G set 1; G1_COL PE5/G set 1; G1_CRS PE6/G set 1; G1_TSUCOMP PE7/G set 1
  parameters: INSTANCE_ID=52 (Ethernet MAC), CLOCK_ID=52, INSTANCE_ID_TSU=54 (Ethernet MAC - Time Stamp Unit Generic Clock - No Interrupt), INSTANCE_ID_Q1=121 (GMAC1 Queue 1 Interrupt signal toggled on a DMA write to the first word of each DMA data buffer associated with queue 1)
GPBR at 0xE001D060
  parameters: GPBR_NUMBER_DIV2=2 (GPBR_NUMBER divided by 2 -1 Gallardo=1 SAM9X60=3 Mistral=11)
I2SMCC0 at 0xE161C000 (I2SMCC)
  pins: I2SMCC0_CK PB23/C set 1 or PD13/A set 2; I2SMCC0_WS PB24/C set 1 or PD15/A set 2; I2SMCC0_DOUT1 PB25/C set 1 or PD17/A set 2; I2SMCC0_DOUT0 PB26/C set 1 or PD16/A set 2; I2SMCC0_MCK PB27/C set 1 or PD14/A set 2; I2SMCC0_DIN0 PC7/A set 1 or PD8/C set 2; I2SMCC0_DIN1 PC8/A set 1 or PD9/C set 2; I2SMCC0_DOUT3 PC9/A set 1 or PD19/A set 2; I2SMCC0_DOUT2 PC10/A set 1 or PD18/A set 2; I2SMCC0_DIN2 PC22/A set 1 or PD10/C set 2; I2SMCC0_DIN3 PC23/A set 1 or PD11/C set 2
  parameters: INSTANCE_ID=57 (Inter-IC Sound Controller 0), CLOCK_ID=57, DMAC_ID_RX=33, DMAC_ID_TX=34
I2SMCC1 at 0xE1620000 (I2SMCC)
  pins: I2SMCC1_CK PC11/A set 1 or PD28/D set 2; I2SMCC1_WS PC12/A set 1 or PD29/D set 2; I2SMCC1_MCK PC13/A set 1 or PD30/D set 2; I2SMCC1_DOUT0 PC14/A set 1 or PD31/D set 2; I2SMCC1_DOUT1 PC15/A set 1 or PE0/D set 2; I2SMCC1_DOUT2 PC16/A set 1 or PE1/D set 2; I2SMCC1_DOUT3 PC17/A set 1 or PE2/D set 2; I2SMCC1_DIN0 PC18/A set 1 or PE3/D set 2; I2SMCC1_DIN1 PC19/A set 1 or PE4/D set 2; I2SMCC1_DIN2 PC20/A set 1 or PE5/D set 2; I2SMCC1_DIN3 PC21/A set 1 or PE6/D set 2
  parameters: INSTANCE_ID=58 (Inter-IC Sound Controller 1), CLOCK_ID=58, DMAC_ID_RX=35, DMAC_ID_TX=36
ICE
  pins: NTRST PC25/A set 1; TCK_SWCLK PC26/A set 1; TMS_SWDIO PC27/A set 1; TDI PC28/A set 1; TDO PC29/A set 1
ICM at 0xE081C000
  parameters: INSTANCE_ID=55 (Integrity Check Monitor), CLOCK_ID=55, INSTANCE_ID_SINT=122 (Integrity Check Monitor, Secure INTerrupt)
ISC at 0xE1408000
  pins: ISC_MCK PA15/C set 1 or PD23/E set 2; ISC_D{n} PA{n+16}/C set 1 or PD{n+24}/E set 2 (n=0..7); ISC_HSYNC PA24/C set 1 or PE0/E set 2; ISC_VSYNC PA25/C set 1 or PE1/E set 2; ISC_FIELD PA26/C set 1 or PE2/E set 2; ISC_PCK PA27/C set 1 or PE3/E set 2; ISC_D8 PA28/C set 1 or PE4/E set 2; ISC_D9 PA29/C set 1 or PE5/E set 2; ISC_D10 PA30/C set 1 or PE6/E set 2; ISC_D11 PA31/C set 1 or PE7/E set 2
  parameters: INSTANCE_ID=56 (Camera Interface), CLOCK_ID=56
MATRIX at 0xE0804000
  parameters: INSTANCE_ID=60 (HSS AHB Matrix), CLOCK_ID=60
MCAN0 at 0xE0828000 (MCAN)
  pins: CANTX0 PA9/C set 1 or PD12/D set 2; CANRX0 PA10/C set 1 or PD13/D set 2
  parameters: INSTANCE_ID=61 (Master CAN 0), CLOCK_ID=61, INSTANCE_ID_INT1=123 (MCAN0 interrupt1)
MCAN1 at 0xE082C000 (MCAN)
  pins: CANTX1 PA7/C set 1 or PD14/D set 2; CANRX1 PA8/C set 1 or PD15/D set 2
  parameters: INSTANCE_ID=62 (Master CAN 1), CLOCK_ID=62, INSTANCE_ID_INT1=124 (MCAN1 interrupt1)
MCAN2 at 0xE0830000 (MCAN)
  pins: CANTX2 PA5/C set 1 or PD16/D set 2; CANRX2 PA6/C set 1 or PD17/D set 2
  parameters: INSTANCE_ID=63 (Master CAN 2), CLOCK_ID=63, INSTANCE_ID_INT1=125 (MCAN2 interrupt1)
MCAN3 at 0xE0834000 (MCAN)
  pins: CANTX3 PA0/C set 1 or PD18/D set 2; CANRX3 PA1/C set 1 or PD19/D set 2
  parameters: INSTANCE_ID=64 (Master CAN 3), CLOCK_ID=64, INSTANCE_ID_INT1=126 (MCAN3 interrupt1)
MCAN4 at 0xE0838000 (MCAN)
  pins: CANTX4 PD2/C set 1 or PD20/D set 2; CANRX4 PD3/C set 1 or PD21/D set 2
  parameters: INSTANCE_ID=65 (Master CAN 4), CLOCK_ID=65, INSTANCE_ID_INT1=127 (MCAN4 interrupt1)
MCAN5 at 0xE083C000 (MCAN)
  pins: CANTX5 PD4/C set 1 or PD22/F set 2; CANRX5 PD5/C set 1 or PD23/F set 2
  parameters: INSTANCE_ID=66 (Master CAN 5), CLOCK_ID=66, INSTANCE_ID_INT1=128 (MCAN5 interrupt1)
NICGPV at 0xE8B00000
  parameters: AMIB_COUNT=15 (Number of AXI master interface blocks -1 SAMA7G5: 14), ASIB_COUNT=11 (Number of AXI slave interface blocks -1 SAMA7G5: 10), IB_COUNT=2 (Number of interface blocks -1 SAMA7G5: 1)
OTPC at 0xE8C00000
  parameters: INSTANCE_ID=67 (One Time Programmable memory Controller), EMULATION_ADDRESS=0xE0000000, EMULATION_SIZE=0x00001000
PDMC0 at 0xE1608000 (PDMC)
  pins: PDMC0_CLK PB9/C set 1 or PD22/A set 2; PDMC0_DS0 PB10/C set 1 or PD23/A set 2; PDMC0_DS1 PB11/C set 1 or PD24/A set 2
  parameters: INSTANCE_ID=68 (Pulse Density Modulation Interface Controller 0), CLOCK_ID=68, DMAC_ID_RX=37
PDMC1 at 0xE160C000 (PDMC)
  pins: PDMC1_CLK PA2/C set 1 or PD25/A set 2; PDMC1_DS0 PA3/C set 1 or PD26/A set 2; PDMC1_DS1 PA4/C set 1 or PD27/A set 2
  parameters: INSTANCE_ID=69 (Pulse Density Modulation Interface Controller 1), CLOCK_ID=69, DMAC_ID_RX=38
PIO at 0xE0014000
  pins: P{n} PA{n} (n=0..31); P{n} PB{n-32} (n=32..63); P{n} PC{n-64} (n=64..95); P{n} PD{n-96} (n=96..127); P{n} PE{n-128} (n=128..135)
  parameters: CLOCK_ID=11
PIOA
  parameters: INSTANCE_ID=11 (For PIO 0 to 31), INSTANCE_ID_SINT=129 (For PIO 0 to 31, Secure INTerrupt), OSR_DEFAULT_VAL=0x00000000 (Register value at reset), PSR_DEFAULT_VAL=0xFFFFFFFF (Register value at reset), PUSR_DEFAULT_VAL=0x00000000 (Register value at reset), PPDSR_DEFAULT_VAL=0xFFFFFFFF (Register value at reset), STRS_DEFAULT_VAL=0xFFFFFFFF (Register value at reset), SECRS_DEFAULT_VAL=0x00000000 (Register value at reset), FILTRS_DEFAULT_VAL=0x00000000 (Register value at reset), ABCDSR1_DEFAULT_VAL=0x00000000 (Register value at reset), ABCDSR2_DEFAULT_VAL=0x00000000 (Register value at reset), ABCDSR3_DEFAULT_VAL=0x00000000 (Register value at reset), ABCDSR4_DEFAULT_VAL=0x00000000 (Register value at reset)
PIOB
  parameters: INSTANCE_ID=12 (For PIO 32 to 63, interrupt), INSTANCE_ID_SINT=130 (For PIO 32 to 63, Secure INTerrupt), OSR_DEFAULT_VAL=0x00000000 (Register value at reset), PSR_DEFAULT_VAL=0xFFFFFFFF (Register value at reset), PUSR_DEFAULT_VAL=0x00000000 (Register value at reset), PPDSR_DEFAULT_VAL=0xFFFFFFFF (Register value at reset), STRS_DEFAULT_VAL=0xFFFFFFFF (Register value at reset), SECRS_DEFAULT_VAL=0x00000000 (Register value at reset), FILTRS_DEFAULT_VAL=0x00000000 (Register value at reset), ABCDSR1_DEFAULT_VAL=0x00000000 (Register value at reset), ABCDSR2_DEFAULT_VAL=0x00000000 (Register value at reset), ABCDSR3_DEFAULT_VAL=0x00000000 (Register value at reset), ABCDSR4_DEFAULT_VAL=0x00000000 (Register value at reset)
PIOC
  parameters: INSTANCE_ID=13 (For PIO 64 to 95, interrupt), INSTANCE_ID_SINT=131 (For PIO 64 to 95, Secure INTerrupt), OSR_DEFAULT_VAL=0x00000000 (Register value at reset), PSR_DEFAULT_VAL=0xC1FFFFFF (Register value at reset), PUSR_DEFAULT_VAL=0xE4000000 (Register value at reset), PPDSR_DEFAULT_VAL=0x3FFFFFFF (Register value at reset), STRS_DEFAULT_VAL=0xFFFFFFFF (Register value at reset), SECRS_DEFAULT_VAL=0x00000000 (Register value at reset), FILTRS_DEFAULT_VAL=0x00000000 (Register value at reset), ABCDSR1_DEFAULT_VAL=0x00000000 (Register value at reset), ABCDSR2_DEFAULT_VAL=0x00000000 (Register value at reset), ABCDSR3_DEFAULT_VAL=0x00000000 (Register value at reset), ABCDSR4_DEFAULT_VAL=0x00000000 (Register value at reset)
PIOD
  parameters: INSTANCE_ID=14 (For PIO 96 to 127, interrupt), INSTANCE_ID_SINT=132 (For PIO 96 to 127, Secure INTerrupt), OSR_DEFAULT_VAL=0x00000000 (Register value at reset), PSR_DEFAULT_VAL=0xFFFFFFFF (Register value at reset), PUSR_DEFAULT_VAL=0x00000003 (Register value at reset), PPDSR_DEFAULT_VAL=0xFFFFFFFC (Register value at reset), STRS_DEFAULT_VAL=0xFFFFFFFF (Register value at reset), SECRS_DEFAULT_VAL=0x00000000 (Register value at reset), FILTRS_DEFAULT_VAL=0x00000000 (Register value at reset), ABCDSR1_DEFAULT_VAL=0x00000000 (Register value at reset), ABCDSR2_DEFAULT_VAL=0x00000000 (Register value at reset), ABCDSR3_DEFAULT_VAL=0x00000000 (Register value at reset), ABCDSR4_DEFAULT_VAL=0x00000000 (Register value at reset)
PIOE
  parameters: INSTANCE_ID=15 (For PIO 128 to 136, interrupt), INSTANCE_ID_SINT=133 (For PIO 128 to 136, Secure INTerrupt), OSR_DEFAULT_VAL=0x00000000 (Register value at reset), PSR_DEFAULT_VAL=0xFFFFFFFF (Register value at reset), PUSR_DEFAULT_VAL=0xFFFFFF00 (Register value at reset), PPDSR_DEFAULT_VAL=0xFFFFFFFF (Register value at reset), STRS_DEFAULT_VAL=0x000000FF (Register value at reset), SECRS_DEFAULT_VAL=0x00000000 (Register value at reset), FILTRS_DEFAULT_VAL=0x00000000 (Register value at reset), ABCDSR1_DEFAULT_VAL=0x00000000 (Register value at reset), ABCDSR2_DEFAULT_VAL=0x00000000 (Register value at reset), ABCDSR3_DEFAULT_VAL=0x00000000 (Register value at reset), ABCDSR4_DEFAULT_VAL=0x00000000 (Register value at reset)
PIT64B{n} at {0xE1800000+0x4000*n} (PIT64B) (n=0..2)
  parameters: INSTANCE_ID={n+70} (64-bit Periodic Interval Timer {n}), CLOCK_ID={n+70}, INSTANCE_ID_SINT={n+135} (64-bit Periodic Interval Timer {n}, Secure INTerrupt)
PIT64B3 at 0xE2004000 (PIT64B)
  parameters: INSTANCE_ID=73 (64-bit Periodic Interval Timer 3), CLOCK_ID=73, INSTANCE_ID_SINT=138 (64-bit Periodic Interval Timer 3, Secure INTerrupt)
PIT64B4 at 0xE2008000 (PIT64B)
  parameters: INSTANCE_ID=74 (64-bit Periodic Interval Timer 4), CLOCK_ID=74, INSTANCE_ID_SINT=139 (64-bit Periodic Interval Timer 4, Secure INTerrupt)
PIT64B5 at 0xE2810000 (PIT64B)
  parameters: INSTANCE_ID=75 (64-bit Periodic Interval Timer 5), CLOCK_ID=75, INSTANCE_ID_SINT=140 (64-bit Periodic Interval Timer 5, Secure INTerrupt)
PMC at 0xE0018000
  pins: PCK2 PB3/C set 2 or PB18/C set 1; PCK3 PB4/C set 2 or PB19/C set 1; PCK4 PB5/C set 2 or PB23/F set 1; PCK5 PB6/C set 2 or PB24/F set 1; PCK0 PB16/C set 1 or PD2/B set 2 or PD20/A set 3; PCK1 PB17/C set 1 or PD12/A set 2 or PD21/A set 3; PCK6 PB25/F set 1 or PD10/B set 2; PCK7 PB26/F set 1 or PD11/B set 2
  parameters: INSTANCE_ID=10 (Power Management Controller), PMC_PROG_CLK_NB=8 (Number of PCKs in the product - 1 SAM9X60, SAM9X70: 1 SAMA7G5: 7)
PWM at 0xE1604000
  pins: PWML0 PA0/E set 3 or PB9/E set 2 or PB31/E set 1 or PD13/C set 4 or PE2/A set 5; PWMH0 PA1/E set 3 or PB10/E set 2 or PB30/E set 1 or PD14/C set 4 or PE3/A set 5; PWMH1 PA2/E set 3 or PB12/E set 2 or PC1/E set 1 or PD16/C set 4 or PE5/A set 5; PWML3 PA3/E set 3 or PB15/E set 2 or PC4/E set 1 or PD19/C set 4 or PD28/F set 5; PWMH3 PA4/E set 3 or PB16/E set 2 or PC5/E set 1 or PD20/C set 4 or PD29/F set 5; PWMEXTRG0 PA5/E set 3 or PB17/E set 2 or PB26/E set 1 or PD22/C set 4 or PD30/F set 5; PWMEXTRG1 PA6/E set 3 or PB18/E set 2 or PB27/E set 1 or PD23/C set 4 or PD31/F set 5; PWMFI0 PA7/E set 3 or PB19/E set 2 or PB28/E set 1 or PD24/C set 4 or PE0/F set 5; PWMFI1 PA8/E set 3 or PB20/E set 2 or PB29/E set 1 or PD25/C set 4 or PE1/F set 5; PWML2 PA12/E set 3 or PB13/E set 2 or PC2/E set 1 or PD17/C set 4 or PE6/A set 5; PWMH2 PA13/E set 3 or PB14/E set 2 or PC3/E set 1 or PD18/C set 4 or PE7/A set 5; PWML1 PA14/E set 3 or PB11/E set 2 or PC0/E set 1 or PD15/C set 4 or PE4/A set 5
  parameters: INSTANCE_ID=77 (Pulse Width Modulation), CLOCK_ID=77, DMAC_ID_TX=39
QSPI0 at 0xE080C000 (QSPI)
  pins: QSPI0_IO3 PB9/A set 1; QSPI0_IO2 PB10/A set 1; QSPI0_IO1 PB11/A set 1; QSPI0_IO0 PB12/A set 1; QSPI0_CS PB13/A set 1; QSPI0_SCK PB14/A set 1; QSPI0_SCKN PB15/A set 1; QSPI0_IO4 PB16/A set 1; QSPI0_IO5 PB17/A set 1; QSPI0_IO6 PB18/A set 1; QSPI0_IO7 PB19/A set 1; QSPI0_DQS PB20/A set 1; QSPI0_INT PB21/A set 1
  parameters: INSTANCE_ID=78 (Quad IO Serial Peripheral Interface 0), CLOCK_ID=78, DMAC_ID_RX=40, DMAC_ID_TX=41
QSPI1 at 0xE0810000 (QSPI)
  pins: QSPI1_IO3 PB22/A set 1; QSPI1_IO2 PB23/A set 1; QSPI1_IO1 PB24/A set 1; QSPI1_IO0 PB25/A set 1; QSPI1_CS PB26/A set 1; QSPI1_SCK PB27/A set 1
  parameters: INSTANCE_ID=79 (Quad IO Serial Peripheral Interface 1), CLOCK_ID=79, DMAC_ID_RX=42, DMAC_ID_TX=43
RSTC at 0xE001D000
  parameters: INSTANCE_ID=6 (Reset Controller)
RTC at 0xE001D0A8
  parameters: INSTANCE_ID=7 (Real-Time Clock)
RTT at 0xE001D020
  parameters: INSTANCE_ID=8 (Real-Time Timer)
SCKC at 0xE001D050
  parameters: INSTANCE_ID=4 (Slow Clock Controller)
SDMMC0 at 0xE1204000 (SDMMC)
  pins: SDMMC0_CK PA0/A set 1; SDMMC0_CMD PA1/A set 1; SDMMC0_RSTN PA2/A set 1; SDMMC0_DAT{n} PA{n+3}/A set 1 (n=0..7); SDMMC0_DS PA11/A set 1; SDMMC0_WP PA12/A set 1; SDMMC0_1V8SEL PA13/A set 1; SDMMC0_CD PA14/A set 1
  parameters: INSTANCE_ID=80 (Ultra High Speed SD Host controller 0 (eMMC 5.1)), CLOCK_ID=80, INSTANCE_ID_TIMER=141 (Ultra High Speed SD Host controller 0 (eMMC 5.1) Timer interrupt)
SDMMC1 at 0xE1208000 (SDMMC)
  pins: SDMMC1_RSTN PB28/A set 1; SDMMC1_CMD PB29/A set 1; SDMMC1_CK PB30/A set 1; SDMMC1_DAT0 PB31/A set 1; SDMMC1_DAT1 PC0/A set 1; SDMMC1_DAT2 PC1/A set 1; SDMMC1_DAT3 PC2/A set 1; SDMMC1_WP PC3/A set 1; SDMMC1_CD PC4/A set 1; SDMMC1_1V8SEL PC5/A set 1
  parameters: INSTANCE_ID=81 (Ultra High Speed SD Host controller 1 (eMMC 4.51)), CLOCK_ID=81, INSTANCE_ID_TIMER=142 (Ultra High Speed SD Host controller 1 (eMMC 4.51) Timer interrupt)
SDMMC2 at 0xE120C000 (SDMMC)
  pins: SDMMC2_RSTN PD2/A set 1; SDMMC2_CMD PD3/A set 1; SDMMC2_CK PD4/A set 1; SDMMC2_DAT0 PD5/A set 1; SDMMC2_DAT1 PD6/A set 1; SDMMC2_DAT2 PD7/A set 1; SDMMC2_DAT3 PD8/A set 1; SDMMC2_WP PD9/A set 1; SDMMC2_CD PD10/A set 1; SDMMC2_1V8SEL PD11/A set 1
  parameters: INSTANCE_ID=82 (Ultra High Speed SD Host controller 2 (eMMC 4.51)), CLOCK_ID=82, INSTANCE_ID_TIMER=143 (Ultra High Speed SD Host controller 2 (eMMC 4.51) Timer interrupt)
SECUMOD at 0xE0004000
  parameters: INSTANCE_ID=17 (Security Module)
SECURAM
  parameters: INSTANCE_ID=18 (Secret RAM)
SFR at 0xE1624000
  parameters: INSTANCE_ID=19 (Special Function Register), CLOCK_ID=19
SFRBU at 0xE0008000
  parameters: INSTANCE_ID=20 (Special Function Register in BackUp zone)
SHA at 0xE1814000
  parameters: INSTANCE_ID=83 (Secure Hash Algorithm), CLOCK_ID=83, INSTANCE_ID_SINT=144 (Secure Hash Algorithm, Secure INTerrupt), DMAC_ID_TX=48
SHDWC at 0xE001D010
  parameters: INSTANCE_ID=5 (SHutDoWn Controller)
HSMC at 0xE0808000 (SMC)
  parameters: INSTANCE_ID=21 (Static Memory Controller - NAND Flash Controller), CLOCK_ID=21
SPDIFRX at 0xE1614000
  pins: SPDIF_RX PA9/E set 1 or PB0/E set 2 or PD6/C set 3
  parameters: INSTANCE_ID=84 (Sony Philips Digital Interface RX), CLOCK_ID=84, DMAC_ID_RX=49
SPDIFTX at 0xE1618000
  pins: SPDIF_TX PA10/E set 1 or PB1/E set 2 or PD7/C set 3
  parameters: INSTANCE_ID=85 (Sony Philips Digital Interface TX), CLOCK_ID=85, DMAC_ID_TX=50
SSC0 at 0xE180C000 (SSC)
  pins: TF0 PA26/E set 1 or PE0/A set 2; TK0 PA27/E set 1 or PE1/A set 2; RD0 PA28/E set 1 or PD28/A set 2; RF0 PA29/E set 1 or PD29/A set 2; RK0 PA30/E set 1 or PD30/A set 2; TD0 PA31/E set 1 or PD31/A set 2
  parameters: INSTANCE_ID=86 (Synchronous Serial Interface 0), CLOCK_ID=86, DMAC_ID_RX=44, DMAC_ID_TX=45
SSC1 at 0xE200C000 (SSC)
  pins: RF1 PB3/A set 1 or PD23/D set 2; TF1 PB4/A set 1 or PD26/D set 2; TK1 PB5/A set 1 or PD27/D set 2; RK1 PB6/A set 1 or PD24/D set 2; TD1 PB7/A set 1 or PD25/D set 2; RD1 PB8/A set 1 or PD22/D set 2
  parameters: INSTANCE_ID=87 (Synchronous Serial Interface 1), CLOCK_ID=87, DMAC_ID_RX=46, DMAC_ID_TX=47
SYSCWP at 0xE001D0DC
TC0 at 0xE2814000 (TC)
  pins: TIOA0 PA11/E set 1 or PD2/E set 2 or PD27/C set 3; TIOB0 PA15/E set 1 or PD3/E set 2 or PD28/C set 3; TCLK0 PA16/E set 1 or PD4/E set 2 or PD29/C set 3; TIOA1 PA17/E set 1 or PD5/E set 2 or PD30/C set 3; TIOB1 PA18/E set 1 or PD6/E set 2 or PD31/C set 3; TCLK1 PA19/E set 1 or PD7/E set 2 or PE0/C set 3; TIOA2 PA20/E set 1 or PD8/E set 2 or PE1/C set 3; TIOB2 PA21/E set 1 or PD9/E set 2 or PE2/C set 3; TCLK2 PA22/E set 1 or PD10/E set 2 or PE3/C set 3
  parameters: INSTANCE_ID_CHANNEL0=88 (32-bit Timer Counter 0 Channel 0), CLOCK_ID_CHANNEL0=88, INSTANCE_ID_CHANNEL1=89 (32-bit Timer Counter 0 Channel 1 interrupt), CLOCK_ID_CHANNEL1=89, INSTANCE_ID_CHANNEL2=90 (32-bit Timer Counter 0 Channel 2 interrupt), CLOCK_ID_CHANNEL2=90, INSTANCE_ID_SINT0=145 (32-bit Timer Counter 0 Channel 0, Secure INTerrupt), INSTANCE_ID_SINT1=146 (32-bit Timer Counter 0 Channel 1, Secure INTerrupt), INSTANCE_ID_SINT2=147 (32-bit Timer Counter 0 Channel 2), DMAC_ID_RX=51, TCCLKS_=0 (MCK1), TCCLKS_TIMER_CLOCK1=1 (GCLK), TCCLKS_TIMER_CLOCK2=2 (MCK1/8), TCCLKS_TIMER_CLOCK3=3 (MCK1/32), TCCLKS_TIMER_CLOCK4=4 (MCK1/128), TCCLKS_TIMER_CLOCK5=5 (TD_SLCK), TCCLKS_XC0=6 (XC0), TCCLKS_XC1=7 (XC1), TCCLKS_XC2=8 (XC2), NUM_INTERRUPT_LINES=3, TIMER_WIDTH=32
TC1 at 0xE0800000 (TC)
  pins: TIOA0 PB29/D set 1 or PD11/E set 2 or PE4/C set 3; TIOB0 PB30/D set 1 or PD12/E set 2 or PE5/C set 3; TCLK0 PB31/D set 1 or PD13/E set 2 or PE6/C set 3; TIOA1 PC0/D set 1 or PD14/E set 2 or PE7/C set 3; TIOB1 PC1/D set 1 or PD15/E set 2; TCLK1 PC2/D set 1 or PD16/E set 2; TIOA2 PC3/D set 1 or PD17/E set 2; TIOB2 PC4/D set 1 or PD18/E set 2; TCLK2 PC5/D set 1 or PD19/E set 2
  parameters: INSTANCE_ID_CHANNEL0=91 (32-bit Timer Counter 1 Channel 0), CLOCK_ID_CHANNEL0=91, INSTANCE_ID_CHANNEL1=92 (32-bit Timer Counter 1 Channel 1 interrupt), CLOCK_ID_CHANNEL1=92, INSTANCE_ID_CHANNEL2=93 (32-bit Timer Counter 1 Channel 2 interrupt), CLOCK_ID_CHANNEL2=93, INSTANCE_ID_SINT0=148 (32-bit Timer Counter 1 Channel 0, Secure INTerrupt), INSTANCE_ID_SINT1=149 (32-bit Timer Counter 1 Channel 1, Secure INTerrupt), INSTANCE_ID_SINT2=150 (32-bit Timer Counter 1 Channel 2, Secure INTerrupt), DMAC_ID_RX=52, TCCLKS_=0 (MCK1), TCCLKS_TIMER_CLOCK1=1 (GCLK), TCCLKS_TIMER_CLOCK2=2 (MCK1/8), TCCLKS_TIMER_CLOCK3=3 (MCK1/32), TCCLKS_TIMER_CLOCK4=4 (MCK1/128), TCCLKS_TIMER_CLOCK5=5 (TD_SLCK), TCCLKS_XC0=6 (XC0), TCCLKS_XC1=7 (XC1), TCCLKS_XC2=8 (XC2), NUM_INTERRUPT_LINES=3, TIMER_WIDTH=32
TCPCA at 0xE0840000 (TCPC)
  parameters: INSTANCE_ID=94 (USB Type-C Port Controller A), CLOCK_ID=94
TCPCB at 0xE0844000 (TCPC)
  parameters: INSTANCE_ID=95 (USB Type-C Port Controller B), CLOCK_ID=95
TDES at 0xE2014000
  parameters: INSTANCE_ID=96 (Triple Data Encryption System), CLOCK_ID=96, INSTANCE_ID_SINT=151 (Triple Data Encryption System, Secure INTerrupt), DMAC_ID_RX=53, DMAC_ID_TX=54
TRNG at 0xE2010000
  parameters: INSTANCE_ID=97 (True Random Number Generator), CLOCK_ID=97, INSTANCE_ID_SINT=152 (True Random Number Generator, Secure INTerrupt)
TZAESB
  parameters: INSTANCE_ID_NS=98 (TrustZone Advanced Encryption Standard Bridge Non-Secure (Clocks & Interrupt)), CLOCK_ID_NS=98, INSTANCE_ID_NS_SINT=99 (TrustZone Advanced Encryption Standard Bridge Non-Secure (Interrupt only)), INSTANCE_ID_S=100 (TrustZone Advanced Encryption Standard Bridge Secure), INSTANCE_ID_S_SINT=101 (TrustZone Advanced Encryption Standard Bridge Secure (Interrupt only))
TZAESBNS at 0xE0820000 (TZAESB)
TZAESBS at 0xE0824000 (TZAESB)
TZAESBASC at 0xE2000000
  parameters: INSTANCE_ID=28 (TrustZone Advanced Encryption Standard Bridge - Address Space Controlller), CLOCK_ID=28
TZC at 0xE3000000
  parameters: INSTANCE_ID=102 (TrustZone Address Space Controller (TZC-400))
TZPM at 0xE0010000
  parameters: INSTANCE_ID=103 (TrustZone Peripheral Manager)
DDRUMCTL at 0xE3800000 (UDDRC)
  parameters: INSTANCE_ID=36 (Enhanced Universal DDR-SDRAM Memory Controller)
UDPHSA at 0xE0814000 (UDPHS)
  parameters: INSTANCE_ID=104 (USB Device High Speed A), CLOCK_ID=104
UDPHSB at 0xE0818000 (UDPHS)
  parameters: INSTANCE_ID=105 (USB Device High Speed B), CLOCK_ID=105
UHPHS_OHCI at 0x00400000 (UHPFS)
UHPHS
  parameters: INSTANCE_ID=106 (USB Host Controller High Speed), CLOCK_ID=106
UHPHS_EHCI at 0x00500000 (UHPHS)
XDMAC0 at 0xE2808000 (XDMAC)
  parameters: INSTANCE_ID=22 (DMA 0, mem to periph, 32 Channels), CLOCK_ID=22, INSTANCE_ID_SINT=112 (DMA 0, mem to periph, 32 Channels, Secure INTerrupt)
XDMAC1 at 0xE280C000 (XDMAC)
  parameters: INSTANCE_ID=23 (DMA 1, mem to periph, 32 Channels), CLOCK_ID=23, INSTANCE_ID_SINT=113 (DMA 1, mem to periph, 32 Channels, Secure INTerrupt)
XDMAC2 at 0xE1200000 (XDMAC)
  parameters: INSTANCE_ID=24 (DMA 2, mem to mem, 4 Channels), CLOCK_ID=24, INSTANCE_ID_SINT=114 (DMA 2, mem to mem, 4 Channels, Secure INTerrupt)

## Interrupts
{n} SGI{n} (ARM) (n=0..15) — Software Generated Interrupt {n}
25 VirtMaint (ARM) — Virtual Maintenance Interrupt (PPI6)
26 HyperVTimer (ARM) — Hypervisor Timer event (PPI5)
27 VirtTimer (ARM) — Virtual Timer event (PPI4)
28 LegacynFIQ (ARM) — Legacy nFIQ signal (PPI0)
29 SecPhysTimer (ARM) — Secure Physical Timer event (PPI1)
30 NonSecPhysTimer (ARM) — Non-secure Physical Timer event (PPI2)
31 LegacynIRQ (ARM) — Legacy nIRQ signal (PPI3)
32 DWDT_SW (DWDT) — Dual Watchdog Timer, Secure World
33 DWDT_NSW (DWDT) — Dual Watchdog Timer, Non Secure World, interrupt
34 DWDT_NSW_ALARM (DWDT) — Dual Watchdog Timer, Non Secure World Alarm, interrupt
36 SCKC — Slow Clock Controller
37 SHDWC — SHutDoWn Controller
38 RSTC — Reset Controller
39 RTC — Real-Time Clock
40 RTT — Real-Time Timer
42 PMC — Power Management Controller
43 PIOA — For PIO 0 to 31
44 PIOB — For PIO 32 to 63, interrupt
45 PIOC — For PIO 64 to 95, interrupt
46 PIOD — For PIO 96 to 127, interrupt
47 PIOE — For PIO 128 to 136, interrupt
49 SECUMOD — Security Module
50 SECURAM — Secret RAM
51 SFR — Special Function Register
53 HSMC — Static Memory Controller - NAND Flash Controller
54 XDMAC0 — DMA 0, mem to periph, 32 Channels
55 XDMAC1 — DMA 1, mem to periph, 32 Channels
56 XDMAC2 — DMA 2, mem to mem, 4 Channels
57 ACC — Analog Comparator Controller
58 ADC — Analog-to-Digital Converter
59 AES — Advanced Encryption Standard
61 ARM — Cortex-A7 Core0 interrupt
62 ASRC — Asynchronous Sample Rate Converter
64 CPKCC — Classic Public Key Cryptography Controller
65 CSI — Camera Serial Interface 2 between ISC and MIPI PHY
66 CSI2DC — CSI to Demultiplexer Controller
{n+70} FLEXCOM{n} (n=0..11)
83 GMAC0 — Gigabit Ethernet MAC
84 GMAC1 — Ethernet MAC
85 GMAC0_TSU (GMAC0) — Gigabit Ethernet MAC - Time Stamp Unit Generic Clock - No Interrupt
86 GMAC1_TSU (GMAC1) — Ethernet MAC - Time Stamp Unit Generic Clock - No Interrupt
87 ICM — Integrity Check Monitor
88 ISC — Camera Interface
89 I2SMCC0 — Inter-IC Sound Controller 0
90 I2SMCC1 — Inter-IC Sound Controller 1
92 MATRIX — HSS AHB Matrix
93 MCAN0_INT0 (MCAN0) — Master CAN 0
94 MCAN1_INT0 (MCAN1) — Master CAN 1
95 MCAN2_INT0 (MCAN2) — Master CAN 2
96 MCAN3_INT0 (MCAN3) — Master CAN 3
97 MCAN4_INT0 (MCAN4) — Master CAN 4
98 MCAN5_INT0 (MCAN5) — Master CAN 5
99 OTPC — One Time Programmable memory Controller
100 PDMC0 — Pulse Density Modulation Interface Controller 0
101 PDMC1 — Pulse Density Modulation Interface Controller 1
102 PIT64B0 — 64-bit Periodic Interval Timer 0
103 PIT64B1 — 64-bit Periodic Interval Timer 1
104 PIT64B2 — 64-bit Periodic Interval Timer 2
105 PIT64B3 — 64-bit Periodic Interval Timer 3
106 PIT64B4 — 64-bit Periodic Interval Timer 4
107 PIT64B5 — 64-bit Periodic Interval Timer 5
109 PWM — Pulse Width Modulation
110 QSPI0 — Quad IO Serial Peripheral Interface 0
111 QSPI1 — Quad IO Serial Peripheral Interface 1
112 SDMMC0 — Ultra High Speed SD Host controller 0 (eMMC 5.1)
113 SDMMC1 — Ultra High Speed SD Host controller 1 (eMMC 4.51)
114 SDMMC2 — Ultra High Speed SD Host controller 2 (eMMC 4.51)
115 SHA — Secure Hash Algorithm
116 SPDIFRX — Sony Philips Digital Interface RX
117 SPDIFTX — Sony Philips Digital Interface TX
118 SSC0 — Synchronous Serial Interface 0
119 SSC1 — Synchronous Serial Interface 1
120 TC0_CH0 (TC0) — 32-bit Timer Counter 0 Channel 0 interrupt
121 TC0_CH1 (TC0) — 32-bit Timer Counter 0 Channel 1 interrupt
122 TC0_CH2 (TC0) — 32-bit Timer Counter 0 Channel 2 interrupt
123 TC1_CH0 (TC1) — 32-bit Timer Counter 1 Channel 0 interrupt
124 TC1_CH1 (TC1) — 32-bit Timer Counter 1 Channel 1 interrupt
125 TC1_CH2 (TC1) — 32-bit Timer Counter 1 Channel 2 interrupt
126 TCPCA — USB Type-C Port Controller A
127 TCPCB — USB Type-C Port Controller B
128 TDES — Triple Data Encryption System
129 TRNG — True Random Number Generator
130 TZAESB_NS (TZAESB) — TrustZone Advanced Encryption Standard Bridge Non-Secure (Clocks & Interrupt)
131 TZAESB_NS_SINT (TZAESB) — TrustZone Advanced Encryption Standard Bridge Non-Secure (Interrupt only)
132 TZAESB_S (TZAESB) — TrustZone Advanced Encryption Standard Bridge Secure
133 TZAESB_S_SINT (TZAESB) — TrustZone Advanced Encryption Standard Bridge Secure (Interrupt only)
134 TZC — TrustZone Address Space Controller (TZC-400)
135 TZPM — TrustZone Peripheral Manager
136 UDPHSA — USB Device High Speed A
137 UDPHSB — USB Device High Speed B
138 UHPHS — USB Host Controller High Speed
142 ARM_NPMUIRQ (ARM) — Performance Monitoring Unit interrupt
143 ARM_NAXIERRIRQ (ARM) — AXI transaction error interrupt
144 XDMAC0_SINT (XDMAC0) — DMA 0, mem to periph, 32 Channels, Secure INTerrupt
145 XDMAC1_SINT (XDMAC1) — DMA 1, mem to periph, 32 Channels, Secure INTerrupt
146 XDMAC2_SINT (XDMAC2) — DMA 2, mem to mem, 4 Channels, Secure INTerrupt
147 AES_SINT (AES) — Advanced Encryption Standard, Secure INTerrupt
148 GMAC0_Q1 (GMAC0) — GMAC0 Queue 1 Interrupt signal toggled on a DMA write to the first word of each DMA data buffer associated with queue 1
149 GMAC0_Q2 (GMAC0) — GMAC0 Queue 2 Interrupt signal toggled on a DMA write to the first word of each DMA data buffer associated with queue 2
150 GMAC0_Q3 (GMAC0) — GMAC0 Queue 3 Interrupt signal toggled on a DMA write to the first word of each DMA data buffer associated with queue 3
151 GMAC0_Q4 (GMAC0) — GMAC0 Queue 4 Interrupt signal toggled on a DMA write to the first word of each DMA data buffer associated with queue 4
152 GMAC0_Q5 (GMAC0) — GMAC0 Queue 5 Interrupt signal toggled on a DMA write to the first word of each DMA data buffer associated with queue 5
153 GMAC1_Q1 (GMAC1) — GMAC1 Queue 1 Interrupt signal toggled on a DMA write to the first word of each DMA data buffer associated with queue 1
154 ICM_SINT (ICM) — Integrity Check Monitor, Secure INTerrupt
155 MCAN0_INT1 (MCAN0) — MCAN0 interrupt1
156 MCAN1_INT1 (MCAN1) — MCAN1 interrupt1
157 MCAN2_INT1 (MCAN2) — MCAN2 interrupt1
158 MCAN3_INT1 (MCAN3) — MCAN3 interrupt1
159 MCAN4_INT1 (MCAN4) — MCAN4 interrupt1
160 MCAN5_INT1 (MCAN5) — MCAN5 interrupt1
161 PIOA_SINT (PIOA) — For PIO 0 to 31, Secure INTerrupt
162 PIOB_SINT (PIOB) — For PIO 32 to 63, Secure INTerrupt
163 PIOC_SINT (PIOC) — For PIO 64 to 95, Secure INTerrupt
164 PIOD_SINT (PIOD) — For PIO 96 to 127, Secure INTerrupt
165 PIOE_SINT (PIOE) — For PIO 128 to 136, Secure INTerrupt
167 PIT64B0_SINT (PIT64B0) — 64-bit Periodic Interval Timer 0, Secure INTerrupt
168 PIT64B1_SINT (PIT64B1) — 64-bit Periodic Interval Timer 1, Secure INTerrupt
169 PIT64B2_SINT (PIT64B2) — 64-bit Periodic Interval Timer 2, Secure INTerrupt
170 PIT64B3_SINT (PIT64B3) — 64-bit Periodic Interval Timer 3, Secure INTerrupt
171 PIT64B4_SINT (PIT64B4) — 64-bit Periodic Interval Timer 4, Secure INTerrupt
172 PIT64B5_SINT (PIT64B5) — 64-bit Periodic Interval Timer 5, Secure INTerrupt
173 SDMMC0_TIMER (SDMMC0) — Ultra High Speed SD Host controller 0 (eMMC 5.1) Timer interrupt
174 SDMMC1_TIMER (SDMMC1) — Ultra High Speed SD Host controller 1 (eMMC 4.51) Timer interrupt
175 SDMMC2_TIMER (SDMMC2) — Ultra High Speed SD Host controller 2 (eMMC 4.51) Timer interrupt
176 SHA_SINT (SHA) — Secure Hash Algorithm, Secure INTerrupt
177 TC0_SINT0 (TC0) — 32-bit Timer Counter 0 Channel 0, Secure INTerrupt
178 TC0_SINT1 (TC0) — 32-bit Timer Counter 0 Channel 1, Secure INTerrupt
179 TC0_SINT2 (TC0) — 32-bit Timer Counter 0 Channel 2
180 TC1_SINT0 (TC1) — 32-bit Timer Counter 1 Channel 0, Secure INTerrupt
181 TC1_SINT1 (TC1) — 32-bit Timer Counter 1 Channel 1, Secure INTerrupt
182 TC1_SINT2 (TC1) — 32-bit Timer Counter 1 Channel 2, Secure INTerrupt
183 TDES_SINT (TDES) — Triple Data Encryption System, Secure INTerrupt
184 TRNG_SINT (TRNG) — True Random Number Generator, Secure INTerrupt
185 EIC_EXT_IRQ0 (EIC) — External Interrupt controller, External Interrupt ID0
186 EIC_EXT_IRQ1 (EIC) — External Interrupt controller, External Interrupt ID1

## Properties
SIGNATURES: JTAGID=0x05B4203F, CHIPID_CIDR=0x80162110, CHIPID_EXID=0x00000018
NAMING_RULES: SUBSTRUCTURE_PREFIX=true

## Pinouts (pin number, pad)
TFBGA427: AA1 GND, AA10 PA13, AA11 PA14, AA12 PA20, AA13 PA22, AA14 PA26, AA15 PA27, AA16 PA29, AA17 PA31, AA18 PB1, AA19 PB3, AA20 MIPI_DP1, AA21 MIPI_CLKP, AA22 MIPI_DP0, AA23 MIPI_REXT, AA25 GND, AA3 DDRM_VDD_1, AA4 GND, AA5 DDRM_VDD_2, AA6 GND, AA7 DDRM_VDD_3, AA8 GND, AA9 XOUT32, A1 GND, A3 PC30, A4 DDRM_VDD, A5 PC23, A6 PC22, A7 PC20, A8 PC18, A9 PC16, A10 HHSA_RTUNE, A11 HHSA_DP, A12 HHSB_RTUNE, A13 HHSB_DP, A14 HHSC_RTUNE, A15 HHSC_DP, A16 PB30, A17 PC1, A18 PC0, A19 PB29, A20 PD3, A21 PE6, A22 PE5, A23 PE2, A25 GND, B1 PD0, B2 GND, B4 PC12, B5 PC27, B6 DDRM_VDD_4, B7 PC29, B8 VDDUTMI, B9 NRST_OUT, B10 VDDUTMI, B11 HHSA_DM, B12 VDDUTMI, B13 HHSB_DM, B14 VDDUTMI, B15 HHSC_DM, B16 GND, B17 PC2, B18 VDDSDMMC1, B19 PB31, B20 SDMMC2_CAL, B21 PE4, B22 PE3, B24 GND, B25 PD27, C1 XOUT, C2 XIN, C3 GND, C5 PC9, C7 PC5, C9 PC21, C11 PC24, C13 HHSA_CC1, C15 HHSB_CC1, C17 PB28, C19 PD5, C21 PD28, C23 GND, C24 PD29, C25 PD24, D1 PC8, D2 PC3, D4 GND, D7 PC25, D9 VREFP, D11 PC31, D13 PC13, D15 HHSA_CC2, D17 HHSB_CC2, D19 PD4, D20 GND, D22 GND, D24 VDDSDMMC2, D25 PE0, E1 DDRM_VDD_5, E2 GND, E3 DDRM_VDD_6, E4 DDR_VREF, E5 GND, E7 DDRM_VDD_7, E8 GNDUTMI, E9 DDRM_VDD_8, E10 GNDUTMI, E11 PC26, E12 GNDUTMI, E13 PC19, E14 GNDUTMI, E15 PC14, E16 GNDANA, E17 PD8, E18 GND, E19 PD2, E21 GND, E22 PD30, E23 PD26, E24 PD31, E25 PD20, F1 GND, F2 DDRM_VDD_9, F5 DDRM_VDD_10, F6 DDRM_VDD_11, F8 DDRM_VDD_12, F9 GND, F10 VDDANA, F11 PC11, F12 VDDANA, F13 PD1, F14 VDDIN33, F15 PC17, F16 VDDUTMI, F17 PD7, F18 SDMMC1_CAL, F20 GND, F21 VDDCPU, F24 VDDIOP1, F25 PD18, G1 DDRM_VDD_13, G2 GND, G3 GND, G4 DDRM_ZQ, G5 GND, G6 DDRM_VDD_14, G7 GND, G9 GND, G11 VDDCORE, G13 NRST, G15 PC15, G17 PD6, G19 VDDCPU, G20 PE7, G21 PE1, G22 PD23, G23 PD25, G24 PD22, G25 PD16, H1 GND, H2 DDRM_VDD_15, H5 GND, H6 DDRM_VDD_16, H8 GND, H10 GNDANA, H11 PC6, H12 VDDCORE, H13 PC4, H14 GNDANA, H15 PC28, H16 GNDIN33, H18 GNDUTMI, H20 VDDCPU, H21 GND, H24 VDDIOP1, H25 PD11, J1 GND, J2 DDRM_VDD_17, J3 GND, J4 DDRM_VDD_18, J5 GND, J6 DDRM_VDD_19, J7 GND, J9 GND, J10 GND, J11 AUDIOCLK, J12 DDR_ZQ, J13 PC7, J14 PC10, J15 VDDOUT25, J16 GND, J17 VDDCORE, J18 PD15, J19 VDDCPU, J20 PD17, J21 PD19, J22 PD21, J23 PD14, J24 PD10, J25 PD9, K1 DDRM_VDD_20, K2 GND, K5 DDRM_VDD_21, K6 DDRM_VDD_22, K7 DDRM_VDD_23, K8 GND, K9 DDRM_VDD_24, K10 GND, K11 GND, K12 VDDIODDR, K13 GND, K14 VDDIODDR, K15 GND, K16 VBAT, K17 VDDCORE, K18 VDDCPU, K19 PD13, K20 VDDCORE, K21 GND, K24 VDDQSPI1, K25 PB23, L1 GND, L2 DDRM_VDD_25, L3 GND, L4 DDRM_VDD_26, L5 GND, L6 DDRM_VDD_27, L7 GND, L8 GND, L9 VDDIODDR, L10 VDDIODDR, L11 VDDIODDR, L12 GND, L13 VDDCORE, L14 GND, L15 VDDIODDR, L16 GND, L17 GND, L18 GND, L19 PD12, L20 PB22, L21 PB27, L22 PB25, L23 PB24, L24 PB26, L25 PA9, M1 DDRM_VDD_28, M2 GND, M5 GND, M6 GND, M7 DDRM_VDD_29, M8 GND, M9 VDDIODDR, M10 VDDIODDR, M11 GND, M12 VDDCORE, M13 GND, M14 VDDIODDR, M15 GND, M16 VDDIODDR, M17 GND, M18 GND, M19 PA10, M20 SDMMC0_CAL, M21 GND, M24 VDDSDMMC0, M25 PA8, N1 GND, N2 GND, N3 DDRM_VDD_30, N4 GND, N5 DDRM_VDD_31, N6 DDRM_VDD_32, N7 GND, N8 DDRM_VDD_33, N9 GND, N10 GND, N11 VDDIODDR, N12 GND, N13 VDDIODDR, N14 GND, N15 VDDIODDR, N16 GNDBAT, N17 VDDCORE, N18 GND, N19 VDDCORE, N20 PA4, N21 PA7, N22 PA6, N23 PA0, N24 PA5, N25 PA11, P1 DDRM_VDD_34, P2 GND, P5 GND, P6 DDRM_VDD_35, P8 GND, P10 VDDIODDR, P11 GND, P12 VDDIODDR, P13 GND, P14 VDDIODDR, P15 LPM, P16 PA12, P18 GND, P20 VDDQSPI0, P21 VDDCORE, P24 GND, P25 PA1, R1 GND, R2 DDRM_VDD_36, R3 GND, R4 DDRM_VDD_37, R5 DDRM_VDD_38, R6 GND, R7 GND, R9 DDRM_VDD_39, R10 GND, R11 GND, R12 DDR_VREF_1, R13 VDDIODDR, R15 SHDN, R17 QSPI0_CAL, R19 GND, R20 PB10, R21 PB19, R22 PA2, R23 PB18, R24 PA3, R25 PB21, T1 DDRM_VDD_40, T2 GND, T5 GND, T6 DDRM_VDD_41, T8 DDRM_VDD_42, T9 GND, T10 DDRM_VDD_43, T11 GND, T12 GND, T13 JTAGSEL, T14 VDDCORE, T15 PIOBU1, T16 VDDCORE, T17 PA28, T18 PB0, T20 VDDDPHY, T21 GND, T24 VDDCORE, T25 PB17, U1 GND, U2 DDRM_VDD_44, U3 GND, U4 DDRM_VDD_45, U5 DDRM_VDD_46, U7 DDRM_VDD_47, U8 GND, U9 DDRM_VDD_48, U10 GND, U11 TST, U12 GND, U13 PIOBU3, U14 GND, U15 PA21, U16 GND, U17 PA19, U18 GND, U19 PB4, U21 VDDDPHY, U22 PB13, U23 PB16, U24 PB20, U25 PB11, V1 DDRM_VDD_49, V2 GND, V4 GND, V6 DDRM_VDD_50, V7 GND, V9 GND, V11 PIOBU2, V13 PIOBU0, V15 PA15, V17 PA25, V19 VDDCORE, V20 GNDDPHY, V22 GNDDPHY, V24 GND, V25 PB12, W1 GND, W2 DDRM_VDD_51, W3 GND, W5 GND, W6 DDRM_VDD_52, W7 DDRM_VDD_53, W9 DDRM_VDD_54, W11 GND, W13 PA17, W15 PA23, W17 PB7, W19 PB5, W20 PB6, W21 PB8, W23 GND, W24 PB15, W25 PB14, Y1 DDRM_VDD_55, Y2 GND, Y4 DDRM_VDD_56, Y5 GND, Y6 DDRM_VDD_57, Y7 GND, Y8 DDRM_VDD_58, Y9 XIN32, Y10 GND, Y11 WKUP0, Y12 GND, Y13 PA18, Y14 PA30, Y15 PA16, Y16 VDDIOP0, Y17 PA24, Y18 VDDIOP0, Y19 PB2, Y20 MIPI_DN1, Y21 MIPI_CLKN, Y22 MIPI_DN0, Y24 GND, Y25 PB9

## Notices in the file
Copyright (c) 2020 Microchip Technology Inc.
SPDX-License-Identifier: Apache-2.0
Licensed under the Apache License, Version 2.0 (the "License");
you may not use this file except in compliance with the License.
You may obtain a copy of the License at
http://www.apache.org/licenses/LICENSE-2.0
Unless required by applicable law or agreed to in writing, software
distributed under the License is distributed on an "AS IS" BASIS,
WITHOUT WARRANTIES OR CONDITIONS OF ANY KIND, either express or implied.
See the License for the specific language governing permissions and
limitations under the License.
