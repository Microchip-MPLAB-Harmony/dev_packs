# ATSAMA5D27CLD1G register map
Vendor: Microchip Technology; Series: SAMA5D2; File version: 0
Microchip ATSAMA5D27CLD1G Microcontroller
Registers are 32-bit, read-write, reset 0x0 unless marked. A register's access mark holds for its fields unless they carry their own. Offsets are from the block's base; lines under a group give offsets from that group; [hi:lo] are bit positions; {n}, {i} and the like mark numbered series; 'fields as' and 'values as' point back to an identical list; <NAME> marks a mode.

## Memory map
0x00600000 AXIMX size 0x4 — AXI Matrix
0x00A00000 L2CC size 0xF84 — L2 Cache Controller
0xA0000000 SDMMC0 size 0x244 — Secure Digital MultiMedia Card Controller
0xB0000000 SDMMC1 size 0x244
0xF0000000 LCDC size 0x1B58 — LCD Controller
0xF0004000 XDMAC1 size 0x8E8
0xF0008000 ISC size 0x1858 — Image Sensor Controller
0xF000C000 MPDDRC size 0xEC — AHB Multiport DDR-SDRAM Controller
0xF0010000 XDMAC0 size 0x8E8 — Extensible DMA Controller
0xF0014000 PMC size 0x154 — Power Management Controller
0xF0018000 MATRIX0 size 0x2CC — AHB Bus Matrix
0xF001C000 AESB size 0x70 — Advanced Encryption Standard Bridge
0xF0020000 QSPI0 size 0xEC — Quad Serial Peripheral Interface
0xF0024000 QSPI1 size 0xEC
0xF0028000 SHA size 0xD8 — Secure Hash Algorithm
0xF002C000 AES size 0xE0 — Advanced Encryption Standard
0xF8000000 SPI0 size 0xEC — Serial Peripheral Interface
0xF8004000 SSC0 size 0xEC — Synchronous Serial Controller
0xF8008000 GMAC size 0x820 — Gigabit Ethernet MAC
0xF800C000 TC0 size 0xE8 — Timer Counter
0xF8010000 TC1 size 0xE8
0xF8014000 HSMC size 0x7EC — Static Memory Controller
0xF8018000 PDMIC size 0xEC — Pulse Density Modulation Interface Controller
0xF801C000 UART0 size 0xE8 — Universal Asynchronous Receiver Transmitter
0xF8020000 UART1 size 0xE8
0xF8024000 UART2 size 0xE8
0xF8028000 TWIHS0 size 0xEC — Two-wire Interface High Speed
0xF802C000 PWM size 0x464 — Pulse Width Modulation Controller
0xF8030000 SFR size 0x98 — Special Function Registers
0xF8034000 FLEXCOM0 size 0x6EC — Flexible Serial Communication
0xF8038000 FLEXCOM1 size 0x6EC
0xF803C000 SAIC size 0xEC
0xF8040000 ICM size 0x58 — Integrity Check Monitor
0xF8048000 RSTC size 0xC — Reset Controller
0xF8048010 SHDWC size 0x10 — Shutdown Controller
0xF8048030 PIT size 0x10 — Periodic Interval Timer
0xF8048040 WDT size 0xC — Watchdog Timer
0xF8048050 SCKC size 0x4 — Slow Clock Controller
0xF80480B0 RTC size 0xD4 — Real-time Clock
0xF8049000 RXLP size 0xE8 — Low Power Asynchronous Receiver
0xF804A000 ACC size 0xEC — Analog Comparator Controller
0xF804C000 SFC size 0x7C — Secure Fuse Controller
0xF8050000 I2SC0 size 0x28 — Inter-IC Sound Controller
0xF8054000 MCAN0 size 0xFC — Controller Area Network
0xFC000000 SPI1 size 0xEC
0xFC004000 SSC1 size 0xEC
0xFC008000 UART3 size 0xE8
0xFC00C000 UART4 size 0xE8
0xFC010000 FLEXCOM2 size 0x6EC
0xFC014000 FLEXCOM3 size 0x6EC
0xFC018000 FLEXCOM4 size 0x6EC
0xFC01C000 TRNG size 0x54 — True Random Number Generator
0xFC020000 AIC size 0xEC — Advanced Interrupt Controller
0xFC028000 TWIHS1 size 0xEC
0xFC02C000 UDPHS size 0x39A — USB High Speed Device Port
0xFC030000 ADC size 0xEC — Analog-to-Digital Converter
0xFC038000 PIO size 0x15E8 — Parallel Input/Output Controller
0xFC03C000 MATRIX1 size 0x2CC
0xFC040000 SECUMOD size 0x94 — Security Module
0xFC044000 TDES size 0x74 — Triple Data Encryption Standard
0xFC048000 CLASSD size 0xE8 — Audio Class D Amplifier (CLASSD)
0xFC04C000 I2SC1 size 0x28
0xFC050000 MCAN1 size 0xFC
0xFC05C000 SFRBU size 0x18 — Special Function Registers Backup
0xFC060000 PTC size 0x36 — Peripheral Touch Controller
0xFC069000 CHIPID size 0x8 — Chip Identifier

## Interrupts
0 SAIC
3 PIT
4 WDT
5 GMAC
6 XDMAC0
7 XDMAC1
8 ICM
9 AES
10 AESB
11 TDES
12 SHA
13 MPDDRC
14 MATRIX1
15 MATRIX0
16 SECUMOD
17 HSMC
19 FLEXCOM0
20 FLEXCOM1
21 FLEXCOM2
22 FLEXCOM3
23 FLEXCOM4
24 UART0
25 UART1
26 UART2
27 UART3
28 UART4
29 TWIHS0
30 TWIHS1
31 SDMMC0
32 SDMMC1
33 SPI0
34 SPI1
35 TC0
36 TC1
38 PWM
40 ADC
42 UDPHS
43 SSC0
44 SSC1
45 LCDC
46 ISC
47 TRNG
48 PDMIC
49 AIC
50 SFC
52 QSPI0
53 QSPI1
54 I2SC0
55 I2SC1
56 MCAN0_INT0 (MCAN0)
57 MCAN1_INT0 (MCAN1)
58 PTC
59 CLASSD
63 L2CC
64 MCAN0_INT1 (MCAN0)
65 MCAN1_INT1 (MCAN1)
66 GMAC_Q1 (GMAC)
67 GMAC_Q2 (GMAC)
71 SDMMC0_TIMER (SDMMC0)
72 SDMMC1_TIMER (SDMMC1)
75 ACC
76 RXLP

## Notices in the file
Copyright (c) 2022 Microchip Technology Inc.
SPDX-License-Identifier: Apache-2.0
Licensed under the Apache License, Version 2.0 (the "License");
you may not use this file except in compliance with the License.
You may obtain a copy of the License at
http://www.apache.org/licenses/LICENSE-2.0
Unless required by applicable law or agreed to in writing, software
distributed under the License is distributed on an "AS IS" BASIS,
WITHOUT WARRANTIES OR CONDITIONS OF ANY KIND, either express or implied.
See the License for the specific language governing permissions and
limitations under the License.
