# PIC32CX2051MTG64 device description
Architecture: CORTEX-M4; Family: PIC32CXMT; Series: PIC32CXMTG
Parameters: __CM4_REV=0x0001, __MPU_PRESENT=1, __FPU_PRESENT=1, __NVIC_PRIO_BITS=4, __Vendor_SysTickConfig=0, POWER_DOMAIN=PD_CORE
Programming and debug interfaces: JTAG, SWD
Registers are 32-bit, read-write, no defined reset value unless marked. A register's access mark holds for its fields unless they carry their own. Offsets are from the block's base; lines under a group give offsets from that group; [hi:lo] are bit positions; {n}, {i} and the like mark numbered series; 'fields as' and 'values as' point back to an identical list; <NAME> marks a mode.

## Ordering variants
PIC32CX2051MTG64-MU: QFN64, up to 0.00024 MHz, -40 to +85 C, 2.25 to 3.6 V

## Memory
base space: start 0 size 0x100000000, little endian
  0x40000000 PERIPHERALS size 0x20000000 io, rw
  0x01000000 IFLASH0 size 0x00100000 flash, rw, executable, page 512
  0x01100000 IFLASH1 size 0x00100000 flash, rw, executable, page 512
  0x02020000 CPKCC_ROM size 0x00010000 other, ro
  0x02031000 CPKCC_RAM size 0x00001000 other, rw
  0x04000000 QSPI_MEM size 0x02000000 other, rw, executable
  0x06000000 QSPI_AESB size 0x02000000 other, rw, executable
  0x11000000 IFLASH0_CC size 0x00100000 flash, rw, executable, page 512
  0x11100000 IFLASH1_CC size 0x00100000 flash, rw, executable, page 512
  0x14000000 QSPI_MEM_CC size 0x02000000 other, rw, executable
  0x16000000 QSPI_AESB_CC size 0x02000000 other, rw, executable
  0x1FFFA000 DTCM size 0x00002000 other, rw, executable
  0x1FFFC000 ITCM size 0x00004000 other, rw, executable
  0x20000000 IRAM0 size 0x00080000 ram, rw, executable
  0xE0000000 CORTEXM_PRIVATE_PB size 0x00100000 other, rw
fuses space: start 0 size 1, little endian
lockbits space: start 0 size 0x20, little endian

## Peripheral instances (address, pins/pin function, parameters)
ACC at 0x40028000
  pins: AD0 PA29/X1; ACC_INP0 PA29/X1; XIN PA29/X1; AD1 PA30/X1; ACC_INP1 PA30/X1; AD2 PA31/X1; ACC_INP2 PA31/X1; AD3 PB0/X1; ACC_INN0 PB0/X1; XOUT PB0/X1; AD4 PB1/X1; ACC_INN1 PB1/X1
  parameters: INSTANCE_ID=25, CLOCK_ID=25
ADC at 0x40024000
  pins: AD0 PA29/X1; ACC_INP0 PA29/X1; XIN PA29/X1; AD1 PA30/X1; ACC_INP1 PA30/X1; AD2 PA31/X1; ACC_INP2 PA31/X1; AD3 PB0/X1; ACC_INN0 PB0/X1; XOUT PB0/X1; AD4 PB1/X1; ACC_INN1 PB1/X1
  parameters: INSTANCE_ID=24, CLOCK_ID=24
AES at 0x44000000
  parameters: INSTANCE_ID=49, CLOCK_ID=49, INSTANCE_ID_AESSEC=50
AESB at 0x44004000
  parameters: INSTANCE_ID=51, CLOCK_ID=51, INSTANCE_ID_AESBSEC=52
CHIPID at 0x40050200
CMCC0 at 0x46008000 (CMCC)
  parameters: ICACHE_PRESENT=1, DCACHE_PRESENT=0, SIZE=16KB
CMCC1 at 0x4600C000 (CMCC)
  parameters: ICACHE_PRESENT=0, DCACHE_PRESENT=1, SIZE=8KB
CPKCC at 0x46000000
  parameters: INSTANCE_ID=59, CLOCK_ID=59
DWDT at 0x40052000
  parameters: INSTANCE_ID=4
FLEXCOM0 at 0x40000000 (FLEXCOM)
  pins: FLEXCOM0_IO0 PA4/A; FLEXCOM0_IO1 PA5/A; FLEXCOM0_IO2 PA6/A; FLEXCOM0_IO3 PA7/A; FLEXCOM0_IO4 PA6/B or PA29/B
  parameters: INSTANCE_ID=9, CLOCK_ID=9, USART_FIFO_SIZE=8, SPI_FIFO_SIZE=8, TWI_FIFO_SIZE=8
FLEXCOM1 at 0x40004000 (FLEXCOM)
  pins: FLEXCOM1_IO0 PA8/A or PC2/B; FLEXCOM1_IO1 PA9/A or PC3/B; FLEXCOM1_IO2 PA10/A; FLEXCOM1_IO3 PA11/A; FLEXCOM1_IO4 PA10/B or PA29/C
  parameters: INSTANCE_ID=10, CLOCK_ID=10, USART_FIFO_SIZE=8, SPI_FIFO_SIZE=8, TWI_FIFO_SIZE=8
FLEXCOM2 at 0x40008000 (FLEXCOM)
  pins: FLEXCOM2_IO0 PA12/A; FLEXCOM2_IO1 PA13/A; FLEXCOM2_IO2 PA14/A; FLEXCOM2_IO3 PA15/A; FLEXCOM2_IO4 PA14/B or PA29/D
  parameters: INSTANCE_ID=11, CLOCK_ID=11, USART_FIFO_SIZE=8, SPI_FIFO_SIZE=8, TWI_FIFO_SIZE=8
FLEXCOM3 at 0x4000C000 (FLEXCOM)
  pins: FLEXCOM3_IO0 PA16/A or PB9/B; FLEXCOM3_IO1 PA17/A or PB10/B; FLEXCOM3_IO2 PA18/A or PB11/B; FLEXCOM3_IO3 PA19/A or PB12/B; FLEXCOM3_IO4 PA18/B or PB0/B or PB11/C
  parameters: INSTANCE_ID=12, CLOCK_ID=12, USART_FIFO_SIZE=8, SPI_FIFO_SIZE=8, TWI_FIFO_SIZE=8
FLEXCOM4 at 0x40010000 (FLEXCOM)
  pins: FLEXCOM4_IO0 PB5/B or PB24/B; FLEXCOM4_IO1 PB6/B or PB25/B; FLEXCOM4_IO2 PB7/B or PB26/B; FLEXCOM4_IO3 PB8/B or PC0/B; FLEXCOM4_IO4 PB7/C or PB26/C or PC1/B
  parameters: INSTANCE_ID=13, CLOCK_ID=13, USART_FIFO_SIZE=8, SPI_FIFO_SIZE=8, TWI_FIFO_SIZE=8
FLEXCOM5 at 0x40014000 (FLEXCOM)
  pins: FLEXCOM5_IO0 PA24/B or PB20/B or PC9/A; FLEXCOM5_IO1 PA23/B or PB21/B or PC8/A; FLEXCOM5_IO2 PA22/B or PB22/B or PC7/A; FLEXCOM5_IO3 PA21/B or PB23/B or PC6/A; FLEXCOM5_IO4 PA22/C or PB15/B or PB22/C or PC7/C
  parameters: INSTANCE_ID=14, CLOCK_ID=14, USART_FIFO_SIZE=8, SPI_FIFO_SIZE=8, TWI_FIFO_SIZE=8
FLEXCOM6 at 0x40018000 (FLEXCOM)
  pins: FLEXCOM6_IO0 PA0/A or PA25/B or PC6/B or PC16/A; FLEXCOM6_IO1 PA1/A or PA26/B or PC7/B or PC17/A; FLEXCOM6_IO2 PA27/B or PC18/A; FLEXCOM6_IO3 PA28/B or PC19/A; FLEXCOM6_IO4 PA27/C or PB16/B or PC18/B
  parameters: INSTANCE_ID=15, CLOCK_ID=15, USART_FIFO_SIZE=8, SPI_FIFO_SIZE=8, TWI_FIFO_SIZE=8
FLEXCOM7 at 0x4001C000 (FLEXCOM)
  pins: FLEXCOM7_IO0 PB4/B or PC13/B or PC21/A; FLEXCOM7_IO1 PB3/B or PC12/B or PC20/A; FLEXCOM7_IO2 PB2/B or PC15/B; FLEXCOM7_IO3 PB1/B or PC14/B; FLEXCOM7_IO4 PB2/C or PC11/B
  parameters: INSTANCE_ID=16, CLOCK_ID=16, USART_FIFO_SIZE=8, SPI_FIFO_SIZE=8, TWI_FIFO_SIZE=8
GPBR at 0x40053060
ICM at 0x44010000
  parameters: INSTANCE_ID=57, CLOCK_ID=57, INSTANCE_ID_ICMSEC=58
MATRIX0 at 0x46004000 (MATRIX)
  parameters: INSTANCE_ID=60
MATRIX1 at 0x40044000 (MATRIX)
  parameters: INSTANCE_ID=61
MATRIX2 at 0x4A000000 (MATRIX)
  parameters: INSTANCE_ID=94
MATRIX3 at 0x48020000 (MATRIX)
  parameters: INSTANCE_ID=95
MEM2MEM0 at 0x40034000 (MEM2MEM)
  parameters: INSTANCE_ID=30, CLOCK_ID=30
MEM2MEM1 at 0x48004000 (MEM2MEM)
  parameters: INSTANCE_ID=78, CLOCK_ID=78
PIO0 at 0x40048000 (PIO)
  pins: P4 PA4; P5 PA5; P6 PA6; P7 PA7; P8 PA8; P9 PA9; P12 PA12; P13 PA13; P24 PA24; P25 PA25; P29 PA29; P32 PB0; P34 PB2; P35 PB3; P36 PB4; P41 PB9; P42 PB10; P43 PB11; P44 PB12; P56 PB24; P57 PB25; P58 PB26; P64 PC0; P66 PC2; P67 PC3; P69 PC5; P74 PC10; P75 PC11; P76 PC12; P77 PC13; P78 PC14; P79 PC15; P82 PC18; P83 PC19; P84 PC20; P85 PC21; P86 PC22
  parameters: CLOCK_ID=17
PIOA
  parameters: INSTANCE_ID=17, INSTANCE_ID_SEC=18, PIO_BASE=PIO0, PIO_GROUP_INDEX=0
PIOB
  parameters: INSTANCE_ID=19, INSTANCE_ID_SEC=20, PIO_BASE=PIO0, PIO_GROUP_INDEX=1
PIOC
  parameters: INSTANCE_ID=21, INSTANCE_ID_SEC=22, PIO_BASE=PIO0, PIO_GROUP_INDEX=2
PIO1 at 0x4800C000 (PIO)
  pins: P113 PD17; P114 PD18; P115 PD19
  parameters: CLOCK_ID=85
PIOD
  parameters: INSTANCE_ID=85, INSTANCE_ID_SEC=86, PIO_BASE=PIO1, PIO_GROUP_INDEX=0
PMC at 0x46800000
  pins: PCK0 PA20/A or PC22/A; PCK1 PA2/A or PB1/C; PCK2 PC5/A or PD4/B or PD29/A
  parameters: INSTANCE_ID=6
PWM at 0x4801C000
  pins: PWMH0 PD3/C; PWMH1 PD15/B; PWMH2 PD16/B; PWML0 PD17/A; PWML1 PD18/A; PWML2 PD19/A
  parameters: INSTANCE_ID=90, CLOCK_ID=90, FAULT_PWM_ID0=0x0 (Fault 0 - PWM0_PWMFI0 Input pin), FAULT_PWM_ID1=0x1 (Fault 1 - PWM0_PWMFI1 Input pin), FAULT_PWM_ID2=0x2 (Fault 2 - Main Osc (PMC)), FAULT_PWM_ID3=0x3 (Fault 3 - ADC), FAULT_PWM_ID4=0x4 (Fault 4 - TC3), FAULT_PWM_ID5=0x5 (Fault 5 - TC0), FAULT_PWM_ID6=0x6 (Fault 6 - TC1), FAULT_PWM_ID7=0x7 (Fault 7 - TC2)
QSPI at 0x40020000
  pins: QCS PC14/A; QIO0 PC13/A; QIO1 PC12/A; QIO2 PC11/A; QIO3 PC10/A; QSCK PC15/A
  parameters: INSTANCE_ID=23, CLOCK_ID=23
RSTC at 0x40053000
  parameters: INSTANCE_ID=1
RTC at 0x40053100
  parameters: INSTANCE_ID=2
RTT at 0x40053020
  parameters: INSTANCE_ID=3
SEFC0 at 0x460E0000 (SEFC)
  parameters: INSTANCE_ID=7
SEFC1 at 0x460E0200 (SEFC)
  parameters: INSTANCE_ID=8
SFR at 0x40050400
SFRBU at 0x40050600
SHA at 0x44008000
  parameters: INSTANCE_ID=53, CLOCK_ID=53, INSTANCE_ID_SHASEC=54
SUPC at 0x400531D0
  pins: WKUP5 PA5/X1; WKUP6 PA9/X1; WKUP7 PA13/X1; WKUP9 PB9/X1; WKUP10 PB12/X1; WKUP8 PB25/X1; WKUP13 PC14/X1; WKUP14 PC21/X1
  parameters: INSTANCE_ID=0, INSTANCE_ID_WKUP{n}={n+59} (n=3..15)
SYSCWP at 0x400531A0
TC0 at 0x40038000 (TC)
  pins: TCLK0 PA23/D; TCLK1 PB1/D; TCLK2 PB4/D; TIOA0 PA2/B or PA25/D; TIOA1 PA31/D; TIOA2 PB2/D; TIOB0 PA3/A or PA24/D; TIOB1 PB0/D; TIOB2 PB3/D
  parameters: INSTANCE_ID_CHANNEL0=31, CLOCK_ID_CHANNEL0=31, INSTANCE_ID_CHANNEL1=32, CLOCK_ID_CHANNEL1=32, INSTANCE_ID_CHANNEL2=33, CLOCK_ID_CHANNEL2=33, INSTANCE_ID_C0SEC=40, INSTANCE_ID_C1SEC=41, INSTANCE_ID_C2SEC=42, TCCLKS_=0 (MCK0DIV), TCCLKS_TIMER_CLOCK1=1 (GCLK), TCCLKS_TIMER_CLOCK2=2 (MCK0/8), TCCLKS_TIMER_CLOCK3=3 (MCK0/32), TCCLKS_TIMER_CLOCK4=4 (MCK0/128), TCCLKS_TIMER_CLOCK5=5 (MD_SLCK), TCCLKS_XC0=6 (XC0), TCCLKS_XC1=7 (XC1), TCCLKS_XC2=8 (XC2), NUM_INTERRUPT_LINES=3, TIMER_WIDTH=32
TC1 at 0x4003C000 (TC)
  pins: TCLK3 PB14/C; TCLK4 PB17/C; TCLK5 PC5/D; TIOA3 PB8/C or PC0/C; TIOA4 PB18/C; TIOA5 PB5/C or PB24/C; TIOB3 PB13/C; TIOB4 PB19/C; TIOB5 PB6/C or PB25/C
  parameters: INSTANCE_ID_CHANNEL0=34, CLOCK_ID_CHANNEL0=34, INSTANCE_ID_CHANNEL1=35, CLOCK_ID_CHANNEL1=35, INSTANCE_ID_CHANNEL2=36, CLOCK_ID_CHANNEL2=36, INSTANCE_ID_C0SEC=43, INSTANCE_ID_C1SEC=44, INSTANCE_ID_C2SEC=45, TCCLKS_=0 (MCK0DIV), TCCLKS_TIMER_CLOCK1=1 (GCLK), TCCLKS_TIMER_CLOCK2=2 (MCK0/8), TCCLKS_TIMER_CLOCK3=3 (MCK0/32), TCCLKS_TIMER_CLOCK4=4 (MCK0/128), TCCLKS_TIMER_CLOCK5=5 (MD_SLCK), TCCLKS_XC0=6 (XC0), TCCLKS_XC1=7 (XC1), TCCLKS_XC2=8 (XC2), NUM_INTERRUPT_LINES=3, TIMER_WIDTH=32
TC2 at 0x40040000 (TC)
  pins: TCLK6 PA10/C; TCLK7 PC16/D; TCLK8 PC19/D; TIOA6 PA6/C; TIOA7 PC14/D; TIOA8 PC17/D; TIOB6 PA7/C; TIOB7 PC15/D; TIOB8 PC18/D
  parameters: INSTANCE_ID_CHANNEL0=37, CLOCK_ID_CHANNEL0=37, INSTANCE_ID_CHANNEL1=38, CLOCK_ID_CHANNEL1=38, INSTANCE_ID_CHANNEL2=39, CLOCK_ID_CHANNEL2=39, INSTANCE_ID_C0SEC=46, INSTANCE_ID_C1SEC=47, INSTANCE_ID_C2SEC=48, TCCLKS_=0 (MCK0DIV), TCCLKS_TIMER_CLOCK1=1 (GCLK), TCCLKS_TIMER_CLOCK2=2 (MCK0/8), TCCLKS_TIMER_CLOCK3=3 (MCK0/32), TCCLKS_TIMER_CLOCK4=4 (MCK0/128), TCCLKS_TIMER_CLOCK5=5 (MD_SLCK), TCCLKS_XC0=6 (XC0), TCCLKS_XC1=7 (XC1), TCCLKS_XC2=8 (XC2), NUM_INTERRUPT_LINES=3, TIMER_WIDTH=32
TC3 at 0x48008000 (TC)
  pins: TCLK9 PD3/A; TCLK10 PD16/A; TCLK11 PD19/C; TIOA9 PD0/A; TIOA10 PD14/A; TIOA11 PD17/C; TIOB9 PD4/A; TIOB10 PD15/A; TIOB11 PD18/C
  parameters: INSTANCE_ID_CHANNEL0=79, CLOCK_ID_CHANNEL0=79, INSTANCE_ID_CHANNEL1=80, CLOCK_ID_CHANNEL1=80, INSTANCE_ID_CHANNEL2=81, CLOCK_ID_CHANNEL2=81, INSTANCE_ID_C0SEC=82, INSTANCE_ID_C1SEC=83, INSTANCE_ID_C2SEC=84, TCCLKS_=0 (MCK0DIV), TCCLKS_TIMER_CLOCK1=1 (GCLK), TCCLKS_TIMER_CLOCK2=2 (MCK0/8), TCCLKS_TIMER_CLOCK3=3 (MCK0/32), TCCLKS_TIMER_CLOCK4=4 (MCK0/128), TCCLKS_TIMER_CLOCK5=5 (MD_SLCK), TCCLKS_XC0=6 (XC0), TCCLKS_XC1=7 (XC1), TCCLKS_XC2=8 (XC2), NUM_INTERRUPT_LINES=3, TIMER_WIDTH=32
TRNG at 0x4400C000
  parameters: INSTANCE_ID=55, CLOCK_ID=55, INSTANCE_ID_TRNGSEC=56
FUSES at GPNVMBITS 0 in fuses
LOCKBIT at 0 in lockbits
CoreDebug at 0xE000EDF0
DWT at 0xE0001000
FPU at 0xE000EF30
ITM at 0xE0000000
MPU at 0xE000ED90
NVIC at 0xE000E100
  parameters: NUM_IRQ=96 (Number of interrupt requests), __NVIC_PRIO_BITS=4 (Number of NVIC interrupt priority bits)
SysTick at 0xE000E010
SystemControl at 0xE000E000
TPI at 0xE0040000
  pins: TRACESWO0 PB10/D

## Interrupts
-15 Reset — Reset Vector, invoked on Power up and warm reset
-14 NonMaskableInt — Non maskable Interrupt, cannot be stopped or preempted
-13 HardFault — Hard Fault, all classes of Fault
-12 MemoryManagement — Memory Management, MPU mismatch, including Access Violation and No Match
-11 BusFault — Bus Fault, Pre-Fetch-, Memory Access Fault, other address/memory related Fault
-10 UsageFault — Usage Fault, i.e. Undef Instruction, Illegal State Transition
-5 SVCall — System Service Call via SVC instruction
-4 DebugMonitor
-2 PendSV — Pendable request for system service
-1 SysTick — System Tick Timer
0 SUPC — Supply Controller
1 RSTC — Reset Controller
2 RTC — Real Time Clock
3 RTT — Real Time Timer
4 DWDT0 (DWDT) — Dual Watchdog 0 Timer
5 DWDT1 (DWDT) — Dual Watchdog 1 Timer
6 PMC — Power Management Controller
7 SEFC0 — Embedded Flash Controller 0
8 SEFC1 — Embedded Flash Controller 1
{n+9} FLEXCOM{n} (n=0..7) — FLEXCOM {n} (USART{n}/SPI{n}/TWI{n})
17 PIOA — Application Core Parallel I/O Controller A (PIOA)
18 PIOA_SEC (PIOA) — Application Core Parallel I/O Controller A (PIOA) Secure Event Interrupt
19 PIOB — Application Core Parallel I/O Controller B (PIOB)
20 PIOB_SEC (PIOB) — Application Core Parallel I/O Controller B (PIOB) Secure Event Interrupt
21 PIOC — Application Core Parallel I/O Controller C (PIOC)
22 PIOC_SEC (PIOC) — Application Core Parallel I/O Controller C (PIOC) Secure Event Interrupt
23 QSPI — Quad IO Serial Peripheral Interface
24 ADC — Analog To Digital Converter
25 ACC — Analog Comparator
30 MEM2MEM0 — Application Core Memory to Memory Transfer Controller (MEM2MEM0)
31 TC0_CHANNEL0 (TC0) — Timer Counter 0, Channel 0
32 TC0_CHANNEL1 (TC0) — Timer Counter 0, Channel 1
33 TC0_CHANNEL2 (TC0) — Timer Counter 0, Channel 2
34 TC1_CHANNEL0 (TC1) — Timer Counter 1, Channel 0
35 TC1_CHANNEL1 (TC1) — Timer Counter 1, Channel 1
36 TC1_CHANNEL2 (TC1) — Timer Counter 1, Channel 2
37 TC2_CHANNEL0 (TC2) — Timer Counter 2, Channel 0
38 TC2_CHANNEL1 (TC2) — Timer Counter 2, Channel 1
39 TC2_CHANNEL2 (TC2) — Timer Counter 2, Channel 2
40 TC0_C0SEC (TC0) — Timer Counter 0, Channel 0, Secure IRQ
41 TC0_C1SEC (TC0) — Timer Counter 0, Channel 1, Secure IRQ
42 TC0_C2SEC (TC0) — Timer Counter 0, Channel 2, Secure IRQ
43 TC1_C0SEC (TC1) — Timer Counter 1, Channel 0, Secure IRQ
44 TC1_C1SEC (TC1) — Timer Counter 1, Channel 1, Secure IRQ
45 TC1_C2SEC (TC1) — Timer Counter 1, Channel 2, Secure IRQ
46 TC2_C0SEC (TC2) — Timer Counter 2, Channel 0, Secure IRQ
47 TC2_C1SEC (TC2) — Timer Counter 2, Channel 1, Secure IRQ
48 TC2_C2SEC (TC2) — Timer Counter 2, Channel 2, Secure IRQ
49 AES — Advanced Enhanced Standard
50 AES_AESSEC (AES) — AES Secure Event Interrupt
51 AESB — AES Bridge
52 AESB_AESBSEC (AESB) — AES Bridge Secure Interrupt
53 SHA — Secure Hash Algorithm
54 SHA_SHASEC (SHA) — SHA Secure Event Interrupt
55 TRNG — True Random Generator
56 TRNG_TRNGSEC (TRNG) — TRNG Secure Event Interrupt
57 ICM — Integrity Check Module
58 ICM_ICMSEC (ICM) — Integrity Check Module
59 CPKCC — Public Key Cryptography Controller
60 MATRIX0 — High-Speed Application Core Matrix (HSACM) (MATRIX0)
61 MATRIX1 — Low-Speed Application Core Matrix (LSACM) (MATRIX1)
{n+59} SUPC_WKUP{n} (SUPC) (n=3..15) — External interrupt {n}
78 MEM2MEM1 — Metrology Core Memory to Memory Transfer Controller 1 (MEM2MEM1)
79 TC3_CHANNEL0 (TC3) — Timer Counter 3, Channel 0
80 TC3_CHANNEL1 (TC3) — Timer Counter 3, Channel 1
81 TC3_CHANNEL2 (TC3) — Timer Counter 3, Channel 2
82 TC3_C0SEC (TC3) — Timer Counter 3, Channel 0, Secure IRQ
83 TC3_C1SEC (TC3) — Timer Counter 3, Channel 1, Secure IRQ
84 TC3_C2SEC (TC3) — Timer Counter 3, Channel 2, Secure IRQ
85 PIOD — Metrology Core Parallel I/O Controller D (PIOD)
86 PIOD_SEC (PIOD) — Metrology Core Parallel I/O Controller A Secure Interupt (named as PIOD)
90 PWM — Pulse Width Modulation
94 MATRIX2 — High-Speed Metrology Core Matrix (HSMCM) (Formely MATRIX2)
95 MATRIX3 — Low-Speed Metrology Core Matrix (LSMCM) (Formely MATRIX3)

## Properties
SIGNATURES: JTAGID=0x05B4503F, CHIPID_CIDR=0x2C6F0EE0, CHIPID_EXID=0x00000000

## Pinouts (pin number, pad)
QFN64: 13 PA4, 14 PA5, 15 PA6, 16 PA7, 7 PA8, 8 PA9, 17 PA12, 18 PA13, 34 PA23, 35 PA24, 36 PA25, 37 PA29, 39 PB0, 40 PB2, 43 PB3, 44 PB4, 45 PB9, 46 PB10, 47 PB11, 48 PB12, 49 PB24, 50 PB25, 51 PB26, 52 PC0, 55 PC2, 56 PC3, 57 PC5, 59 PC10, 60 PC11, 62 PC12, 63 PC13, 64 PC14, 1 PC15, 2 PC18, 3 PC19, 4 PC20, 5 PC21, 6 PC22, 10 PD17, 11 PD18, 12 PD19, 22 NRST, 28 FWUP, 29 JTAGSEL, 33 SHDN, 32 TST, 27 RTCOUT0, 26 WKUP2_TMP2, 31 XOUT32, 30 XIN32, 9 VDD3V3, 25 VBAT, 24 VDD3V3, 42 VDD3V3, 54 VDD3V3, 61 VDD3V3, 19 VDDCORE, 23 VDDCORE, 53 VDDCORE, 58 VDDCORE, 41 VDDPLL, 20 VDDOUT, 21 VDD3V3, 38 VREFP

## Notices in the file
Copyright %copyright_year% Microchip Technology Inc.
SPDX-License-Identifier: Apache-2.0
Licensed under the Apache License, Version 2.0 (the "License");
you may not use this file except in compliance with the License.
You may obtain a copy of the License at
http://www.apache.org/licenses/LICENSE-2.0
Unless required by applicable law or agreed to in writing, software
distributed under the License is distributed on an "AS IS" BASIS,
WITHOUT WARRANTIES OR CONDITIONS OF ANY KIND, either express or implied.
See the License for the specific language governing permissions and
limitations under the License.
