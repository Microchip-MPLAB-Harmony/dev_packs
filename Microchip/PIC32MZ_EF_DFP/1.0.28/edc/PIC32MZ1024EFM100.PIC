# PIC32MZ1024EFM100 register map
Vendor: Microchip
Architecture 32xxxx. Special function registers and configuration words.
Registers are 32-bit, read-write, reset 0x0 unless marked. A register's access mark holds for its fields unless they carry their own. Addresses are absolute, and some are shared; only a register's first bit layout is shown; lines under a group give offsets from that group; [hi:lo] are bit positions; {n}, {i} and the like mark numbered series; 'fields as' and 'values as' point back to an identical list; <NAME> marks a mode.

## Further device data
pins=1: RG15/AERXERR/AN23; 2: RA5/PMA5/AN34/EBIA5; 3: RE5/PMD5/RPE5/AN17/EBID5; 4: RE6/PMD6/AN16/EBID6; 5: RE7/PMD7/AN15/EBID7; 6: RC1/PMA6/RPC1/AN22/EBIA6; 7: RC2/PMA12/RPC2/AN21/EBIA12; 8: RC3/PMWR/RPC3/AN20/EBIWE; 9: RC4/PMRD/RPC4/AN19/EBIOE; 10: RG6/SCK2/RPG6/ECOL/C1IND/AN14; 11: RG7/PMA4/SDA4/RPG7/ECRS/C1INC/AN13/EBIA4; 12: RG8/PMA3/SCL4/RPG8/AECRSDV/AERXDV/ECRSDV/ERXDV/C2IND/AN12/EBIA3; 13: VSS; 14: VDD; 15: MCLR; 16: RG9/PMA2/RPG9/AEREFCLK/AERXCLK/EREFCLK/ERXCLK/C2INC/AN11/EBIA2; 17: RA0/AN24/EBIA16/TMS; 18: RE8/RPE8/AERXD0/AN25; 19: RE9/RPE9/AERXD1/AN26; 20: RB5/RPB5/C1INA/AN45; 21: RB4/C1INB/AN4; 22: RB3/RPB3/C2INA/AN3; 23: RB2/RPB2/C2INB/AN2; 24: RB1/RPB1/AN1/PGEC1; 25: RB0/RPB0/AN0/PGED1; 26: RB6/RPB6/AN46/PGEC2; 27: RB7/RPB7/AN47/PGED2; 28: RA9/AERXD2/AN27/VREF-; 29: RA10/AERXD3/AN28/VREF+; 30: AVDD; 31: AVSS; 32: RB8/PMA10/RPB8/AN48/EBIA10; 33: RB9/PMA7/RPB9/AN49/EBIA7; 34: RB10/PMA13/RPB10/AN5/CVREFOUT/EBIA13; 35: RB11/AETXERR/ERXERR/AN6; 36: VSS; 37: VDD; 38: RA1/AN29/EBIA19/TCK; 39: RF13/SCK5/RPF13/AN30/EBIA18/TDI; 40: RF12/RPF12/AN31/EBIA17/TDO; 41: RB12/PMA11/AECRS/ERXD0/AN7/EBIA11; 42: RB13/AECOL/ERXD1/AN8; 43: RB14/PMA1/SCK3/RPB14/AETXD3/ERXD2/AN9/EBIA1; 44: RB15/PMA0/OCFB/RPB15/AETXD2/ERXD3/AN10/EBIA0; 45: VSS; 46: VDD; 47: RD14/RPD14/AETXD0/AN32; 48: RD15/SCK6/RPD15/AETXD1/AN33; 49: RC12/CLKI/OSC1; 50: RC15/CLKO/OSC2; 51: VBUS; 52: VUSB3V3; 53: VSS; 54: D-; 55: D+; 56: RF3/RPF3/USBID; 57: RF2/SDA3/RPF2/EBIRDY3; 58: RF8/SCL3/RPF8/EBIRDY2; 59: RA2/SCL2/EBICS0; 60: RA3/SDA2/EBIRDY1; 61: RA4/PMA14/PMCS1/EBIA14; 62: VDD; 63: VSS; 64: RF4/PMA9/SDA5/RPF4/EBIA9; 65: RF5/PMA8/SCL5/RPF5/EBIA8; 66: RA14/SCL1/RPA14/AETXCLK; 67: RA15/SDA1/RPA15/AETXEN; 68: RD9/PMA15/PMCS2/RPD9/EBIA15; 69: RD10/SCK4/RPD10; 70: RD11/RPD11/AEMDC/EMDC; 71: RD0/INT0/RTCC/RPD0/AEMDIO/EMDIO; 72: RC13/RPC13/SOSCI; 73: RC14/T1CK/RPC14/SOSCO; 74: VDD; 75: VSS; 76: RD1/SCK1/RPD1; 77: RD2/PMD14/RPD2/ETXEN/EBID14; 78: RD3/PMD15/RPD3/ETXCLK/EBID15; 79: RD12/PMD12/RPD12/ETXD2/EBID12; 80: RD13/PMD13/ETXD3/EBID13; 81: RD4/RPD4/SQICS0; 82: RD5/RPD5/SQICS1; 83: VDD; 84: VSS; 85: RF0/PMD11/RPF0/ETXD1/EBID11; 86: RF1/PMD10/RPF1/ETXD0/EBID10; 87: RG1/PMD9/RPG1/ETXERR/EBID9; 88: RG0/PMD8/RPG0/EBID8; 89: RA6/SQICLK/TRCLK; 90: RA7/SQID3/TRD3; 91: RE0/PMD0/EBID0; 92: VSS; 93: VDD; 94: RE1/PMD1/EBID1; 95: RG14/SQID2/TRD2; 96: RG12/SQID1/TRD1; 97: RG13/SQID0/TRD0; 98: RE2/PMD2/EBID2; 99: RE3/PMD3/RPE3/EBID3; 100: RE4/PMD4/AN18/EBID4, interrupts=0 CORE_TIMER — Core Timer; 1 CORE_SOFTWARE_0 — Core Software 0; 2 CORE_SOFTWARE_1 — Core Software 1; 3 EXTERNAL_0 — Ext INT 0; 4 TIMER_1 — Timer1; 5 INPUT_CAPTURE_1_ERROR — Input Capture 1 Error; 6 INPUT_CAPTURE_1 — Input Capture 1; 7 OUTPUT_COMPARE_1 — Output Compare 1; 8 EXTERNAL_1 — Ext INT 1; 9 TIMER_2 — Timer2; 10 INPUT_CAPTURE_2_ERROR — Input Capture 2 Error; 11 INPUT_CAPTURE_2 — Input Capture 2; 12 OUTPUT_COMPARE_2 — Output Compare 2; 13 EXTERNAL_2 — Ext INT 2; 14 TIMER_3 — Timer3; 15 INPUT_CAPTURE_3_ERROR — Input Capture 3 Error; 16 INPUT_CAPTURE_3 — Input Capture 3; 17 OUTPUT_COMPARE_3 — Output Compare 3; 18 EXTERNAL_3 — Ext INT 3; 19 TIMER_4 — Timer4; 20 INPUT_CAPTURE_4_ERROR — Input Capture 4 Error; 21 INPUT_CAPTURE_4 — Input Capture 4; 22 OUTPUT_COMPARE_4 — Output Compare 4; 23 EXTERNAL_4 — Ext INT 4; 24 TIMER_5 — Timer5; 25 INPUT_CAPTURE_5_ERROR — Input Capture 5 Error; 26 INPUT_CAPTURE_5 — Input Capture 5; 27 OUTPUT_COMPARE_5 — Output Compare 5; 28 TIMER_6 — Timer6; 29 INPUT_CAPTURE_6_ERROR — Input Capture 6 Error; 30 INPUT_CAPTURE_6 — Input Capture 6; 31 OUTPUT_COMPARE_6 — Output Compare 6; 32 TIMER_7 — Timer7; 33 INPUT_CAPTURE_7_ERROR — Input Capture 7 Error; 34 INPUT_CAPTURE_7 — Input Capture 7; 35 OUTPUT_COMPARE_7 — Output Compare 7; 36 TIMER_8 — Timer8; 37 INPUT_CAPTURE_8_ERROR — Input Capture 8 Error; 38 INPUT_CAPTURE_8 — Input Capture 8; 39 OUTPUT_COMPARE_8 — Output Compare 8; 40 TIMER_9 — Timer9; 41 INPUT_CAPTURE_9_ERROR — Input Capture 9 Error; 42 INPUT_CAPTURE_9 — Input Capture 9; 43 OUTPUT_COMPARE_9 — Output Compare 9; 44 ADC — ADC Global; 45 ADC_FIFO — ADC FIFO Data Ready; 46 ADC_DC1 — ADC Digital Comparator 1; 47 ADC_DC2 — ADC Digital Comparator 2; 48 ADC_DC3 — ADC Digital Comparator 3; 49 ADC_DC4 — ADC Digital Comparator 4; 50 ADC_DC5 — ADC Digital Comparator 5; 51 ADC_DC6 — ADC Digital Comparator 6; 52 ADC_DF1 — ADC Digital Filter 1; 53 ADC_DF2 — ADC Digital Filter 2; 54 ADC_DF3 — ADC Digital Filter 3; 55 ADC_DF4 — ADC Digital Filter 4; 56 ADC_DF5 — ADC Digital Filter 5; 57 ADC_DF6 — ADC Digital Filter 6; 58 ADC_FAULT — ADC Fault; 59 ADC_DATA0 — ADC Data 0; 60 ADC_DATA1 — ADC Data 1; 61 ADC_DATA2 — ADC Data 2; 62 ADC_DATA3 — ADC Data 3; 63 ADC_DATA4 — ADC Data 4; 64 ADC_DATA5 — ADC Data 5; 65 ADC_DATA6 — ADC Data 6; 66 ADC_DATA7 — ADC Data 7; 67 ADC_DATA8 — ADC Data 8; 68 ADC_DATA9 — ADC Data 9; 69 ADC_DATA10 — ADC Data 10; 70 ADC_DATA11 — ADC Data 11; 71 ADC_DATA12 — ADC Data 12; 72 ADC_DATA13 — ADC Data 13; 73 ADC_DATA14 — ADC Data 14; 74 ADC_DATA15 — ADC Data 15; 75 ADC_DATA16 — ADC Data 16; 76 ADC_DATA17 — ADC Data 17; 77 ADC_DATA18 — ADC Data 18; 78 ADC_DATA19 — ADC Data 19; 79 ADC_DATA20 — ADC Data 20; 80 ADC_DATA21 — ADC Data 21; 81 ADC_DATA22 — ADC Data 22; 82 ADC_DATA23 — ADC Data 23; 83 ADC_DATA24 — ADC Data 24; 84 ADC_DATA25 — ADC Data 25; 85 ADC_DATA26 — ADC Data 26; 86 ADC_DATA27 — ADC Data 27; 87 ADC_DATA28 — ADC Data 28; 88 ADC_DATA29 — ADC Data 29; 89 ADC_DATA30 — ADC Data 30; 90 ADC_DATA31 — ADC Data 31; 91 ADC_DATA32 — ADC Data 32; 92 ADC_DATA33 — ADC Data 33; 93 ADC_DATA34 — ADC Data 34; 94 ADC_DATA35 — ADC Data 35; 95 ADC_DATA36 — ADC Data 36; 96 ADC_DATA37 — ADC Data 37; 97 ADC_DATA38 — ADC Data 38; 98 ADC_DATA39 — ADC Data 39; 99 ADC_DATA40 — ADC Data 40; 100 ADC_DATA41 — ADC Data 41; 101 ADC_DATA42 — ADC Data 42; 102 ADC_DATA43 — ADC Data 43; 103 ADC_DATA44 — ADC Data 44; 104 CORE_PERF_COUNT — Core Performance Counter; 105 CORE_FAST_DEBUG_CHAN — Core Fast Debug Channel; 106 SYSTEM_BUS_PROTECTION — System Bus Protection Violation; 107 CRYPTO — Crypto Engine Event; 109 SPI1_FAULT — SPI1 Fault; 110 SPI1_RX — SPI1 Receive Done; 111 SPI1_TX — SPI1 Transmit Done; 112 UART1_FAULT — UART1 Fault; 113 UART1_RX — UART1 Receive Done; 114 UART1_TX — UART1 Transmit Done; 115 I2C1_BUS — I2C1 Bus Collision Event; 116 I2C1_SLAVE — I2C1 Slave Event; 117 I2C1_MASTER — I2C1 Master Event; 118 CHANGE_NOTICE_A — PORTA Input Change; 119 CHANGE_NOTICE_B — PORTB Input Change; 120 CHANGE_NOTICE_C — PORTC Input Change; 121 CHANGE_NOTICE_D — PORTD Input Change; 122 CHANGE_NOTICE_E — PORTE Input Change; 123 CHANGE_NOTICE_F — PORTF Input Change; 124 CHANGE_NOTICE_G — PORTG Input Change; 128 PMP — Parallel Master Port; 129 PMP_ERROR — Parallel Master Port Error; 130 COMPARATOR_1 — Comparator 1; 131 COMPARATOR_2 — Comparator 2; 132 USB — USB General Event; 133 USB_DMA — USB DMA Event; 134 DMA0 — DMA Channel 0; 135 DMA1 — DMA Channel 1; 136 DMA2 — DMA Channel 2; 137 DMA3 — DMA Channel 3; 138 DMA4 — DMA Channel 4; 139 DMA5 — DMA Channel 5; 140 DMA6 — DMA Channel 6; 141 DMA7 — DMA Channel 7; 142 SPI2_FAULT — SPI2 Fault; 143 SPI2_RX — SPI2 Receive Done; 144 SPI2_TX — SPI2 Transmit Done; 145 UART2_FAULT — UART2 Fault; 146 UART2_RX — UART2 Receive Done; 147 UART2_TX — UART2 Transmit Done; 148 I2C2_BUS — I2C2 Bus Collision Event; 149 I2C2_SLAVE — I2C2 Slave Event; 150 I2C2_MASTER — I2C2 Master Event; 151 CAN1 — Control Area Network 1; 152 CAN2 — Control Area Network 2; 153 ETHERNET — Ethernet; 154 SPI3_FAULT — SPI3 Fault; 155 SPI3_RX — SPI3 Receive Done; 156 SPI3_TX — SPI3 Transmit Done; 157 UART3_FAULT — UART3 Fault; 158 UART3_RX — UART3 Receive Done; 159 UART3_TX — UART3 Transmit Done; 160 I2C3_BUS — I2C3 Bus Collision Event; 161 I2C3_SLAVE — I2C3 Slave Event; 162 I2C3_MASTER — I2C3 Master Event; 163 SPI4_FAULT — SPI4 Fault; 164 SPI4_RX — SPI4 Receive Done; 165 SPI4_TX — SPI4 Transmit Done; 166 RTCC — Real Time Clock; 167 FLASH_CONTROL — Flash Control Event; 168 PREFETCH — Prefetch Module SEC Event; 169 SQI1 — SQI1 Event; 170 UART4_FAULT — UART4 Fault; 171 UART4_RX — UART4 Receive Done; 172 UART4_TX — UART4 Transmit Done; 173 I2C4_BUS — I2C4 Bus Collision Event; 174 I2C4_SLAVE — I2C4 Slave Event; 175 I2C4_MASTER — I2C4 Master Event; 176 SPI5_FAULT — SPI5 Fault; 177 SPI5_RX — SPI5 Receive Done; 178 SPI5_TX — SPI5 Transmit Done; 179 UART5_FAULT — UART5 Fault; 180 UART5_RX — UART5 Receive Done; 181 UART5_TX — UART5 Transmit Done; 182 I2C5_BUS — I2C5 Bus Collision Event; 183 I2C5_SLAVE — I2C5 Slave Event; 184 I2C5_MASTER — I2C5 Master Event; 185 SPI6_FAULT — SPI6 Fault; 186 SPI6_RX — SPI6 Receive Done; 187 SPI6_TX — SPI6 Transmit Done; 188 UART6_FAULT — UART6 Fault; 189 UART6_RX — UART6 Receive Done; 190 UART6_TX — UART6 Transmit Done; 192 ADC_EOS — ADC End of Scan Ready; 193 ADC_ARDY — ADC Analog Circuits Ready; 194 ADC_URDY — ADC Update Ready; 196 ADC_EARLY — ADC Group Early Interrupt Request; 198 ADC0_EARLY — ADC0 Early Interrupt Request; 199 ADC1_EARLY — ADC1 Early Interrupt Request; 200 ADC2_EARLY — ADC2 Early Interrupt Request; 201 ADC3_EARLY — ADC3 Early Interrupt Request; 202 ADC4_EARLY — ADC4 Early Interrupt Request; 205 ADC7_EARLY — ADC7 Early Interrupt Request; 206 ADC0_WARM — ADC0 Warm Interrupt Request; 207 ADC1_WARM — ADC1 Warm Interrupt Request; 208 ADC2_WARM — ADC2 Warm Interrupt Request; 209 ADC3_WARM — ADC3 Warm Interrupt Request; 210 ADC4_WARM — ADC4 Warm Interrupt Request; 213 ADC7_WARM — ADC7 Warm Interrupt Request
