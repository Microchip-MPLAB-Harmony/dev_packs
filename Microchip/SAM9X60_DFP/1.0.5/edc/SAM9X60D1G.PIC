# SAM9X60D1G register map
Vendor: Microchip
Architecture arm32bit. Special function registers and configuration words.
Registers are 32-bit, read-write, no defined reset value unless marked. A register's access mark holds for its fields unless they carry their own. Addresses are absolute, and some are shared; only a register's first bit layout is shown; lines under a group give offsets from that group; [hi:lo] are bit positions; {n}, {i} and the like mark numbered series; 'fields as' and 'values as' point back to an identical list; <NAME> marks a mode.

## Further device data
interrupts=0 EXT_FIQ — External FIQ; 1 SYSC — System Controller Interrupt; 2 PIOA — Parallel I/O Controller A; 3 PIOB — Parallel I/O Controller B; 4 PIOC — Parallel I/O Controller C; 5 FLEXCOM0 — FLEXCOM 0; 6 FLEXCOM1 — FLEXCOM 1; 7 FLEXCOM2 — FLEXCOM 2; 8 FLEXCOM3 — FLEXCOM 3; 9 FLEXCOM6 — FLEXCOM 6; 10 FLEXCOM7 — FLEXCOM 7; 11 FLEXCOM8 — FLEXCOM 8; 12 SDMMC0 — Secure Digital Multi Media Card 0; 13 FLEXCOM4 — FLEXCOM 4; 14 FLEXCOM5 — FLEXCOM 5; 15 FLEXCOM9 — FLEXCOM 9; 16 FLEXCOM10 — FLEXCOM 10; 17 TC0 — Timer Counter 0; 18 PWM — Pulse Width Modulation; 19 ADC — Analog to Digital Converter; 20 XDMAC — Extended DMA Controller; 21 MATRIX — Matrix; 22 UHPHS — USB Host High Speed; 23 UDPHS — USB Device High Speed; 24 EMAC0 — Ethernet MAC 0; 25 LCDC — LCD Controller; 26 SDMMC1 — Secure Digital Multi Media Card 1; 27 EMAC1 — Ethernet MAC 1; 28 SSC — Synchronous Serial Controller; 29 CAN0 — Controller Area Network 0; 30 CAN1 — Controller Area Network 1; 31 EXT_IRQ — External IRQ; 32 FLEXCOM11 — FLEXCOM 11; 33 FLEXCOM12 — FLEXCOM 12; 34 I2SMCC — I2S Multi Channel Controller; 35 QSPI — Quad I/O SPI Controller; 36 GFX2D — Graphics 2D Controller; 37 PIT64B — Periodic Interval Timer 64-bit ; 38 TRNG — True Random Number Generator; 39 AES — Advanced Encryption Standard; 40 TDES — Triple Data Encryption Standard; 41 SHA — Secure Hash Algorithm; 42 CLASSD — Class D Controller; 43 ISI — Image Sensor Interface; 44 PIOD — Parallel I/O D; 45 TC1 — Timer Counter 1; 46 OTPC — One Time Programmable Controller; 47 DBGU — Debug Unit; 48 ECC — ECC Controller; 49 MC — Memory Controller
