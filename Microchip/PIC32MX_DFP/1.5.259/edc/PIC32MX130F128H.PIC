# PIC32MX130F128H register map
Vendor: Microchip
Architecture 32xxxx. Special function registers and configuration words.
Registers are 32-bit, read-write, reset 0x0 unless marked. A register's access mark holds for its fields unless they carry their own. Addresses are absolute, and some are shared; only a register's first bit layout is shown; lines under a group give offsets from that group; [hi:lo] are bit positions; {n}, {i} and the like mark numbered series; 'fields as' and 'values as' point back to an identical list; <NAME> marks a mode.

## Further device data
pins=1: RE5/PMD5/RPE5/AN22; 2: RE6/PMD6/AN23; 3: RE7/PMD7/AN27; 4: RG6/PMA5/SCK2/RPG6/C1IND/AN16; 5: RG7/PMA4/RPG7/C1INC/AN17; 6: RG8/PMA3/RPG8/C2IND/AN18; 7: MCLR; 8: RG9/PMA2/RPG9/C2INC/AN19; 9: VSS; 10: VDD; 11: RB5/RPB5/C1INA/AN5; 12: RB4/C1INB/AN4; 13: RB3/RPB3/C2INA/AN3/PGED3; 14: RB2/CTED13/RPB2/C2INB/CTCMP/AN2/PGEC3; 15: RB1/CTED12/RPB1/AN1/VREF-/PGEC1; 16: RB0/PMA6/RPB0/AN0/VREF+/PGED1; 17: RB6/RPB6/AN6/PGEC2; 18: RB7/CTED3/RPB7/AN7/PGED2; 19: AVDD; 20: AVSS; 21: RB8/CTED10/RPB8/AN8; 22: RB9/PMA7/CTED4/RPB9/AN9; 23: RB10/PMA13/CTED11/RPB10/AN10/CVREFOUT/TMS; 24: RB11/PMA12/AN11/TDO; 25: VSS; 26: VDD; 27: RB12/PMA11/AN12/TCK; 28: RB13/PMA10/AN13/TDI; 29: RB14/PMA1/CTED5/SCK3/RPB14/AN14; 30: RB15/PMA0/CTED6/OCFB/RPB15/AN15; 31: RF4/PMA9/SDA2/RPF4; 32: RF5/PMA8/SCL2/RPF5; 33: RF3/RPF3; 34: RF2/RPF2; 35: RF6/INT0/SCK1/RPF6; 36: RG3/SDA1; 37: RG2/SCL1; 38: VDD; 39: RC12/CLKI/OSC1; 40: RC15/CLKO/OSC2; 41: VSS; 42: RD8/RTCC/RPD8; 43: RD9/RPD9; 44: RD10/PMA15/RPD10; 45: RD11/PMA14/RPD11; 46: RD0/RPD0; 47: RC13/RPC13/SOSCI; 48: RC14/T1CK/RPC14/SOSCO; 49: RD1/RPD1/AN24; 50: RD2/RPD2/AN25; 51: RD3/RPD3/C3IND/AN26; 52: RD4/PMWR/RPD4; 53: RD5/PMRD/RPD5; 54: RD6/C3INC; 55: RD7/C3INB; 56: VCAP; 57: VDD; 58: RF0/RPF0/C3INA; 59: RF1/RPF1; 60: RE0/PMD0; 61: RE1/PMD1; 62: RE2/PMD2/AN20; 63: RE3/PMD3/CTPLS/RPE3; 64: RE4/PMD4/AN21, interrupts=0 CORE_TIMER — Core Timer; 1 CORE_SOFTWARE_0 — Core Software 0; 2 CORE_SOFTWARE_1 — Core Software 1; 3 EXTERNAL_0 — Ext INT 0; 4 TIMER_1 — Timer1; 5 INPUT_CAPTURE_1 — Input Capture 1; 6 OUTPUT_COMPARE_1 — Output Compare 1; 7 EXTERNAL_1 — Ext INT 1; 8 TIMER_2 — Timer2; 9 INPUT_CAPTURE_2 — Input Capture 2; 10 OUTPUT_COMPARE_2 — Output Compare 2; 11 EXTERNAL_2 — Ext INT 2; 12 TIMER_3 — Timer3; 13 INPUT_CAPTURE_3 — Input Capture 3; 14 OUTPUT_COMPARE_3 — Output Compare 3; 15 EXTERNAL_3 — Ext INT 3; 16 TIMER_4 — Timer4; 17 INPUT_CAPTURE_4 — Input Capture 4; 18 OUTPUT_COMPARE_4 — Output Compare 4; 19 EXTERNAL_4 — Ext INT 4; 20 TIMER_5 — Timer5; 21 INPUT_CAPTURE_5 — Input Capture 5; 22 OUTPUT_COMPARE_5 — Output Compare 5; 23 ADC — ADC; 24 FAIL_SAFE_MONITOR — Fail Safe Clock Monitor; 25 RTCC — Real Time Clock Calendar; 26 FCE — Flash Control Event; 27 COMPARATOR_1 — Comparator 1; 28 COMPARATOR_2 — Comparator 2; 29 USB_1 — USB Module 1; 30 SPI_1 — SPI1; 31 UART_1 — UART 1; 32 I2C_1 — I2C 1; 33 CHANGE_NOTICE — Change Notice; 34 PMP — PMP; 35 SPI_2 — SPI 2; 36 UART_2 — UART 2; 37 I2C_2 — I2C 2; 38 UART_3 — UART 3; 39 UART_4 — UART 4; 40 UART_5 — UART 5; 41 CTMU — CTMU Event; 42 DMA_0 — DMA Channel 0; 43 DMA_1 — DMA Channel 1; 44 DMA_2 — DMA Channel 2; 45 DMA_3 — DMA Channel 3; 46 COMPARATOR_3 — Comparator 3; 47 CAN_1 — CAN 1; 48 SPI_3 — SPI 3; 49 SPI_4 — SPI 4
