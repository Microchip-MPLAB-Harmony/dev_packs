# WBZ351 register map
Vendor: Microchip
Registers are 32-bit, read-write, reset 0x0 unless marked. A register's access mark holds for its fields unless they carry their own. Addresses are absolute, and some are shared; only a register's first bit layout is shown; [hi:lo] are bit positions; {n}, {i} and the like mark numbered series; 'fields as' and 'values as' point back to an identical list.

## PPS
0x44001000 EXTINT0R
  [3:0] EXTINT0
    15=RPA9; 1=RPA3; 2=RPA7; 3=RPA11; 4=RPB0; 5=RPB4; 6=RPB8; 7=RPB12; 8=RPA2; 9=RPA6; 10=RPA10; 11=RPA14; 12=RPB3; 13=RPB7; 14=RPB11; 0=OFF
0x44001004 EXTINT1R
  [3:0] EXTINT1
    15=RPA0; 1=RPA4; 2=RPA8; 3=RPA12; 4=RPB1; 5=RPB5; 6=RPB9; 7=RPB13; 8=RPA3; 9=RPA7; 10=RPA11; 11=RPB0; 12=RPB4; 13=RPB8; 14=RPB12; 0=OFF
0x44001008 EXTINT2R
  [3:0] EXTINT2
    15=RPA1; 1=RPA5; 2=RPA9; 3=RPA13; 4=RPB2; 5=RPB6; 6=RPB10; 7=RPA0; 8=RPA4; 9=RPA8; 10=RPA12; 11=RPB1; 12=RPB5; 13=RPB9; 14=RPB13; 0=OFF
0x4400100C EXTINT3R
  [3:0] EXTINT3
    15=RPA2; 1=RPA6; 2=RPA10; 3=RPA14; 4=RPB3; 5=RPB7; 6=RPB11; 7=RPA1; 8=RPA5; 9=RPA9; 10=RPA13; 11=RPB2; 12=RPB6; 13=RPB10; 14=RPA8; 0=OFF
0x4400103C NMIR
  [3:0] NMI
    values as EXTINT3R.EXTINT3
0x44001040 SCOM0P0R
  [3:0] SCOM0P0 — SERCOM0/PAD0
    values as EXTINT1R.EXTINT1
0x44001044 SCOM0P1R
  [3:0] SCOM0P1 — SERCOM0/PAD1
    1=RPA3; 2=RPA5; 3=RPA6; 4=RPA7; 5=RPB5; 6=RPB6; 7=RPB8; 8=RPB9; 0=OFF
0x44001048 SCOM0P2R
  [3:0] SCOM0P2 — SERCOM0/PAD2
    values as EXTINT3R.EXTINT3
0x4400104C SCOM0P3R
  [3:0] SCOM0P3 — SERCOM0/PAD3
    values as EXTINT0R.EXTINT0
0x44001050 SCOM1P0R
  [3:0] SCOM1P0 — SERCOM1/PAD0
    values as EXTINT2R.EXTINT2
0x44001054 SCOM1P1R
  [3:0] SCOM1P1 — SERCOM1/PAD1
    values as SCOM0P1R.SCOM0P1
0x44001058 SCOM1P2R
  [3:0] SCOM1P2 — SERCOM1/PAD2
    values as EXTINT0R.EXTINT0
0x4400105C SCOM1P3R
  [3:0] SCOM1P3 — SERCOM1/PAD3
    values as EXTINT1R.EXTINT1
0x44001084 QD0R
  [3:0] QD0 — QSPI/DATA0
    values as EXTINT3R.EXTINT3
0x44001088 QD1R
  [3:0] QD1 — QSPI/DATA1
    values as EXTINT0R.EXTINT0
0x4400108C QD2R
  [3:0] QD2 — QSPI/DATA2
    values as EXTINT1R.EXTINT1
0x44001090 QD3R
  [3:0] QD3 — QSPI/DATA3
    values as EXTINT2R.EXTINT2
0x44001094 REFIR
  [3:0] REFI
    values as SCOM0P1R.SCOM0P1
0x44001098 CCLIN0R
  [3:0] CCLIN0
    values as EXTINT0R.EXTINT0
0x4400109C CCLIN1R
  [3:0] CCLIN1
    values as EXTINT1R.EXTINT1
0x440010A0 CCLIN2R
  [3:0] CCLIN2
    values as EXTINT2R.EXTINT2
0x440010A4 CCLIN3R
  [3:0] CCLIN3
    values as EXTINT0R.EXTINT0
0x440010A8 CCLIN4R
  [3:0] CCLIN4
    values as EXTINT1R.EXTINT1
0x440010AC CCLIN5R
  [3:0] CCLIN5
    values as EXTINT2R.EXTINT2
0x440010B0 TC0WO0G1R
  [3:0] TC0WO0 — TC0/WO0G1
    values as EXTINT0R.EXTINT0
0x440010B4 TC0WO0G2R
  [3:0] TC0WO0 — TC0/WO0G2
    values as EXTINT1R.EXTINT1
0x440010B8 TC0WO1G3R
  [3:0] TC0WO1 — TC0/WO1G3
    values as EXTINT2R.EXTINT2
0x440010BC TC0WO1G4R
  [3:0] TC0WO1 — TC0/WO1G4
    values as EXTINT3R.EXTINT3
0x440010C0 TC1WO0G1R
  [3:0] TC1WO0 — TC1/WO0G1
    values as EXTINT0R.EXTINT0
0x440010C4 TC1WO1G2R
  [3:0] TC1WO1 — TC1/WO1G2
    values as EXTINT1R.EXTINT1
{0x440010A8+0x10*i} TC{i}WO0G1R (i=2..7)
  [3:0] TC{i}WO0 — TC{i}/WO0G1
    values as EXTINT0R.EXTINT0
{0x440010AC+0x10*i} TC{i}WO0G3R (i=2..7)
  [3:0] TC{i}WO0 — TC{i}/WO0G3
    values as EXTINT2R.EXTINT2
{0x440010B0+0x10*i} TC{i}WO1G2R (i=2..7)
  [3:0] TC{i}WO1 — TC{i}/WO1G2
    values as EXTINT1R.EXTINT1
{0x440010B4+0x10*i} TC{i}WO1G4R (i=2..7)
  [3:0] TC{i}WO1 — TC{i}/WO1G4
    values as EXTINT3R.EXTINT3
0x44001200 RPA0G2R
  [4:0] RPA0G2R — RPA0/G2
    0=OFF; 1=SCOM0P0 (SERCOM0/PAD0); 2=SCOM0P3 (SERCOM0/PAD3); 3=SCOM0P2 (SERCOM0/PAD2); 5=SCOM1P3 (SERCOM1/PAD3); 6=SCOM1P2 (SERCOM1/PAD2); 7=TCC0WO1; 8=TCC0WO5; 9=TCC0WO3; 10=TCC1WO1; 11=TCC1WO5; 12=TCC1WO3; 13=TCC2WO1; {v}=TC{v-15}WO1 (v=15..22); 23=QSPICS; 24=QD0; 25=QD3; 26=QD2; 27=CCLOUT1; 28=TSTBUS0; 29=TSTBUS3; 30=TSTBUS6; 31=TSTBUS9
0x44001204 RPA0G3R
  [4:0] RPA0G3R — RPA0/G3
    0=OFF; 2=SCOM0P0 (SERCOM0/PAD0); 3=SCOM0P3 (SERCOM0/PAD3); 4=SCOM1P2 (SERCOM1/PAD2); 6=SCOM1P3 (SERCOM1/PAD3); 7=TCC0WO2; 8=TCC0WO0; 9=TCC0WO4; 10=TCC1WO2; 11=TCC1WO0; 12=TCC1WO4; 13=TCC2WO0; {v}=TC{v-15}WO0 (v=15..22); 23=QCS; 24=QD1; 25=QD0; 26=QD3; 27=CCLOUT0; 28=TSTBUS1; 29=TSTBUS4; 30=TSTBUS7; 31=TSTBUS10
0x44001208 RPA1G3R
  [4:0] RPA1G3R — RPA1/G3
    values as RPA0G3R.RPA0G3R
0x4400120C RPA1G4R
  [4:0] RPA1G4R — RPA1/G4
    0=OFF; 1=SCOM0P2 (SERCOM0/PAD2); 3=SCOM0P0 (SERCOM0/PAD0); 4=SCOM1P3 (SERCOM1/PAD3); 6=SCOM1P0 (SERCOM1/PAD0); 7=TCC0WO3; 8=TCC0WO1; 9=TCC0WO5; 10=TCC1WO3; 11=TCC1WO1; 12=TCC1WO5; 13=TCC2WO1; 15=TC0WO0; {v}=TC{v-15}WO1 (v=16..22); 23=QCS; 24=QD2; 25=QD1; 26=QD0; 27=CCLOUT1; 28=TSTBUS2; 29=TSTBUS5; 30=TSTBUS8; 31=TSTBUS11
0x44001214 RPA2G4R
  [4:0] RPA2G4R — RPA2/G4
    values as RPA1G4R.RPA1G4R
0x44001218 RPA3G1R
  [4:0] RPA3G1R — RPA3/G1
    0=OFF; 1=SCOM0P1 (SERCOM0/PAD1); 2=SCOM1P1 (SERCOM1/PAD1); {v}=REFO{v-2} (v=3..6); 7=QSCK
0x4400121C RPA3G2R
  [4:0] RPA3G2R — RPA3/G2
    values as RPA0G2R.RPA0G2R
0x44001220 RPA3G3R
  [4:0] RPA3G3R — RPA3/G3
    values as RPA0G3R.RPA0G3R
0x44001224 RPA4G2R
  [4:0] RPA4G2R — RPA4/G2
    values as RPA0G2R.RPA0G2R
0x44001228 RPA4G3R
  [4:0] RPA4G3R — RPA4/G3
    values as RPA0G3R.RPA0G3R
{0x440011FC+0xC*i} RPA{i}G4R (i=4..6)
  [4:0] RPA{i}G4R — RPA{i}/G4
    values as RPA1G4R.RPA1G4R
{0x440011F4+0xC*i} RPA{i}G1R (i=5..7)
  [4:0] RPA{i}G1R — RPA{i}/G1
    values as RPA3G1R.RPA3G1R
0x44001234 RPA5G3R
  [4:0] RPA5G3R — RPA5/G3
    values as RPA0G3R.RPA0G3R
0x44001240 RPA6G2R
  [4:0] RPA6G2R — RPA6/G2
    values as RPA0G2R.RPA0G2R
0x4400124C RPA7G2R
  [4:0] RPA7G2R — RPA7/G2
    values as RPA0G2R.RPA0G2R
0x44001250 RPA8G2R
  [4:0] RPA8G2R — RPA8/G2
    values as RPA0G2R.RPA0G2R
0x44001254 RPA8G3R
  [4:0] RPA8G3R — RPA8/G3
    values as RPA0G3R.RPA0G3R
0x44001258 RPA8G4R
  [4:0] RPA8G4R — RPA8/G4
    values as RPA1G4R.RPA1G4R
0x44001260 RPA9G3R
  [4:0] RPA9G3R — RPA9/G3
    values as RPA0G3R.RPA0G3R
0x44001264 RPA9G4R
  [4:0] RPA9G4R — RPA9/G4
    values as RPA1G4R.RPA1G4R
0x4400126C RPA10G4R
  [4:0] RPA10G4R — RPA10/G4
    values as RPA1G4R.RPA1G4R
0x44001278 RPA13G3R
  [4:0] RPA13G3R — RPA13/G3
    values as RPA0G3R.RPA0G3R
0x4400127C RPA13G4R
  [4:0] RPA13G4R — RPA13/G4
    values as RPA1G4R.RPA1G4R
0x44001284 RPA14G4R
  [4:0] RPA14G4R — RPA14/G4
    values as RPA1G4R.RPA1G4R
0x44001290 RPB0G2R
  [4:0] RPB0G2R — RPB0/G2
    values as RPA0G2R.RPA0G2R
0x44001294 RPB1G2R
  [4:0] RPB1G2R — RPB1/G2
    values as RPA0G2R.RPA0G2R
0x44001298 RPB1G3R
  [4:0] RPB1G3R — RPB1/G3
    values as RPA0G3R.RPA0G3R
0x4400129C RPB2G3R
  [4:0] RPB2G3R — RPB2/G3
    values as RPA0G3R.RPA0G3R
0x440012A0 RPB2G4R
  [4:0] RPB2G4R — RPB2/G4
    values as RPA1G4R.RPA1G4R
0x440012A8 RPB3G4R
  [4:0] RPB3G4R — RPB3/G4
    values as RPA1G4R.RPA1G4R
0x440012B0 RPB4G2R
  [4:0] RPB4G2R — RPB4G2
    values as RPA0G2R.RPA0G2R
0x440012B4 RPB5G2R
  [4:0] RPB5G2R — RPB5/G2
    values as RPA0G2R.RPA0G2R
0x440012B8 RPB5G1R
  [4:0] RPB5G1R — RPB5/G1
    values as RPA3G1R.RPA3G1R
0x440012BC RPB6G3R
  [4:0] RPB6G3R — RPB6/G3
    values as RPA0G3R.RPA0G3R
0x440012C0 RPB6G1R
  [4:0] RPB6G1R — RPB6/G1
    values as RPA3G1R.RPA3G1R
{0x4400128C+8i} RPB{i}G1R (i=7..9)
  [4:0] RPB{i}G1R — RPB{i}/G1
    values as RPA3G1R.RPA3G1R
0x440012C8 RPB7G4R
  [4:0] RPB7G4R — RPB7/G4
    values as RPA1G4R.RPA1G4R
0x440012D0 RPB8G2R
  [4:0] RPB8G2R — RPB8/G2
    values as RPA0G2R.RPA0G2R
0x440012D8 RPB9G3R
  [4:0] RPB9G3R — RPB9/G3
    values as RPA0G3R.RPA0G3R
0x440012DC RPB10G3R
  [4:0] RPB10G3R — RPB10/G3
    values as RPA0G3R.RPA0G3R
0x440012E0 RPB10G4R
  [4:0] RPB10G4R — RPB10/G4
    values as RPA1G4R.RPA1G4R
0x440012E8 RPB11G4R
  [4:0] RPB11G4R — RPB11/G4
    values as RPA1G4R.RPA1G4R
0x440012F0 RPB12G2R
  [4:0] RPB12G2R — RPB12/G2
    values as RPA0G2R.RPA0G2R
0x440012F4 RPB13G2R
  [4:0] RPB13G2R — RPB13/G2
    values as RPA0G2R.RPA0G2R
0x440012F8 RPB13G3R
  [4:0] RPB13G3R — RPB13/G3
    values as RPA0G3R.RPA0G3R
