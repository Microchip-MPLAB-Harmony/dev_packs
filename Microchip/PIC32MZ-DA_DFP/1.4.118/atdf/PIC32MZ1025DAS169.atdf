# PIC32MZ1025DAS169 device description
Architecture: MIPS; Family: PIC32MZDA; Series: PIC32MZ
Parameters: __MPU_PRESENT=1 (MPU present or not), __INT_PRIO_LEVELS=7 (Number of interrupt priority levels), __INT_SUBPRIO_LEVELS=4 (Number of interrupt subpriority levels), __INT_NUM_SHADOW_SETS=7 (Number of interrupt shadow register sets), __VTOR_PRESENT=1 (Vector Table Offset Register present or not), __FPU_PRESENT=1 (FPU present or not), __FPU_DP=1 (Double Precision FPU implemented or not), __ICACHE_PRESENT=1 (Instruction Cache present or not), __DCACHE_PRESENT=1 (Data Cache present or not), __ITCM_PRESENT=0 (Instruction TCM present or not), __DTCM_PRESENT=0 (Data TCM present or not), LITTLE_ENDIAN=1 (Little endian used or not), __NUM_OSC=7 (Number of oscillators present), __SYS_DEF_FREQ=200000000 (System Clock Default Frequency), __PB1_DEF_FREQ=100000000 (Peripheral Bus 1 Default Clock Frequency), __PB2_DEF_FREQ=100000000 (Peripheral Bus 2 Default Clock Frequency), __PB3_DEF_FREQ=100000000 (Peripheral Bus 3 Default Clock Frequency), __PB4_DEF_FREQ=100000000 (Peripheral Bus 4 Default Clock Frequency), __PB5_DEF_FREQ=100000000 (Peripheral Bus 5 Default Clock Frequency), __PB6_DEF_FREQ=100000000 (Peripheral Bus 6 Default Clock Frequency), __PB7_DEF_FREQ=200000000 (Peripheral Bus 7 Default Clock Frequency), __REFCLK1_DEF_FREQ=200000000 (Reference Clock 1 Default Frequency), __REFCLK2_DEF_FREQ=200000000 (Reference Clock 2 Default Frequency), __REFCLK3_DEF_FREQ=200000000 (Reference Clock 3 Default Frequency), __REFCLK4_DEF_FREQ=200000000 (Reference Clock 4 Default Frequency), __REFCLK5_DEF_FREQ=200000000 (Reference Clock 5 Default Frequency), __POSC_DEF_FREQ=24000000 (Primary Oscillator Input Default Frequency), __SOSC_DEF_FREQ=32768 (Secondary Oscillator Input Default Frequency), __PB1_DEF_DIV=2 (Peripheral Bus 1 Default Divider Value), __PB2_DEF_DIV=2 (Peripheral Bus 2 Default Divider Value), __PB3_DEF_DIV=2 (Peripheral Bus 3 Default Divider Value), __PB4_DEF_DIV=2 (Peripheral Bus 4 Default Divider Value), __PB5_DEF_DIV=2 (Peripheral Bus 5 Default Divider Value), __PB6_DEF_DIV=2 (Peripheral Bus 6 Default Divider Value), __PB7_DEF_DIV=1 (Peripheral Bus 7 Default Divider Value), __ARCH_ARM=0 (ARM architecture or not), __NUM_DMA_CHANNELS=8 (Number of DMA Channels)
Programming and debug interfaces: JTAG, SWD
Registers are 32-bit, read-write, no defined reset value unless marked. A register's access mark holds for its fields unless they carry their own. Offsets are from the block's base; lines under a group give offsets from that group; [hi:lo] are bit positions; {n}, {i} and the like mark numbered series; 'fields as' and 'values as' point back to an identical list; <NAME> marks a mode.

## Ordering variants
PIC32MZ1025DAS169: LFBGA169, up to 200 MHz, -40 to +85 C, 2.2 to 3.6 V

## Memory
base space: start 0 size 0x100000000, little endian
  0xff300000 emulation size 0x100000
  0xffffffff devid size 0x0
  0x1d000000 code size 0x100000 flash, rw, executable
  0x1fc74000 testmem size 0x4000
  0x1fc40000 boot1 size 0xff00 flash, executable
  0x1fc50000 boot1lastpage size 0x4000
  0x1fc60000 boot2 size 0xff00
  0x1fc70000 boot2lastpage size 0x4000
  0x1fc20000 upperbootalias size 0xff00
  0x1fc30000 upperbootaliaslastpage size 0x4000
  0x1fc00000 lowerbootalias size 0xff00
  0x1fc10000 lowerbootaliaslastpage size 0x4000
  0x1fc0ff30 lowerbootaliasaltconfig size 0x50
  0x1fc2ff30 upperbootaliasaltconfig size 0x50
  0x1fc2ffb0 upperbootaliasconfig size 0x50
  0x1fc4ff30 altboot1config size 0x50
  0x1fc4ffb0 boot1config size 0x50
  0x1fc6ff30 altboot2config size 0x50
  0x1fc6ffb0 boot2config size 0x50
  0x0 kseg0_data_mem size 0x40000
  0x20000000 ebi_data_mem size 0x4000000
  0x30000000 sqi_data_mem size 0x4000000
  0x1f800000 periph_pb1_std size 0x1a00
  0x1f810000 periph_pb1_fast size 0x2000
  0x1f820000 periph_pb2_std size 0x10000
  0x1f840000 periph_pb3_std size 0xc400
  0x1f860000 periph_pb4_std size 0xa00
  0x1f880000 periph_pb5_std size 0x5000
  0x1f8c0000 periph_pb6_std size 0x400
  0x1f8e0000 periph_indep size 0xd000
  0x1f8f0000 periph_ssx0 size 0x10000
  0x1f900000 periph_ssx1 size 0x10000
  0x1f910000 periph_ssx2 size 0x10000
  0x1f920000 periph_ssx3 size 0x10000
  0x08000000 ddr_data_mem size 0x2000000
lowerbootaliasconfig space: start 0x1fc0ffb0 size 0x50
serial space: start 0x1FC54000 size 0x28

## Peripheral instances (address, pins/pin function, parameters)
ADCHS at 0x1f84b000 in periph_pb3_std
CAN1 at CAN 0x1f880000 in periph_pb5_std
CAN2
CFG at 0x1f800000 in periph_pb1_std
CMP at 0x1f84c000 in periph_pb3_std
CORE at 0x0
CRU at 0x1f801200 in periph_pb1_std
RCON at 0x1f801200 in periph_pb1_std
CRYPTO at 0x1f8e5000 in periph_indep
CTMU at 0x1f84c200 in periph_pb3_std
CVR at 0x1f800e00 in periph_pb1_std
DDR at 0x1f8e8000 in periph_indep
DDR_PHY at 0x1f8e9100 in periph_indep
DMAC at 0x1f811000 in periph_pb1_fast
DMT at 0x1f800a00 in periph_pb1_std
DSCTRL at 0x1f8c0200 in periph_pb6_std
EBI at 0x1f8e1014 in periph_indep
ETH at 0x1f882000 in periph_pb5_std
GLCD at 0x1f8ea000 in periph_indep
GPIO at 0x1f860000 in periph_pb4_std
GPU at 0x1f8eb000 in periph_indep
HLVD at 0x1f801800 in periph_pb1_std
I2C{n} (n=1..5)
ICAP{n} (n=1..3)
  parameters: TMR_SRC_0=0 (Timer 3), TMR_SRC_1=1 (Timer 2), TMR_ALTERNATE_SRC_0=0 (Timer 5), TMR_ALTERNATE_SRC_1=1 (Timer 4)
ICAP{n} (n=4..6)
  parameters: TMR_SRC_0=0 (Timer 3), TMR_SRC_1=1 (Timer 2), TMR_ALTERNATE_SRC_0=0 (Timer 3), TMR_ALTERNATE_SRC_1=1 (Timer 2)
ICAP7
  parameters: TMR_SRC_0=0 (Timer 3), TMR_SRC_1=1 (Timer 2), TMR_ALTERNATE_SRC_0=0 (Timer 7), TMR_ALTERNATE_SRC_1=1 (Timer 6)
ICAP8
  parameters: TMR_SRC_0=0 (Timer 3), TMR_SRC_1=1 (Timer 2), TMR_ALTERNATE_SRC_0=0 (Timer 7), TMR_ALTERNATE_SRC_1=1 (Timer 6)
ICAP9 at ICAP 0x1f842000 in periph_pb3_std
  parameters: TMR_SRC_0=0 (Timer 3), TMR_SRC_1=1 (Timer 2), TMR_ALTERNATE_SRC_0=0 (Timer 7), TMR_ALTERNATE_SRC_1=1 (Timer 6)
INT at 0x1f810000 in periph_pb1_fast
JTAG at 0x1f801130 in periph_pb1_std
NVM at 0x1f800600 in periph_pb1_std
  parameters: PAGE_SIZE=16384, ROW_SIZE=2048
OCMP1 at OCMP 0x1f844000 in periph_pb3_std
  parameters: TMR_SRC_0=0 (Timer 2), TMR_SRC_1=1 (Timer 3), TMR_ALTERNATE_SRC_0=0 (Timer 4), TMR_ALTERNATE_SRC_1=1 (Timer 5)
OCMP2
  parameters: TMR_SRC_0=0 (Timer 2), TMR_SRC_1=1 (Timer 3), TMR_ALTERNATE_SRC_0=0 (Timer 4), TMR_ALTERNATE_SRC_1=1 (Timer 5)
OCMP3
  parameters: TMR_SRC_0=0 (Timer 2), TMR_SRC_1=1 (Timer 3), TMR_ALTERNATE_SRC_0=0 (Timer 4), TMR_ALTERNATE_SRC_1=1 (Timer 5)
OCMP{n} (n=4..6)
  parameters: TMR_SRC_0=0 (Timer 2), TMR_SRC_1=1 (Timer 3), TMR_ALTERNATE_SRC_0=0 (Timer 2), TMR_ALTERNATE_SRC_1=1 (Timer 3)
OCMP{n} (n=7..9)
  parameters: TMR_SRC_0=0 (Timer 2), TMR_SRC_1=1 (Timer 3), TMR_ALTERNATE_SRC_0=0 (Timer 6), TMR_ALTERNATE_SRC_1=1 (Timer 7)
PCACHE at 0x1f8e0000 in periph_indep
PMP at 0x1f82e000 in periph_pb2_std
RNG at 0x1f8e6000 in periph_indep
RPIN at 0x1f801404 in periph_pb1_std
RPOUT at 0x1f801538 in periph_pb1_std
RTCC at 0x1f8c0000 in periph_pb6_std
SB at 0x1f8f8020 in periph_ssx0
SDHC at 0x1f8ec004 in periph_indep
SPI1 at SPI 0x1f821000 in periph_pb2_std
SPI{n} (n=2..6)
SQI1 at SQI 0x1f8e2000 in periph_indep
TMR1 at 0x1f840000 in periph_pb3_std
TMR2 at 0x1f840200 in periph_pb3_std
TMR{n} (n=3..9)
UART1 at UART 0x1f822000 in periph_pb2_std
UART{n} (n=2..6)
USB at 0x1f8e3000 in periph_indep
USBCLKRST at 0x1f8e4000 in periph_pb5_std
WDT at 0x1f800800 in periph_pb1_std

## Interrupts
0 CORE_TIMER
1 CORE_SOFTWARE_0
2 CORE_SOFTWARE_1
3 EXTERNAL_0 — Ext INT 0
4 TIMER_1
5 INPUT_CAPTURE_1_ERROR
6 INPUT_CAPTURE_1
7 OUTPUT_COMPARE_1
8 EXTERNAL_1 — Ext INT 1
9 TIMER_2
10 INPUT_CAPTURE_2_ERROR
11 INPUT_CAPTURE_2
12 OUTPUT_COMPARE_2
13 EXTERNAL_2 — Ext INT 2
14 TIMER_3
15 INPUT_CAPTURE_3_ERROR
16 INPUT_CAPTURE_3
17 OUTPUT_COMPARE_3
18 EXTERNAL_3 — Ext INT 3
19 TIMER_4
20 INPUT_CAPTURE_4_ERROR
21 INPUT_CAPTURE_4
22 OUTPUT_COMPARE_4
23 EXTERNAL_4 — Ext INT 4
24 TIMER_5
25 INPUT_CAPTURE_5_ERROR
26 INPUT_CAPTURE_5
27 OUTPUT_COMPARE_5
28 TIMER_6
29 INPUT_CAPTURE_6_ERROR
30 INPUT_CAPTURE_6
31 OUTPUT_COMPARE_6
32 TIMER_7
33 INPUT_CAPTURE_7_ERROR
34 INPUT_CAPTURE_7
35 OUTPUT_COMPARE_7
36 TIMER_8
37 INPUT_CAPTURE_8_ERROR
38 INPUT_CAPTURE_8
39 OUTPUT_COMPARE_8
40 TIMER_9
41 INPUT_CAPTURE_9_ERROR
42 INPUT_CAPTURE_9
43 OUTPUT_COMPARE_9
44 ADC — ADC Global
45 ADC_FIFO
46 ADC_DC1 — ADC Digital Comparator 1
47 ADC_DC2 — ADC Digital Comparator 2
48 ADC_DC3 — ADC Digital Comparator 3
49 ADC_DC4 — ADC Digital Comparator 4
50 ADC_DC5 — ADC Digital Comparator 5
51 ADC_DC6 — ADC Digital Comparator 6
52 ADC_DF1 — ADC Digital Filter 1
53 ADC_DF2 — ADC Digital Filter 2
54 ADC_DF3 — ADC Digital Filter 3
55 ADC_DF4 — ADC Digital Filter 4
56 ADC_DF5 — ADC Digital Filter 5
57 ADC_DF6 — ADC Digital Filter 6
58 ADC_FAULT
{n+59} ADC_DATA{n} (n=0..43)
103 USB_SR — USB Suspend/Resume
104 CORE_PERF_COUNT — Core Performance Counter
105 CORE_FAST_DEBUG_CHAN — Core Fast Debug Channel
106 SYSTEM_BUS_PROTECTION — System Bus Protection Violation
107 CRYPTO — Crypto Engine Event
109 SPI1_FAULT
110 SPI1_RX — SPI1 Receive Done
111 SPI1_TX — SPI1 Transmit Done
112 UART1_FAULT
113 UART1_RX — UART1 Receive Done
114 UART1_TX — UART1 Transmit Done
115 I2C1_BUS — I2C1 Bus Collision Event
116 I2C1_SLAVE — I2C1 Slave Event
117 I2C1_MASTER — I2C1 Master Event
118 CHANGE_NOTICE_A — PORTA Input Change
119 CHANGE_NOTICE_B — PORTB Input Change
120 CHANGE_NOTICE_C — PORTC Input Change
121 CHANGE_NOTICE_D — PORTD Input Change
122 CHANGE_NOTICE_E — PORTE Input Change
123 CHANGE_NOTICE_F — PORTF Input Change
124 CHANGE_NOTICE_G — PORTG Input Change
125 CHANGE_NOTICE_H — PORTH Input Change
126 CHANGE_NOTICE_J — PORTJ Input Change
127 CHANGE_NOTICE_K — PORTK Input Change
128 PMP — Parallel Master Port
129 PMP_ERROR — Parallel Master Port Error
130 COMPARATOR_1
131 COMPARATOR_2
132 USB — USB General Event
133 USB_DMA — USB DMA Event
{n+134} DMA{n} (n=0..7) — DMA Channel {n}
142 SPI2_FAULT
143 SPI2_RX — SPI2 Receive Done
144 SPI2_TX — SPI2 Transmit Done
145 UART2_FAULT
146 UART2_RX — UART2 Receive Done
147 UART2_TX — UART2 Transmit Done
148 I2C2_BUS — I2C2 Bus Collision Event
149 I2C2_SLAVE — I2C2 Slave Event
150 I2C2_MASTER — I2C2 Master Event
151 CAN1 — Control Area Network 1
152 CAN2 — Control Area Network 2
153 ETHERNET
154 SPI3_FAULT
155 SPI3_RX — SPI3 Receive Done
156 SPI3_TX — SPI3 Transmit Done
157 UART3_FAULT
158 UART3_RX — UART3 Receive Done
159 UART3_TX — UART3 Transmit Done
160 I2C3_BUS — I2C3 Bus Collision Event
161 I2C3_SLAVE — I2C3 Slave Event
162 I2C3_MASTER — I2C3 Master Event
163 SPI4_FAULT
164 SPI4_RX — SPI4 Receive Done
165 SPI4_TX — SPI4 Transmit Done
166 RTCC — Real Time Clock
167 FLASH_CONTROL — Flash Control Event
168 PREFETCH — Prefetch Module SEC Event
169 SQI1 — SQI1 Event
170 UART4_FAULT
171 UART4_RX — UART4 Receive Done
172 UART4_TX — UART4 Transmit Done
173 I2C4_BUS — I2C4 Bus Collision Event
174 I2C4_SLAVE — I2C4 Slave Event
175 I2C4_MASTER — I2C4 Master Event
176 SPI5_FAULT
177 SPI5_RX — SPI5 Receive Done
178 SPI5_TX — SPI5 Transmit Done
179 UART5_FAULT
180 UART5_RX — UART5 Receive Done
181 UART5_TX — UART5 Transmit Done
182 I2C5_BUS — I2C5 Bus Collision Event
183 I2C5_SLAVE — I2C5 Slave Event
184 I2C5_MASTER — I2C5 Master Event
185 SPI6_FAULT
186 SPI6_RX — SPI6 Receive Done
187 SPI6_TX — SPI6 Transmit Done
188 UART6_FAULT
189 UART6_RX — UART6 Receive Done
190 UART6_TX — UART6 Transmit Done
191 SDHC — SD Host Controller
192 GLCD — Grapics LCD Controller
193 GPU — Graphics Processing Unit
195 CTMU — Charge Time Measurement Unit
196 ADC_EOS — ADC End of Scan Ready
197 ADC_ARDY — ADC Analog Circuits Ready
198 ADC_URDY — ADC Update Ready
199 ADC0_EARLY — ADC0 Early Interrupt Request
200 ADC1_EARLY — ADC1 Early Interrupt Request
201 ADC2_EARLY — ADC2 Early Interrupt Request
202 ADC3_EARLY — ADC3 Early Interrupt Request
203 ADC4_EARLY — ADC4 Early Interrupt Request
205 ADC_EARLY — ADC Group Early Interrupt Request
206 ADC7_EARLY — ADC7 Early Interrupt Request
207 ADC0_WARM — ADC0 Warm Interrupt Request
208 ADC1_WARM — ADC1 Warm Interrupt Request
209 ADC2_WARM — ADC2 Warm Interrupt Request
210 ADC3_WARM — ADC3 Warm Interrupt Request
211 ADC4_WARM — ADC4 Warm Interrupt Request
214 ADC7_WARM — ADC7 Warm Interrupt Request
215 MPLL_FAULT

## Properties
SIGNATURES: DEVID_DEVID=0x08A43053

## Notices in the file
Copyright (c) 2017 Microchip Technology Inc.
SPDX-License-Identifier: Apache-2.0
Licensed under the Apache License, Version 2.0 (the "License");
you may not use this file except in compliance with the License.
You may obtain a copy of the License at
http://www.apache.org/licenses/LICENSE-2.0
Unless required by applicable law or agreed to in writing, software
distributed under the License is distributed on an "AS IS" BASIS,
WITHOUT WARRANTIES OR CONDITIONS OF ANY KIND, either express or implied.
See the License for the specific language governing permissions and
limitations under the License.
