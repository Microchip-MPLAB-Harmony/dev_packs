# CEC1734_S0_2HW device description
Architecture: CORTEX-M4; Family: CEC173X; Series: CEC
Parameters: __FPU_PRESENT=1, __MPU_PRESENT=1, __CM4_REV=0x0100 (CM4 Core Revision), __NVIC_PRIO_BITS=3 (Number of Bits used for Priority Levels), __Vendor_SysTickConfig=0 (Set to 1 if different SysTick Config is used), __VTOR_PRESENT=1 (Vector Table Offset Regisrer present or not), __ARCH_ARM=1, __ARCH_ARM_CORTEX_M=1, LITTLE_ENDIAN=1, EXTERNAL_APPLICATION_FLASH=1, __REVID=1
Programming and debug interfaces: SWD
Registers are 32-bit, read-write, reset 0x0 unless marked. A register's access mark holds for its fields unless they carry their own. Offsets are from the block's base; lines under a group give offsets from that group; [hi:lo] are bit positions; {n}, {i} and the like mark numbered series; 'fields as' and 'values as' point back to an identical list; <NAME> marks a mode.

## Ordering variants
CEC1734-S0-I/2HW: VFBGA64, pinout CEC1734_S0_2HW, up to 96 MHz, -40 to +85 C, 3.135 to 3.63 V

## Memory
base space: start 0 size 0x100000000, little endian
  0x000C8000 CODE_SRAM size 0x50000 ram, rw, executable
  0x00118000 DATA_SRAM size 0xA000 ram, rw
  0x00122000 BOOTROM_SRAM size 0x6000 ram, rw
  0x00128000 DATA_SRAM2 size 0x10000 ram, rw
  0x00138000 DATA_SRAM3 size 0x10000 ram, rw
  0x20000000 DATA_SRAM_ALIAS size 0x8000 ram, rw
  0x40000000 EC_DEVICE_REGISTERS size 0x80000 io, rw
  0x40080000 GPIO_REGISTERS size 0x10000 io, rw
  0x400F0000 HOST_DEVICE_REGISTERS size 0x100000 io, rw
  0x40100000 CRYPTO_RAM size 0x6000 ram, ro
  0xE000E000 SCS size 0x00001000 io, rw
  0x50000000 EXTERNAL_FLASH size 0x8000000 flash, rw, executable, external

## Peripheral instances (address, pins/pin function, parameters)
PCR at 0x40080100
  pins: nRESET_IN nRESET_IN/A; VCC_PWRGD GPIO057/B; CLK32KHZ_IN GPIO130/B; CLK32KHZ_OUT GPIO201/B; TST_CLK_OUT GPIO253/B
DMA_MAIN at 0x40002400
  parameters: CH_NUM=10 (Number of channels)
DMA_CHAN00 at 0x40002440
  parameters: CRC_ENGINE_PRESENT=1
DMA_CHAN01 at 0x40002480
  parameters: FILL_ENGINE_PRESENT=1
DMA_CHAN02 at 0x400024C0
DMA_CHAN{n:02} at {0x40002440+0x40*n} (DMA_CHAN02) (n=3..9)
ECIA at 0x4000E000
GCR at 0x400FFF00
UART0 at 0x4000C400 (UART)
  pins: UART0_TX GPIO104/B; UART0_RX GPIO105/B
GPIO at 0x40081000
  pins: GPIO000 GPIO000; GPIO002 GPIO002; GPIO003 GPIO003; GPIO004 GPIO004; GPIO012 GPIO012; GPIO013 GPIO013; GPIO015 GPIO015; GPIO016 GPIO016; GPIO020 GPIO020; GPIO021 GPIO021; GPIO022 GPIO022; GPIO023 GPIO023; GPIO026 GPIO026; GPIO027 GPIO027; GPIO030 GPIO030; GPIO031 GPIO031; GPIO034 GPIO034; GPIO046 GPIO046; GPIO047 GPIO047; GPIO050 GPIO050; GPIO053 GPIO053; GPIO055 GPIO055; GPIO056 GPIO056; GPIO057 GPIO057; GPIO063 GPIO063; GPIO104 GPIO104; GPIO105 GPIO105; GPIO106 GPIO106; GPIO107 GPIO107; GPIO112 GPIO112; GPIO127 GPIO127; GPIO130 GPIO130; GPIO132 GPIO132; GPIO140 GPIO140; GPIO143 GPIO143; GPIO144 GPIO144; GPIO145 GPIO145; GPIO146 GPIO146; GPIO147 GPIO147; GPIO150 GPIO150; GPIO156 GPIO156; GPIO157 GPIO157; GPIO170 GPIO170; GPIO201 GPIO201; GPIO202 GPIO202; GPIO203 GPIO203; GPIO204 GPIO204; GPIO223 GPIO223; GPIO224 GPIO224; GPIO227 GPIO227; GPIO250 GPIO250; GPIO253 GPIO253
WDT at 0x40000400
TIMER32_0 at 0x40000C80 (TIMER32)
TIMER32_1 at 0x40000CA0 (TIMER32)
CCT at 0x40001000
  pins: ICT10 GPIO015/C; ICT0 GPIO050/B
HTM0 at 0x40009800 (HTM)
HTM1 at 0x40009820 (HTM)
RTOS at 0x40007400
PWM0 at 0x40005800 (PWM)
  pins: PWM0 GPIO053/B
LED0 at 0x4000B800 (LED)
  pins: LED0 GPIO156/B
LED1 at 0x4000B900 (LED)
  pins: LED1 GPIO157/B
SMB{n} at {0x40004000+0x400*n} (SMB) (n=0..4)
  pins: SDA0 GPIO003/B; SCL0 GPIO004/B; SDA4 GPIO143/B; SCL4 GPIO144/B; SDA6 GPIO132/B; SCL6 GPIO140/B; SDA9 GPIO145/B; SCL9 GPIO146/B; SDA10 GPIO030/B; SCL10 GPIO107/B; SDA15 GPIO147/B; SCL15 GPIO150/B
  parameters: DMA_ID_TARGET={2n} (device number of SMB{n} DMA target trigger), DMA_ID_HOST={2n+1} (device number of SMB{n} DMA host trigger)
QMSPI0 at 0x40070000 (QMSPI)
  pins: QSPI0_CLK GPIO056/B; QSPI0_CS0_n GPIO055/B; QSPI0_CS1_n GPIO002/B; QSPI0_IO0 GPIO223/B; QSPI0_IO1 GPIO224/B; QSPI0_IO2 GPIO227/B; QSPI0_IO3 GPIO016/B; QSPI0_IN_CLK GPIO204/B; QSPI0_IN_CS0_n GPIO020/B; QSPI0_IN_CS1_n GPIO021/B; QSPI0_IN_IO1 GPIO022/B; QSPI0_IN_IO0 GPIO023/B; QSPI0_IN_IO2 GPIO202/B; QSPI0_IN_IO3 GPIO203/B
  parameters: DMA_ID_TX=10 (device number of DMA TX trigger), DMA_ID_RX=11 (device number of DMA RX trigger)
TFDP at 0x40008C00
  pins: TFDP_CLK GPIO104/C or GPIO170/C; TFDP_DATA GPIO105/C; ALT_TFDP_CLK GPIO027/B; ALT_TFDP_DATA GPIO112/C
VTR_REG_BANK at 0x4000A400
EC_REG_BANK at 0x4000FC00
OTP at 0x40082000
SPT0 at 0x40007000 (SPT)
  pins: QSPI0_IN_CLK GPIO204/B; QSPI0_IN_IO1 GPIO022/B; QSPI0_IN_IO0 GPIO023/B; QSPI0_IN_IO2 GPIO202/B; QSPI0_IN_IO3 GPIO203/B; SP0_AP_INTR GPIO053/B
SPT1 at 0x40006C00 (SPT)
  pins: SP1_AP_INTR GPIO034/B
FPU at 0xE000EF30
IMSPI at 0x40220000
NVIC at 0xE000E100
  parameters: NUM_IRQ=32 (Number of interrupt requests), __NVIC_PRIO_BITS=3 (Number of NVIC interrupt priority bits)
SysTick at 0xE000E010
SystemControl at 0xE000E000
PKE_ERR
PKE_END
RNG
AES
HASH
ENV_MON at 0x40200600
SPI_MON0 at 0x40010000 (SPI_MON)
  pins: ALT_VIOL_0 GPIO107/C; SPI0_KILL GPIO000/B; SPI0_RESET_n GPIO000/C; SPI0PER_CS_n GPIO250/B; AP0_RESET_n GPIO106/B; SP0_AP_INTR GPIO026/B; SPIMON_QSPI0_CS1_n GPIO002/C; SPIMON_QSPI0_CS0_n GPIO055/C; QSPI0_CLK_CLAMP GPIO056/C; QSPI0_IO0_CLAMP GPIO223/C; QSPI0_IO1_CLAMP GPIO224/C; QSPI0_IO2_CLAMP GPIO227/C; QSPI0_IO3_CLAMP GPIO016/C
SPI_MON1 at 0x40010400 (SPI_MON)
  pins: ALT_VIOL_1 GPIO112/B; SP1_AP_INTR GPIO034/B; SP1_ALT_CLK GPIO063/B; SP1_ALT_CS_n GPIO046/B; SP1_ALT_IO0 GPIO031/B; SP1_ALT_IO1 GPIO047/B; SP1_ALT_IO2 GPIO127/B; SP1_ALT_IO3 GPIO013/B

## Interrupts
-15 Reset — Reset Vector, invoked on Power up and warm reset
-14 NonMaskableInt — Non maskable Interrupt, cannot be stopped or preempted
-13 HardFault — Hard Fault, all classes of Fault
-12 MemoryManagement — Memory Management, MPU mismatch, including Access Violation and No Match
-11 BusFault — Bus Fault, Pre-Fetch-, Memory Access Fault, other address/memory related Fault
-10 UsageFault — Usage Fault, i.e. Undef Instruction, Illegal State Transition
-5 SVCall — System Service Call via SVC instruction
-4 DebugMonitor
-2 PendSV — Pendable request for system service
-1 SysTick — System Tick Timer
{n-8} GIRQ{n:02} (ECIA) (n=8..18)
12 GIRQ20 (ECIA)
13 GIRQ21 (ECIA)
14 GIRQ23 (ECIA)
15 GIRQ24 (ECIA)
17 GIRQ26 (ECIA)
20 I2CSMB0 (SMB0)
21 I2CSMB1 (SMB1)
22 I2CSMB2 (SMB2)
23 I2CSMB3 (SMB3)
{n+24} DMA_CH{n:02} (DMA_CHAN{n:02}) (n=0..9)
40 UART0
65 PKE_ERR
66 PKE_END
67 RNG
68 AES
69 HASH
83 LED0
84 LED1
90 SPT0
91 QMSPI0
92 QMSPI1
111 RTMR (RTOS)
112 HTMR0 (HTM0)
113 HTMR1 (HTM1)
134 EMC (ENV_MON)
140 TIMER32_0
141 TIMER32_1
146 CCT
147 CCT_CAP0 (CCT)
148 CCT_CAP1 (CCT)
149 CCT_CAP2 (CCT)
150 CCT_CAP3 (CCT)
151 CCT_CAP4 (CCT)
152 CCT_CAP5 (CCT)
153 CCT_CMP0 (CCT)
154 CCT_CMP1 (CCT)
158 I2CSMB4 (SMB4)
171 WDT
174 CLK_MON (PCR)
181 SWI0 (RTOS)
182 SWI1 (RTOS)
183 SWI2 (RTOS)
184 SWI3 (RTOS)
185 IMSPI
187 SPT1
188 SPIMON0_VLTN (SPI_MON0)
189 SPIMON0_MTMON (SPI_MON0)
190 SPIMON0_LTMON (SPI_MON0)
191 SPIMON1_VLTN (SPI_MON1)
192 SPIMON1_MTMON (SPI_MON1)
193 SPIMON1_LTMON (SPI_MON1)
194 VTR1_PAD_MON (EC_REG_BANK)
195 VTR2_PAD_MON (EC_REG_BANK)

## Pinouts (pin number, pad)
CEC1734_S0_2HW: E2 GPIO000, F9 GPIO002, J2 GPIO003, G2 GPIO004, J3 GPIO012, K7 GPIO013, F2 GPIO015, D10 GPIO016, G9 GPIO020, D9 GPIO021, A7 GPIO022, A8 GPIO023, A4 GPIO026, K2 GPIO027, D1 GPIO030, G1 GPIO031, F1 GPIO034, C2 GPIO046, K3 GPIO047, H2 GPIO050, J5 GPIO053, E9 GPIO055, B9 GPIO056, J4 GPIO057, H1 GPIO063, K5 GPIO104, J6 GPIO105, K6 GPIO106, E1 GPIO107, K8 GPIO112, J7 GPIO127, J1 GPIO130, D2 GPIO132, C1 GPIO140, A2 GPIO143, A3 GPIO144, B4 GPIO145, B2 GPIO146, B1 GPIO147, B3 GPIO150, J10 GPIO156, G10 GPIO157, J8 GPIO170, J9 GPIO201, C9 GPIO202, E10 GPIO203, B10 GPIO204, A6 GPIO223, A9 GPIO224, B7 GPIO227, C10 GPIO250, B6 GPIO253, H9 JTAG_RST_N, H10 nRESET_IN, G4 VSS_ANALOG, K9 VTR_PLL, D7 VSS, G7 VTR_REG, B8 VTR1, D4 VTR_ANALOG, K4 VR_CAP, A5 VSS, F10 VSS, B5 VSS
