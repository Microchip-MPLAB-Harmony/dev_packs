# CEC1734_S0_2ZW register map
Vendor: Microchip
Architecture arm32bit. Special function registers and configuration words.
Registers are 32-bit, read-write, reset 0x0 unless marked. A register's access mark holds for its fields unless they carry their own. Addresses are absolute, and some are shared; only a register's first bit layout is shown; lines under a group give offsets from that group; [hi:lo] are bit positions; {n}, {i} and the like mark numbered series; 'fields as' and 'values as' point back to an identical list; <NAME> marks a mode.

## Further device data
pins=1: GPIO000/SPI0_KILL/SPI0_RESET_n; 2: GPIO002/QSPI0_CS1_n/SPIMON_QSPI0_CS1_n; 3: GPIO003/SDA0/SDA0/SDA0/SDA0/SDA0; 4: GPIO004/SCL0/SCL0/SCL0/SCL0/SCL0; 5: GPIO012; 6: GPIO013/SP1_ALT_IO3; 7: GPIO015/ICT10; 8: GPIO016/QSPI0_IO3/QSPI0_IO3_CLAMP; 9: GPIO020/QSPI0_IN_CS0_n; 10: GPIO021/QSPI0_IN_CS1_n; 11: GPIO022/QSPI0_IN_IO1/QSPI0_IN_IO1; 12: GPIO023/QSPI0_IN_IO0/QSPI0_IN_IO0; 13: GPIO024/SPI1PER_CS_n/SPI1PER_CS_n; 14: GPIO026/SP0_AP_INTR; 15: GPIO027/ALT_TFDP_CLK; 16: GPIO030/SDA10/SDA10/SDA10/SDA10/SDA10; 17: GPIO031/SP1_ALT_IO0; 18: GPIO032/QSPI1_IN_IO1/QSPI1_IN_IO1; 19: GPIO033; 20: GPIO034/SP1_AP_INTR/SP1_AP_INTR; 21: GPIO045/QSPI1_IN_CS1_n; 22: GPIO046/SP1_ALT_CS_n; 23: GPIO047/SP1_ALT_IO1; 24: GPIO050/ICT0; 25: GPIO053/PWM0/SP0_AP_INTR; 26: GPIO055/QSPI0_CS0_n/SPIMON_QSPI0_CS0_n; 27: GPIO056/QSPI0_CLK/QSPI0_CLK_CLAMP; 28: GPIO057/VCC_PWRGD; 29: GPIO063/SP1_ALT_CLK; 30: GPIO070/QSPI1_IN_IO0/QSPI1_IN_IO0; 31: GPIO071/QSPI1_IN_CS0_n; 32: GPIO104/UART0_TX/TFDP_CLK; 33: GPIO105/UART0_RX/TFDP_DATA; 34: GPIO106/AP0_RESET_n; 35: GPIO107/SCL10/SCL10/SCL10/SCL10/SCL10/ALT_VIOL_0; 36: GPIO112/ALT_VIOL_1/ALT_TFDP_DATA; 37: GPIO113/ICT9; 38: GPIO120/QSPI1_CS1_n/SPIMON_QSPI1_CS1_n; 39: GPIO121/QSPI1_IO0/QSPI1_IO0_CLAMP; 40: GPIO122/QSPI1_IO1/QSPI1_IO1_CLAMP; 41: GPIO123/QSPI1_IO2/QSPI1_IO2_CLAMP; 42: GPIO124/QSPI1_CS0_n/SPIMON_QSPI1_CS0_n; 43: GPIO125/QSPI1_CLK/QSPI1_CLK_CLAMP; 44: GPIO126/QSPI1_IO3/QSPI1_IO3_CLAMP; 45: GPIO127/SP1_ALT_IO2; 46: GPIO130/CLK32KHZ_IN; 47: GPIO131/SPI0PER_CS_n/AP1_RESET_n; 48: GPIO132/SDA6/SDA6/SDA6/SDA6/SDA6; 49: GPIO140/SCL6/SCL6/SCL6/SCL6/SCL6; 50: GPIO143/SDA4/SDA4/SDA4/SDA4/SDA4; 51: GPIO144/SCL4/SCL4/SCL4/SCL4/SCL4; 52: GPIO145/SDA9/SDA9/SDA9/SDA9/SDA9; 53: GPIO146/SCL9/SCL9/SCL9/SCL9/SCL9; 54: GPIO147/SDA15/SDA15/SDA15/SDA15/SDA15; 55: GPIO150/SCL15/SCL15/SCL15/SCL15/SCL15; 56: GPIO156/LED0; 57: GPIO157/LED1; 58: GPIO163/SPI1_KILL/SPI_RESET_n; 59: GPIO165/QSPI1_IN_IO2/QSPI1_IN_IO2; 60: GPIO170/TFDP_CLK; 61: GPIO171/QSPI1_IN_IO3/QSPI1_IN_IO3/TFDP_DATA; 62: GPIO200/QSPI1_IN_CLK/QSPI1_IN_CLK; 63: GPIO201/CLK32KHZ_OUT; 64: GPIO202/QSPI0_IN_IO2/QSPI0_IN_IO2; 65: GPIO203/QSPI0_IN_IO3/QSPI0_IN_IO3; 66: GPIO204/QSPI0_IN_CLK/QSPI0_IN_CLK; 67: GPIO223/QSPI0_IO0/QSPI0_IO0_CLAMP; 68: GPIO224/QSPI0_IO1/QSPI0_IO1_CLAMP; 69: GPIO227/QSPI0_IO2/QSPI0_IO2_CLAMP; 70: GPIO250/SPI0PER_CS_n; 71: GPIO253/TST_CLK_OUT; 72: JTAG_RST_N; 73: nRESET_IN; 74: VSS_ANALOG; 75: VTR_PLL; 76: VSS; 77: VTR_REG; 78: VTR1; 79: VTR_ANALOG; 80: VR_CAP; 81: VSS; 82: VTR2; 83: VSS; 84: VSS, interrupts=-15 Reset — Reset Vector, invoked on Power up and warm reset; -14 NonMaskableInt — Non maskable Interrupt, cannot be stopped or preempted; -13 HardFault — Hard Fault, all classes of Fault; -12 MemoryManagement — Memory Management, MPU mismatch, including Access Violation and No Match; -11 BusFault — Bus Fault, Pre-Fetch-, Memory Access Fault, other address/memory related Fault; -10 UsageFault — Usage Fault, i.e. Undef Instruction, Illegal State Transition; -5 SVCall — System Service Call via SVC instruction; -4 DebugMonitor — Debug Monitor; -2 PendSV — Pendable request for system service; -1 SysTick — System Tick Timer; 0 GIRQ08 — GIRQ08; 1 GIRQ09 — GIRQ09; 2 GIRQ10 — GIRQ10; 3 GIRQ11 — GIRQ11; 4 GIRQ12 — GIRQ12; 5 GIRQ13 — GIRQ13; 6 GIRQ14 — GIRQ14; 7 GIRQ15 — GIRQ15; 8 GIRQ16 — GIRQ16; 9 GIRQ17 — GIRQ17; 10 GIRQ18 — GIRQ18; 12 GIRQ20 — GIRQ20; 13 GIRQ21 — GIRQ21; 14 GIRQ23 — GIRQ23; 15 GIRQ24 — GIRQ24; 17 GIRQ26 — GIRQ26; 20 I2CSMB0 — I2CSMB0; 21 I2CSMB1 — I2CSMB1; 22 I2CSMB2 — I2CSMB2; 23 I2CSMB3 — I2CSMB3; 24 DMA_CH00 — DMA_CH00; 25 DMA_CH01 — DMA_CH01; 26 DMA_CH02 — DMA_CH02; 27 DMA_CH03 — DMA_CH03; 28 DMA_CH04 — DMA_CH04; 29 DMA_CH05 — DMA_CH05; 30 DMA_CH06 — DMA_CH06; 31 DMA_CH07 — DMA_CH07; 32 DMA_CH08 — DMA_CH08; 33 DMA_CH09 — DMA_CH09; 40 UART0 — UART0; 65 PKE_ERR — PKE_ERR; 66 PKE_END — PKE_END; 67 RNG — RNG; 68 AES — AES; 69 HASH — HASH; 83 LED0 — LED0; 84 LED1 — LED1; 90 SPT0 — SPT0; 91 QMSPI0 — QMSPI0; 92 QMSPI1 — QMSPI1; 111 RTMR — RTMR; 112 HTMR0 — HTMR0; 113 HTMR1 — HTMR1; 134 EMC — EMC; 140 TIMER32_0 — TIMER32_0; 141 TIMER32_1 — TIMER32_1; 146 CCT — CCT; 147 CCT_CAP0 — CCT_CAP0; 148 CCT_CAP1 — CCT_CAP1; 149 CCT_CAP2 — CCT_CAP2; 150 CCT_CAP3 — CCT_CAP3; 151 CCT_CAP4 — CCT_CAP4; 152 CCT_CAP5 — CCT_CAP5; 153 CCT_CMP0 — CCT_CMP0; 154 CCT_CMP1 — CCT_CMP1; 158 I2CSMB4 — I2CSMB4; 171 WDT — WDT; 174 CLK_MON — CLK_MON; 181 SWI0 — SWI0; 182 SWI1 — SWI1; 183 SWI2 — SWI2; 184 SWI3 — SWI3; 185 IMSPI — IMSPI; 187 SPT1 — SPT1; 188 SPIMON0_VLTN — SPIMON0_VLTN; 189 SPIMON0_MTMON — SPIMON0_MTMON; 190 SPIMON0_LTMON — SPIMON0_LTMON; 191 SPIMON1_VLTN — SPIMON1_VLTN; 192 SPIMON1_MTMON — SPIMON1_MTMON; 193 SPIMON1_LTMON — SPIMON1_LTMON; 194 VTR1_PAD_MON — VTR1_PAD_MON; 195 VTR2_PAD_MON — VTR2_PAD_MON
