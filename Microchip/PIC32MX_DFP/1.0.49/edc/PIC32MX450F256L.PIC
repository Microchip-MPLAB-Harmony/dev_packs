# PIC32MX450F256L register map
Vendor: Microchip
Architecture 32xxxx. Special function registers and configuration words.
Registers are 32-bit, read-write, reset 0x0 unless marked. A register's access mark holds for its fields unless they carry their own. Addresses are absolute, and some are shared; only a register's first bit layout is shown; lines under a group give offsets from that group; [hi:lo] are bit positions; {n}, {i} and the like mark numbered series; 'fields as' and 'values as' point back to an identical list; <NAME> marks a mode.

## Further device data
pins=1: RG15; 2: VDD; 3: RE5/PMD5/RPE5/AN22; 4: RE6/PMD6/AN23; 5: RE7/PMD7/AN27; 6: RC1/RPC1; 7: RC2/RPC2; 8: RC3/RPC3; 9: RC4/CTED7/RPC4; 10: RG6/PMA5/SCK2/RPG6/C1IND/AN16; 11: RG7/PMA4/RPG7/C1INC/AN17; 12: RG8/PMA3/RPG8/C2IND/AN18; 13: MCLR; 14: RG9/PMA2/RPG9/C2INC/AN19; 15: VSS; 16: VDD; 17: RA0/CTED1/TMS; 18: RE8/RPE8; 19: RE9/RPE9; 20: RB5/VBUSON/RPB5/C1INA/AN5; 21: RB4/C1INB/AN4; 22: RB3/RPB3/C2INA/AN3/PGED3; 23: RB2/CTED13/RPB2/C2INB/AN2/PGEC3; 24: RB1/CTED12/RPB1/AN1/PGEC1; 25: RB0/RPB0/AN0/PGED1; 26: RB6/RPB6/AN6/PGEC2; 27: RB7/CTED3/RPB7/AN7/PGED2; 28: RA9/PMA7/VREF-; 29: RA10/PMA6/VREF+; 30: AVDD; 31: AVSS; 32: RB8/CTED10/RPB8/AN8; 33: RB9/CTED4/RPB9/AN9; 34: RB10/PMA13/CTED11/RPB10/AN10/CVREFOUT; 35: RB11/PMA12/AN11; 36: VSS; 37: VDD; 38: RA1/CTED2/TCK; 39: RF13/RPF13; 40: RF12/RPF12; 41: RB12/PMA11/AN12; 42: RB13/PMA10/AN13; 43: RB14/PMA1/CTED5/RPB14/AN14; 44: RB15/PMA0/CTED6/OCFB/RPB15/AN15; 45: VSS; 46: VDD; 47: RD14/RPD14; 48: RD15/RPD15; 49: RF4/PMA9/RPF4; 50: RF5/PMA8/RPF5; 51: RF3/RPF3/USBID; 52: RF2/RPF2; 53: RF8/RPF8; 54: VBUS; 55: VUSB3V3; 56: D-; 57: D+; 58: RA2/SCL2; 59: RA3/SDA2; 60: RA4/CTED9/TDI; 61: RA5/TDO; 62: VDD; 63: RC12/CLKI/OSC1; 64: RC15/CLKO/OSC2; 65: VSS; 66: RA14/RPA14/SCL1; 67: RA15/RPA15/SDA1; 68: RD8/RTCC/RPD8; 69: RD9/RPD9; 70: RD10/PMCS2/SCK1/RPD10; 71: RD11/PMCS1/RPD11; 72: RD0/INT0/RPD0; 73: RC13/RPC13/SOSCI; 74: RC14/T1CK/RPC14/SOSCO; 75: VSS; 76: RD1/RPD1/AN24; 77: RD2/RPD2/AN25; 78: RD3/RPD3/AN26; 79: RD12/PMD12/RPD12; 80: RD13/PMD13; 81: RD4/PMWR/RPD4; 82: RD5/PMRD/RPD5; 83: RD6/PMD14; 84: RD7/PMD15; 85: VCAP; 86: VDD; 87: RF0/PMD11/RPF0; 88: RF1/PMD10/RPF1; 89: RG1/PMD9/RPG1; 90: RG0/PMD8/RPG0; 91: RA6/TRCLK; 92: RA7/CTED8/TRD3; 93: RE0/PMD0; 94: RE1/PMD1; 95: RG14/TRD2; 96: RG12/TRD1; 97: RG13/TRD0; 98: RE2/PMD2/CTPLS/AN20; 99: RE3/PMD3/RPE3; 100: RE4/PMD4/AN21; 101: NC; 102: NC; 103: NC; 104: NC; 105: NC; 106: NC; 107: NC; 108: NC; 109: NC; 110: NC; 111: NC; 112: NC; 113: NC; 114: VDD; 115: VSS; 116: NC; 117: VDD; 118: VSS; 119: NC; 120: NC; 121: VSS; 122: NC; 123: NC; 124: VDD, interrupts=0 CORE_TIMER — Core Timer; 1 CORE_SOFTWARE_0 — Core Software 0; 2 CORE_SOFTWARE_1 — Core Software 1; 3 EXTERNAL_0 — Ext INT 0; 4 TIMER_1 — Timer1; 5 INPUT_CAPTURE_1 — Input Capture 1; 6 OUTPUT_COMPARE_1 — Output Compare 1; 7 EXTERNAL_1 — Ext INT 1; 8 TIMER_2 — Timer2; 9 INPUT_CAPTURE_2 — Input Capture 2; 10 OUTPUT_COMPARE_2 — Output Compare 2; 11 EXTERNAL_2 — Ext INT 2; 12 TIMER_3 — Timer3; 13 INPUT_CAPTURE_3 — Input Capture 3; 14 OUTPUT_COMPARE_3 — Output Compare 3; 15 EXTERNAL_3 — Ext INT 3; 16 TIMER_4 — Timer4; 17 INPUT_CAPTURE_4 — Input Capture 4; 18 OUTPUT_COMPARE_4 — Output Compare 4; 19 EXTERNAL_4 — Ext INT 4; 20 TIMER_5 — Timer5; 21 INPUT_CAPTURE_5 — Input Capture 5; 22 OUTPUT_COMPARE_5 — Output Compare 5; 23 ADC — ADC; 24 FAIL_SAFE_MONITOR — Fail Safe Clock Monitor; 25 RTCC — Real Time Clock Calendar; 26 FCE — Flash Control Event; 27 COMPARATOR_1 — Comparator 1; 28 COMPARATOR_2 — Comparator 2; 29 USB_1 — USB Module 1; 30 SPI_1 — SPI1; 31 UART_1 — UART 1; 32 I2C_1 — I2C 1; 33 CHANGE_NOTICE — Change Notice; 34 PMP — PMP; 35 SPI_2 — SPI 2; 36 UART_2 — UART 2; 37 I2C_2 — I2C 2; 38 UART_3 — UART_3; 39 UART_4 — UART_4; 40 UART_5 — UART_5; 41 CTMU — CTMU Event; 42 DMA_0 — DMA Channel 0; 43 DMA_1 — DMA Channel 1; 44 DMA_2 — DMA Channel 2; 45 DMA_3 — DMA Channel 3
