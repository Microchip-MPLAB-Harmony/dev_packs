# PIC32CK1025SG01100 register map
Vendor: Microchip Technology; Series: PIC32CKSG01; File version: 0
Microchip PIC32CK1025SG01100 Microcontroller
CPU: CM33 r0p0, little endian, MPU, FPU, DSP, 3 interrupt priority bits, 158 interrupts, 23 SAU regions
Registers are 32-bit, read-write, reset 0x0 unless marked. A register's access mark holds for its fields unless they carry their own. Offsets are from the block's base; lines under a group give offsets from that group; [hi:lo] are bit positions; {n}, {i} and the like mark numbered series; 'fields as' and 'values as' point back to an identical list; <NAME> marks a mode.

## Memory map
0x0FFFF000 SQI size 0x16C — Polaris Serial Quad Interface SIB
0x44000000 DSU size 0x2000 — Device Service Unit
0x44002000 FCR size 0x64 — Flash Read Controller (FCR)
0x44004000 FCW size 0xD0 — Flash Write Control (FCW)
0x44006000 PM size 0xA — Power Manager
0x44008000 SUPC size 0x30 — Supply Controller
0x4400A000 RSTC size 0x8 — Reset Controller
0x4400C000 OSCCTRL size 0x8C — Oscillators Control
0x4400E000 OSC32KCTRL size 0x20 — 32kHz Oscillators Control
0x44010000 GCLK size 0x1A0 — Generic Clock Generator
0x44012000 MCLK size 0x60 — Main Clock
0x44014000 FREQM size 0x28 — Frequency Meter
0x44016000 WDT size 0xD — Watchdog Timer
0x44018000 RTC size 0x70 — Real-Time Counter
0x4401A000 EIC size 0x44 — External Interrupt Controller
0x4401B000 EIC_SEC size 0x44
0x4401C000 PAC size 0x44 — Peripheral Access Controller
0x4401E000 TRAM size 0x9120 — TrustRAM
0x44800000 PORT size 0x200 — Port Module
0x44801000 PORT_SEC size 0x200
0x44802000 DMA0 size 0x2D0 — Direct Memory Access Controller
0x44804000 DMA1 size 0x2D0
0x44806000 HMATRIX size 0x1B8 — HSB Matrix
0x44808000 CMCC size 0x38 — Cortex M Cache Controller
0x4480A000 PRM size 0x4 — Boot ROM Controller
0x4480C000 IDAU size 0x3560 — Implementation Defined Attribution Unit
0x4480E000 EVSYS size 0x224 — Event System Interface
0x44810000 SERCOM0 size 0x38 — Serial Communication Interface
0x44812000 SERCOM1 size 0x38
0x44814000 SERCOM2 size 0x38
0x44816000 SERCOM3 size 0x38
0x44818000 TCC0 size 0x88 — Timer Counter for Control Applications
0x4481A000 TCC1 size 0x88
0x4481C000 TCC2 size 0x88
0x4481E000 TCC3 size 0x88
0x45000000 SERCOM4 size 0x38
0x45002000 SERCOM5 size 0x38
0x45004000 SERCOM6 size 0x38
0x45006000 SERCOM7 size 0x38
0x45008000 TCC4 size 0x88
0x4500A000 TCC5 size 0x88
0x4500C000 TCC6 size 0x88
0x4500E000 TCC7 size 0x88
0x45010000 ADC size 0x16C — ADC Controller
0x45012000 AC size 0x40 — Analog Comparator Controller
0x45014000 PTC — Peripheral Touch Controller
0x45016000 SPI_IXS size 0x3C — Audio SPI with 8 channels compatibilty
0x45018000 PCC size 0xE8 — Parallel Capture Controller
0x4501A000 CCL size 0x18 — Configurable Custom Logic
0x4501C000 PDEC size 0x38 — Position Decoder
0x4501E000 CAN0 size 0x104 — Control Area Network
0x45020000 CAN1 size 0x104
0x45022000 ETH size 0x1280 — Ethernet Controller
0x45024000 TRNG size 0x24 — True Random Generator
0x45026000 SDMMC0 size 0x238 — SD/MMC Host Controller
0x45028000 SDMMC1 size 0x238
0x4502A000 USB size 0x200 — Full-Speed Universal Serial Bus
0x4502C000 EBI size 0xEC — External Bus Interface
0x46000000 USBHS size 0x1554 — USB High Speed
0x48000000 HSM size 0x15C — Hardware Security Module
0xE0000000 ITM size 0x1000 — Instrumentation Macrocell
0xE0001000 DWT size 0x1000 — Data Watchpoint and Trace
0xE0002000 FPB size 0x1000 — Flash Patch and Breakpoint
0xE000E000 ICB size 0x10 — Implementation Control Block
0xE000E010 SysTick size 0x10 — SysTick Timer
0xE000E100 NVIC size 0x400 — Nested Vectored Interrupt Controller
0xE000ED00 SCB size 0x90 — System Control Block
0xE000ED90 MPU size 0x38 — Memory Protection Unit
0xE000EDF0 CoreDebug size 0x1C — Debug Control Block
0xE000EF00 SIG size 0x4 — Software Interrupt Generation
0xE000EF30 FPU size 0x1C — Floating-point Extension
0xE000EFB0 DIB size 0x50 — Debug Identification Block
0xE002E000 ICB_NS size 0x10
0xE002E010 SysTick_NS size 0x10
0xE002E100 NVIC_NS size 0x400
0xE002ED00 SCB_NS size 0x90
0xE002ED90 MPU_NS size 0x38
0xE002EDF0 CoreDebug_NS size 0x1C
0xE002EF00 SIG_NS size 0x4
0xE002EF30 FPU_NS size 0x1C
0xE002EFB0 DIB_NS size 0x50
0xE0040000 TPIU size 0x1000 — Trace Port Interface Unit

## Interrupts
0 FCR_ERR (FCR)
1 FCR_FLT (FCR)
2 FCW
3 PM
4 SUPC
5 OSCCTRL_XOSC (OSCCTRL)
6 OSCCTRL_DFLL (OSCCTRL)
7 OSCCTRL_PLL0 (OSCCTRL)
8 OSC32KCTRL
9 MCLK
10 FREQM
11 WDT
12 RTC
{n+13} EIC_EXTINT_{n} (EIC) (n=0..15)
29 EIC_NSCHK (EIC)
30 PAC
31 TRAM
32 PORT
33 DMA0_PRI0 (DMA0)
34 DMA0_PRI1 (DMA0)
35 DMA0_PRI2 (DMA0)
36 DMA1_PRI0 (DMA1)
37 DMA1_PRI1 (DMA1)
38 HMATRIX
39 EVSYS_0 (EVSYS)
40 EVSYS_1 (EVSYS)
41 EVSYS_2 (EVSYS)
42 EVSYS_3 (EVSYS)
43 EVSYS_OTHER (EVSYS)
44 SERCOM0_56 (SERCOM0)
45 SERCOM0_0 (SERCOM0)
46 SERCOM0_1 (SERCOM0)
47 SERCOM0_2 (SERCOM0)
48 SERCOM0_3 (SERCOM0)
49 SERCOM0_4 (SERCOM0)
50 SERCOM1_56 (SERCOM1)
51 SERCOM1_0 (SERCOM1)
52 SERCOM1_1 (SERCOM1)
53 SERCOM1_2 (SERCOM1)
54 SERCOM1_3 (SERCOM1)
55 SERCOM1_4 (SERCOM1)
56 SERCOM2_56 (SERCOM2)
57 SERCOM2_0 (SERCOM2)
58 SERCOM2_1 (SERCOM2)
59 SERCOM2_2 (SERCOM2)
60 SERCOM2_3 (SERCOM2)
61 SERCOM2_4 (SERCOM2)
62 SERCOM3_56 (SERCOM3)
63 SERCOM3_0 (SERCOM3)
64 SERCOM3_1 (SERCOM3)
65 SERCOM3_2 (SERCOM3)
66 SERCOM3_3 (SERCOM3)
67 SERCOM3_4 (SERCOM3)
68 TCC0_OTHER (TCC0)
69 TCC0_MC_0 (TCC0)
70 TCC0_MC_1 (TCC0)
71 TCC0_MC_2 (TCC0)
72 TCC0_MC_3 (TCC0)
73 TCC0_MC_4 (TCC0)
74 TCC0_MC_5 (TCC0)
75 TCC1_OTHER (TCC1)
76 TCC1_MC_0 (TCC1)
77 TCC1_MC_1 (TCC1)
78 TCC1_MC_2 (TCC1)
79 TCC1_MC_3 (TCC1)
80 TCC1_MC_4 (TCC1)
81 TCC1_MC_5 (TCC1)
82 TCC2_OTHER (TCC2)
83 TCC2_MC_0 (TCC2)
84 TCC2_MC_1 (TCC2)
85 TCC2_MC_2 (TCC2)
86 TCC2_MC_3 (TCC2)
87 TCC2_MC_4 (TCC2)
88 TCC2_MC_5 (TCC2)
89 TCC3_OTHER (TCC3)
90 TCC3_MC_0 (TCC3)
91 TCC3_MC_1 (TCC3)
92 TCC3_MC_2 (TCC3)
93 TCC3_MC_3 (TCC3)
94 TCC3_MC_4 (TCC3)
95 TCC3_MC_5 (TCC3)
96 SERCOM4_56 (SERCOM4)
97 SERCOM4_0 (SERCOM4)
98 SERCOM4_1 (SERCOM4)
99 SERCOM4_2 (SERCOM4)
100 SERCOM4_3 (SERCOM4)
101 SERCOM4_4 (SERCOM4)
102 SERCOM5_56 (SERCOM5)
103 SERCOM5_0 (SERCOM5)
104 SERCOM5_1 (SERCOM5)
105 SERCOM5_2 (SERCOM5)
106 SERCOM5_3 (SERCOM5)
107 SERCOM5_4 (SERCOM5)
108 SERCOM6_56 (SERCOM6)
109 SERCOM6_0 (SERCOM6)
110 SERCOM6_1 (SERCOM6)
111 SERCOM6_2 (SERCOM6)
112 SERCOM6_3 (SERCOM6)
113 SERCOM6_4 (SERCOM6)
114 SERCOM7_56 (SERCOM7)
115 SERCOM7_0 (SERCOM7)
116 SERCOM7_1 (SERCOM7)
117 SERCOM7_2 (SERCOM7)
118 SERCOM7_3 (SERCOM7)
119 SERCOM7_4 (SERCOM7)
120 TCC4_OTHER (TCC4)
121 TCC4_MC_0 (TCC4)
122 TCC4_MC_1 (TCC4)
123 TCC5_OTHER (TCC5)
124 TCC5_MC_0 (TCC5)
125 TCC5_MC_1 (TCC5)
126 TCC6_OTHER (TCC6)
127 TCC6_MC_0 (TCC6)
128 TCC6_MC_1 (TCC6)
129 TCC7_OTHER (TCC7)
130 TCC7_MC_0 (TCC7)
131 TCC7_MC_1 (TCC7)
132 ADC_0 (ADC)
133 ADC_1 (ADC)
134 ADC_2 (ADC)
135 ADC_3 (ADC)
136 ADC_4 (ADC)
137 ADC_5 (ADC)
138 AC
139 PTC
140 SPI_IXS
141 PCC
142 PDEC
143 CAN0
144 CAN1
145 ETH
146 SQI
147 TRNG
148 SDMMC0
149 SDMMC1
150 USB_OTHER (USB)
151 USB_SOF (USB)
152 USB_TRCPT0 (USB)
153 USB_TRCPT1 (USB)
154 USBHS
155 HSM_ERROR (HSM)
156 HSM_TXINT (HSM)
157 HSM_RXINT (HSM)

## Notices in the file
Copyright (c) 2022 Microchip Technology Inc.
SPDX-License-Identifier: Apache-2.0
Licensed under the Apache License, Version 2.0 (the "License");
you may not use this file except in compliance with the License.
You may obtain a copy of the License at
http://www.apache.org/licenses/LICENSE-2.0
Unless required by applicable law or agreed to in writing, software
distributed under the License is distributed on an "AS IS" BASIS,
WITHOUT WARRANTIES OR CONDITIONS OF ANY KIND, either express or implied.
See the License for the specific language governing permissions and
limitations under the License.
