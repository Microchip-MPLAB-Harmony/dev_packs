# PIC32CM5164JH01100 device description
Architecture: CORTEX-M0PLUS; Family: PIC32CM; Series: PIC32CMJH01
Parameters: NUM_IRQ=32 (Number of interrupt request lines), __CM0P_REV=0x0001 (Cortex-M0+ Core Revision), __MPU_PRESENT=1 (MPU present or not), __NVIC_PRIO_BITS=2 (Number of Bits used for Priority Levels), __VTOR_PRESENT=1 (Vector Table Offset Register present or not), __Vendor_SysTickConfig=0 (Set to 1 if different SysTick Config is used), POWER_DOMAIN=PDTOP, __ARCH_ARM=1, __ARCH_ARM_CORTEX_M=1
Programming and debug interfaces: SWD
Registers are 32-bit, read-write, reset 0x0 unless marked. A register's access mark holds for its fields unless they carry their own. Offsets are from the block's base; lines under a group give offsets from that group; [hi:lo] are bit positions; {n}, {i} and the like mark numbered series; 'fields as' and 'values as' point back to an identical list; <NAME> marks a mode.

## Ordering variants
PIC32CM5164JH01100-I/PF: TQFP100, pinout CMJH100, up to 48 MHz, -40 to 85 C, 2.7 to 5.5 V
PIC32CM5164JH01100-E/PF: TQFP100, pinout CMJH100, up to 48 MHz, -40 to 125 C, 2.7 to 5.5 V

## Memory
base space: start 0 size 0x100000000, little endian
  0x00000000 FLASH size 0x80000 flash, rw, executable, page 64
  0x00800000 CAL size 0x8 fuses, ro
  0x00802000 LOCKBIT size 0x4 fuses, ro
  0x00806000 OTP1 size 0x8 fuses, ro
  0x00806008 OTP2 size 0x8 fuses, ro
  0x00806010 OTP3 size 0x8 fuses, ro
  0x00806018 OTP4 size 0x8 fuses, ro
  0x00806020 OTP5 size 0x8 fuses, ro
  0x00806030 TEMP_LOG size 0x8 fuses, ro
  0x00804000 USER_PAGE size 0x100 user_page, rw, page 64
  0x00400000 DATAFLASH size 0x2000 flash, rw, executable, page 64
  0x20000000 DRAM size 0x10000 ram, rw, executable
  0x40000000 HPB0 size 0x4000 io, rw
  0x41000000 HPB1 size 0x10000 io, rw
  0x42000000 HPB2 size 0x8000 io, rw
  0x43000000 HPB3 size 0x1800 io, rw
  0x48000000 DIVAS size 0x20 io, rw
  0xE0000000 PPB size 0x100000 io, rw
fuses space: start 0x00000000 size 0x20000000, little endian

## Peripheral instances (address, pins/pin function, parameters)
AC at 0x42004C00
  pins: AIN0 PA04/B; AIN1 PA05/B; AIN2 PA06/B; AIN3 PA07/B; AIN4 PA02/B; AIN5 PA03/B; AIN6 PB05/B; AIN7 PB06/B; CMP0 PA12/H or PA18/H or PB24/H; CMP1 PA13/H or PA19/H or PB25/H; CMP2 PA00/H or PA24/H or PB30/H; CMP3 PA01/H or PA25/H or PB31/H
  parameters: COMPCTRL_MUXNEG_OPAMP=7 (OPAMP selection for MUXNEG), GCLK_ID=42 (Index of Generic Clock), NUM_CMP=4 (Number of comparators), PAIRS=2 (Number of pairs of comparators), SPEED_LEVELS=2 (Number of speed values), INSTANCE_ID=83 (Instance index for AC)
ADC0 at 0x42004400 (ADC)
  pins: AIN0 PA02/B; AIN1 PA03/B; AIN2 PB08/B; AIN3 PB09/B; AIN{n} PA{n:02}/B (n=4..11); VREFP PA03/B
  parameters: DMAC_ID_RESRDY=42 (Index of DMA RESRDY trigger), EXTCHANNEL_MSB=11 (Number of external channels), GCLK_ID=36 (Index of Generic Clock), INT_CH30=0 (Select OPAMP or CTAT on Channel 30), MASTER_SLAVE_MODE=1 (ADC Master/Slave Mode), INSTANCE_ID=81 (Instance index for ADC0), LOAD_CALIB=1 (CALIB register to be loaded from NVM)
ADC1 at 0x42004800 (ADC)
  pins: AIN0 PB00/B; AIN1 PB01/B; AIN2 PB02/B; AIN3 PB03/B; AIN4 PB08/B; AIN5 PB09/B; AIN6 PB04/B; AIN7 PB05/B; AIN8 PB06/B; AIN9 PB07/B; AIN10 PA08/B; AIN11 PA09/B
  parameters: DMAC_ID_RESRDY=43 (Index of DMA RESRDY trigger), EXTCHANNEL_MSB=11 (Number of external channels), GCLK_ID=37 (Index of Generic Clock), INT_CH30=0 (Select OPAMP or CTAT on Channel 30), MASTER_SLAVE_MODE=2 (ADC Master/Slave Mode), INSTANCE_ID=82 (Instance index for ADC1), LOAD_CALIB=1 (CALIB register to be loaded from NVM)
CAN0 at 0x42001C00 (CAN)
  pins: RX PA25/G or PB23/G; TX PA24/G or PB22/G
  parameters: DMAC_ID_DEBUG=14 (DMA CAN Debug Req), GCLK_ID=26 (Index of Generic Clock), MSG_RAM_ADDR=0x200000000, QOS_RESET_VAL=2 (QOS reset value), INSTANCE_ID=71 (Instance index for CAN0)
CAN1 at 0x42002000 (CAN)
  pins: RX PB11/G or PB15/G; TX PB10/G or PB14/G
  parameters: DMAC_ID_DEBUG=15 (DMA CAN Debug Req), GCLK_ID=27 (Index of Generic Clock), MSG_RAM_ADDR=0x200000000, QOS_RESET_VAL=2 (QOS reset value), INSTANCE_ID=72 (Instance index for CAN1)
CCL at 0x42005800
  pins: IN0 PA04/I or PA16/I or PB22/I; IN1 PA05/I or PA17/I or PB00/I; IN2 PA06/I or PA18/I or PB01/I; IN3 PA08/I or PA30/I; IN4 PA09/I or PC27/I; IN5 PA10/I or PB10/I or PC28/I; IN6 PA22/I or PB06/I; IN7 PA23/I or PB07/I; IN8 PA24/I or PB08/I; IN9 PB14/I or PC20/H; IN10 PB15/I or PC21/H; IN11 PB16/I; OUT0 PA07/I or PA19/I or PB02/I or PB23/I; OUT1 PA11/I or PA31/I or PB11/I; OUT2 PA25/I or PB09/I; OUT3 PB17/I
  parameters: GCLK_ID=40 (GCLK index for CCL), LUT_NUM=4 (Number of LUT in a CCL), SEQ_NUM=2 (Number of SEQ in a CCL), INSTANCE_ID=86 (Instance index for CCL)
DAC at 0x42005000
  pins: VOUT PA02/B; VREFP PA03/B
  parameters: DMAC_ID_EMPTY=45 (Index of DMA EMPTY trigger), GCLK_ID=38, INSTANCE_ID=84 (Instance index for DAC)
DIVAS at 0x48000000, DIVAS_IOBUS 0x60000200
DMAC at 0x41006000
  parameters: CH_BITS=4 (Number of bits to select channel), CH_NUM=12 (Number of channels), EVIN_NUM=4 (Number of input events), EVOUT_NUM=4 (Number of output events), LVL_BITS=2 (Number of bit to select level priority), LVL_NUM=4 (Enable priority level number), QOSCTRL_D_RESETVALUE=2 (QOS dmac ahb interface reset value), QOSCTRL_F_RESETVALUE=2 (QOS dmac fetch interface reset value), QOSCTRL_WRB_RESETVALUE=2 (QOS dmac write back interface reset value), SPLIT_IRQ_NUM=0 (Number of IRQ split out), TRIG_BITS=6 (Number of bits to select trigger source), TRIG_NUM=63 (Number of peripheral triggers), INSTANCE_ID=35 (Instance index for DMAC)
DSU at 0x41002000, DSU_EXT 0x41002100
  parameters: INSTANCE_ID=33 (Instance index for DSU)
EIC at 0x40002800
  pins: EXTINT0 PA16/A or PB00/A or PB16/A or PC08/A or PC24/A or PA00/A; EXTINT1 PA17/A or PB01/A or PB17/A or PC09/A or PC25/A or PA01/A; EXTINT2 PA02/A or PA18/A or PB02/A or PB18/A or PC10/A or PC26/A; EXTINT3 PA03/A or PA19/A or PB03/A or PB19/A or PC11/A or PC27/A; EXTINT4 PA04/A or PA20/A or PB04/A or PB20/A or PC12/A or PC28/A; EXTINT5 PA05/A or PA21/A or PB05/A or PB21/A or PC13/A; EXTINT6 PA06/A or PA22/A or PB06/A or PB22/A or PC14/A; EXTINT7 PA07/A or PA23/A or PB07/A or PB23/A or PC15/A; EXTINT8 PB08/A or PB24/A or PC00/A or PC16/A or PA28/A; EXTINT9 PA09/A or PB09/A or PB25/A or PC01/A or PC17/A; EXTINT10 PA10/A or PA30/A or PB10/A or PC02/A or PC18/A; EXTINT11 PA11/A or PA31/A or PB11/A or PC03/A or PC19/A; EXTINT12 PA12/A or PA24/A or PB12/A or PC20/A; EXTINT13 PA13/A or PA25/A or PB13/A or PC05/A or PC21/A; EXTINT14 PB14/A or PB30/A or PC06/A or PA14/A; EXTINT15 PA27/A or PB15/A or PB31/A or PC07/A or PA15/A; NMI PA08/A
  parameters: EXTINT_NUM=16 (Number of external interrupts), GCLK_ID=2 (Generic Clock index), NUMBER_OF_CONFIG_REGS=2 (Number of CONFIG registers), NUMBER_OF_DPRESCALER_REGS=2 (Number of DPRESCALER registers), NUMBER_OF_INTERRUPTS=16 (Number of external interrupts (obsolete)), INSTANCE_ID=10 (Instance index for EIC)
EVSYS at 0x42000000
  parameters: CHANNELS=12 (Number of Channels), CHANNELS_BITS=4 (Number of bits to select Channel), CHANNELS_MSB=11 (Number of Channels - 1), EXTEVT_NUM=0 (Number of External Event Generators), GCLK_ID_{n}={n+5} (Index of Generic Clock {n}) (n=0..11), GENERATORS=101 (Total Number of Event Generators), GENERATORS_BITS=7 (Number of bits to select Event Generator), USERS=51 (Total Number of Event Users), USERS_BITS=6 (Number of bits to select Event User), INSTANCE_ID=64 (Instance index for EVSYS)
FREQM at 0x40002C00
  parameters: GCLK_ID_MSR=3 (Index of measure generic clock), GCLK_ID_REF=4 (Index of reference generic clock), INSTANCE_ID=11 (Instance index for FREQM)
GCLK at 0x40001C00
  pins: IO0 PB14/H or PB22/H or PA14/H or PA27/H or PA30/H or PA28/H; IO1 PB15/H or PB23/H or PA15/H; IO2 PB16/H or PA16/H; IO3 PA17/H or PB17/H; IO4 PA10/H or PA20/H or PB10/H or PB18/H; IO5 PA11/H or PA21/H or PB11/H or PB19/H; IO6 PA22/H or PB12/H or PB20/H; IO7 PA23/H or PB13/H or PB21/H
  parameters: GENDIV_BITS=16, GEN_BITS=4, GEN_NUM=9 (Number of Generic Clock Generators), GEN_NUM_MSB=8 (Number of Generic Clock Generators - 1), GEN_SOURCE_NUM_MSB=7 (Number of Generic Clock Sources - 1), NUM=43 (Number of Generic Clock Users), SOURCE_BITS=3, SOURCE_NUM=8 (Number of Generic Clock Sources), INSTANCE_ID=7 (Instance index for GCLK)
ICM at 0x42006400
  parameters: INSTANCE_ID=89 (Instance index for ICM)
SMBIST at 0x42006c00
  parameters: EN_LMOB=0 (Enable Local SRAM MBIST On Boot.), EN_ONLINE=1 (Enable online Local SRAM MBIST.), INSTANCE_ID=91 (Instance index for SMBIST.)
MCLK at 0x40000800
  parameters: CTRLA_MCSEL_GCLK=1, CTRLA_MCSEL_OSC8M=0, MCLK_CLK_APB_NUM=4, SYSTEM_CLOCK=4000000 (System Clock Frequency at Reset), INSTANCE_ID=2 (Instance index for MCLK)
  clocks: AHB HPB0 bit 0, HPB1 bit 1, HPB2 bit 2, DSU bit 3, HMATRIXHS bit 4, NVMCTRL bit 5, DRAM bit 6, DMAC bit 7, CAN0 bit 8, CAN1 bit 9, PAC bit 10, NVMCTRL_PICACHU bit 11, DIVAS bit 12, HPB3 bit 13, ICM bit 14
MCRAMC at 0x40003000
  parameters: INSTANCE_ID=12 (Instance index for MCRAMC)
MPU at 0xE000ED90
MTB at 0x41008000
  parameters: INSTANCE_ID=36 (Instance index for MTB)
NVIC at 0xE000E100
  parameters: NUM_IRQ=32 (Number of interrupt requests), __NVIC_PRIO_BITS=2 (Number of NVIC interrupt priority bits)
NVMCTRL at 0x41004000
  pins: MARGIN VMARGIN
  parameters: ECC_PRESENT=1 (define out all the added ECC logic - when =0 there shall be no ECC logic present in the design), FACTORY_WORD_IMPLEMENTED_MASK=0XC0000007FFFFFFFF, PMSB=3, PSZ_BITS=6, RSTFFLTADDR=0x00000000 (the reset default for FFLTADDR), USER_PAGE_OFFSET=0x00800000, USER_WORD_IMPLEMENTED_MASK=0XC01FFFFFFFFFFFFF, DATAFLASH_PAGES=128, DATAFLASH_ADDR=0x00400000 (Start address of the Data Flash area), DATAFLASH_SIZE=8192 (Byte size of the Data Flash area), FLASH_SIZE=524288, PAGE_SIZE=64, PAGES=8192, PAGES_PR_REGION=512, INSTANCE_ID=34 (Instance index for NVMCTRL)
FUSES at LOCKBIT_FUSES 0x00802000 in fuses, OTP1_FUSES 0x00806000 in fuses, OTP2_FUSES 0x00806008 in fuses, OTP3_FUSES 0x00806010 in fuses, OTP4_FUSES 0x00806018 in fuses, OTP5_FUSES 0x00806020 in fuses, USER_FUSES 0x00804000 in fuses
OSC32KCTRL at 0x40001400
  pins: XIN32 PA00/XIN32; XOUT32 PA01/XOUT32
  parameters: OSC32K_COARSE_CALIB_MSB=6, INSTANCE_ID=5 (Instance index for OSC32KCTRL)
OSCCTRL at 0x40001000
  pins: XIN PA14/XIN; XOSC_CLK PA09/XOSC; XOSC_EN PA08/XOSC; XOUT PA15/XOUT
  parameters: GCLK_ID_FDPLL=0 (Index of Generic Clock for DPLL), GCLK_ID_FDPLL32K=1 (Index of Generic Clock for DPLL 32K), FDPLL_VERSION=0x220, OSC48M_VERSION=0x101, XOSC_VERSION=0x210, INSTANCE_ID=4 (Instance index for OSCCTRL)
PAC at 0x40000000
  parameters: HPB_NUM=4 (Number of bridges AHB/APB), INTFLAG_NUM=4 (Number of intflag registers), INSTANCE_ID=0 (Instance index for PAC)
PDEC at 0x42006800
  pins: QDI0 PA08/J or PA16/G; QDI1 PA09/J or PA17/G; QDI2 PA10/J or PA18/G
  parameters: CC_NUM=2 (Number of Compare Channels units), GCLK_ID=41, INSTANCE_ID=90 (Instance index for PDEC)
PM at 0x40000400
  pins: RESET_N RESET_N
  parameters: BIAS_RAM_HS=1 (one if RAM HS can be back biased), PD_NUM=0 (Number of switchable Power Domain), INSTANCE_ID=1 (Instance index for PM)
PORT at 0x41000000, PORT_IOBUS 0x60000000
  pins: P{n} PA{n:02} (n=0..25); P27 PA27; P28 PA28; P30 PA30; P31 PA31; P{n} PB{n-32:02} (n=32..57); P62 PB30; P63 PB31; P64 PC00; P65 PC01; P66 PC02; P67 PC03; P{n} PC{n-64:02} (n=69..85); P88 PC24; P89 PC25; P90 PC26; P91 PC27; P92 PC28
  parameters: BITS=93, DRVSTR=1 (DRVSTR supported?), EV_NUM=4, GROUPS=3, MSB=92, ODRAIN=0 (ODRAIN supported?), SECURE_IMPLEMENTED=0 (Secure I/Os supported?), SLEWLIM=0 (SLEWLIM supported?), INSTANCE_ID=32 (Instance index for PORT)
PTC at 0x42005400
  pins: DS0 PA02/K; DS1 PA03/K; DS2 PA04/K; DS3 PA05/K; DS4 PA06/K; DS5 PA07/K; DS{n} PB{n-6:02}/K (n=6..15); DS16 PA08/K; DS17 PA09/K; DS18 PA10/K; DS19 PA11/K; DS{n} PA{n-4}/K (n=20..27); DS28 PB12/K; DS29 PB13/K; DS30 PB14/K; DS31 PB15/K; X0 PA08/B; X1 PA09/B; X2 PA10/B; X3 PA11/B; X{n} PA{n+12}/B (n=4..11); X12 PB12/B; X13 PB13/B; X14 PB14/B; X15 PB15/B; Y0 PA02/B; Y1 PA03/B; Y2 PA04/B; Y3 PA05/B; Y4 PA06/B; Y5 PA07/B; Y{n} PB{n-6:02}/B (n=6..15); Y16 PA08/B; Y17 PA09/B; Y18 PA10/B; Y19 PA11/B; Y{n} PA{n-4}/B (n=20..27); Y28 PB12/B; Y29 PB13/B; Y30 PB14/B; Y31 PB15/B
  parameters: DMAC_ID_EOC=46 (Index of DMA EOC trigger), DMAC_ID_SEQ=48 (Index of DMA SEQ trigger), DMAC_ID_WCOMP=47 (Index of DMA WCOMP trigger), DS_LINES_MSB=31 (Number of DS lines), FUSEPRESENT=1 (Allows the Driven shield to be included or excluded with a fuse), GCLK_ID=39 (Index of Generic Clock), XY_LINES_MSB=47 (The number of x and y lines), X_LINES_MSB=15 (Number of X lines), Y_LINES_MSB=31 (Number of Y lines), INSTANCE_ID=85 (Instance index for PTC)
RSTC at 0x40000C00
  pins: EXTWAKE{n} PA{n:02}/A (n=0..15)
  parameters: BACKUP_IMPLEMENTED=0, NUMBER_OF_EXTWAKE=0 (number of external wakeup line), INSTANCE_ID=3 (Instance index for RSTC)
RTC at 0x40002400
  parameters: DMAC_ID_TIMESTAMP=62 (DMA RTC timestamp trigger), GPR_NUM=2 (Number of General-Purpose Registers), NUM_OF_ALARMS=1 (Number of Alarms), NUM_OF_BKREGS=0 (Number of Backup Registers), NUM_OF_COMP16=2 (Number of 16-bit Comparators), NUM_OF_COMP32=1 (Number of 32-bit Comparators), NUM_OF_TAMPERS=1 (Number of Tamper Inputs), PER_NUM=8 (Number of Periodic Intervals), INSTANCE_ID=9 (Instance index for RTC)
SERCOM0 at 0x42000400 (SERCOM)
  pins: PAD0 PA04/D or PA08/C or PB24/C; PAD1 PA05/D or PA09/C or PB25/C; PAD2 PA06/D or PC24/C or PA10/C; PAD3 PA07/D or PA11/C or PC25/C
  parameters: DMAC_ID_RX=2 (Index of DMA RX trigger), DMAC_ID_TX=3 (Index of DMA TX trigger), GCLK_ID_CORE=18, GCLK_ID_SLOW=17, INT_MSB=6, PMSB=3, INSTANCE_ID=65 (Instance index for SERCOM0)
SERCOM1 at 0x42000800 (SERCOM)
  pins: PAD0 PC27/D or PA16/C or PA00/D; PAD1 PC28/D or PA17/C or PA01/D; PAD2 PA30/D or PA18/C; PAD3 PA31/D or PA19/C
  parameters: DMAC_ID_RX=4 (Index of DMA RX trigger), DMAC_ID_TX=5 (Index of DMA TX trigger), GCLK_ID_CORE=19, GCLK_ID_SLOW=17, INT_MSB=6, PMSB=3, INSTANCE_ID=66 (Instance index for SERCOM1)
SERCOM2 at 0x42000C00 (SERCOM)
  pins: PAD0 PA08/D or PB20/D or PA12/C; PAD1 PA09/D or PB21/D or PA13/C; PAD2 PA10/D or PA14/C; PAD3 PA11/D or PA15/C
  parameters: DMAC_ID_RX=6 (Index of DMA RX trigger), DMAC_ID_TX=7 (Index of DMA TX trigger), GCLK_ID_CORE=20, GCLK_ID_SLOW=17, INT_MSB=6, PMSB=3, INSTANCE_ID=67 (Instance index for SERCOM2)
SERCOM3 at 0x42001000 (SERCOM)
  pins: PAD0 PA16/D or PA22/C or PB20/C; PAD1 PA17/D or PA23/C or PB21/C; PAD2 PA18/D or PA20/D or PB18/D or PA24/C; PAD3 PA19/D or PA21/D or PB19/D or PA25/C
  parameters: DMAC_ID_RX=8 (Index of DMA RX trigger), DMAC_ID_TX=9 (Index of DMA TX trigger), GCLK_ID_CORE=21, GCLK_ID_SLOW=17, INT_MSB=6, PMSB=3, INSTANCE_ID=68 (Instance index for SERCOM3)
SERCOM4 at 0x42001400 (SERCOM)
  pins: PAD0 PA12/D or PB08/D or PB24/D or PB12/C; PAD1 PA13/D or PB09/D or PB25/D or PB13/C; PAD2 PA14/D or PB10/D or PC24/D or PB14/C; PAD3 PA15/D or PB11/D or PC25/D or PB15/C
  parameters: DMAC_ID_RX=10 (Index of DMA RX trigger), DMAC_ID_TX=11 (Index of DMA TX trigger), GCLK_ID_CORE=22, GCLK_ID_SLOW=17, INT_MSB=6, PMSB=3, INSTANCE_ID=69 (Instance index for SERCOM4)
SERCOM5 at 0x42001800 (SERCOM)
  pins: PAD0 PA22/D or PB02/D or PB30/D or PB16/C; PAD1 PA23/D or PB03/D or PB31/D or PB17/C; PAD2 PA24/D or PB00/D or PB22/D or PA20/C or PB18/C; PAD3 PA25/D or PB01/D or PB23/D or PA21/C or PB19/C
  parameters: DMAC_ID_RX=12 (Index of DMA RX trigger), DMAC_ID_TX=13 (Index of DMA TX trigger), GCLK_ID_CORE=23, GCLK_ID_SLOW=17, INT_MSB=6, PMSB=3, INSTANCE_ID=70 (Instance index for SERCOM5)
SERCOM6 at 0x43000000 (SERCOM)
  pins: PAD0 PC06/C or PC08/C or PC16/C; PAD1 PC07/C or PC09/C or PC17/C; PAD2 PC10/C or PC18/C; PAD3 PC05/C or PC11/C or PC19/C
  parameters: DMAC_ID_RX=49 (Index of DMA RX trigger), DMAC_ID_TX=50 (Index of DMA TX trigger), GCLK_ID_CORE=24, GCLK_ID_SLOW=17, INT_MSB=6, PMSB=3, INSTANCE_ID=96 (Instance index for SERCOM6)
SERCOM7 at 0x43000400 (SERCOM)
  pins: PAD0 PC16/D or PC12/C; PAD1 PC17/D or PC13/C; PAD2 PC18/D or PC14/C; PAD3 PC19/D or PC15/C
  parameters: DMAC_ID_RX=51 (Index of DMA RX trigger), DMAC_ID_TX=52 (Index of DMA TX trigger), GCLK_ID_CORE=25, GCLK_ID_SLOW=17, INT_MSB=6, PMSB=3, INSTANCE_ID=97 (Instance index for SERCOM7)
SUPC at 0x40001800
  parameters: BODCORE_CALIB_MSB=5, BODVDD_CALIB_MSB=5, SUPC_OUT_NUM_MSB=1 (MSB of backup output pad Number), INSTANCE_ID=6 (Instance index for SUPC)
SysTick at 0xE000E010
SystemControl at 0xE000E000
  parameters: __VTOR_PRESENT=1 (Vector Table Offset Register present)
TC0 at 0x42003000 (TC)
  pins: WO0 PA22/E or PB08/E or PB12/E; WO1 PA23/E or PB09/E or PB13/E
  parameters: CC_NUM=2, DMAC_ID_MC_0=28 (Indexes of DMA Match/Compare triggers 0), DMAC_ID_MC_1=29 (Indexes of DMA Match/Compare triggers 1), DMAC_ID_OVF=27 (Indexes of DMA Overflow trigger), EXT=0 (Coding of implemented extended features (keep 0 value)), GCLK_ID=30 (Index of Generic Clock), MASTER_SLAVE_MODE=1 (TC type 0 : NA, 1 : Master, 2 : Slave), OW_NUM=2 (Number of Output Waveforms), INSTANCE_ID=76 (Instance index for TC0)
TC1 at 0x42003400 (TC)
  pins: WO0 PA24/E or PB10/E or PB14/E; WO1 PA25/E or PB11/E or PB15/E
  parameters: CC_NUM=2, DMAC_ID_MC_0=31 (Indexes of DMA Match/Compare triggers 0), DMAC_ID_MC_1=32 (Indexes of DMA Match/Compare triggers 1), DMAC_ID_OVF=30 (Indexes of DMA Overflow trigger), EXT=0 (Coding of implemented extended features (keep 0 value)), GCLK_ID=30 (Index of Generic Clock), MASTER_SLAVE_MODE=2 (TC type 0 : NA, 1 : Master, 2 : Slave), OW_NUM=2 (Number of Output Waveforms), INSTANCE_ID=77 (Instance index for TC1)
TC2 at 0x42003800 (TC)
  pins: WO0 PB02/E or PB16/E; WO1 PB03/E or PB17/E
  parameters: CC_NUM=2, DMAC_ID_MC_0=34 (Indexes of DMA Match/Compare triggers 0), DMAC_ID_MC_1=35 (Indexes of DMA Match/Compare triggers 1), DMAC_ID_OVF=33 (Indexes of DMA Overflow trigger), EXT=0 (Coding of implemented extended features (keep 0 value)), GCLK_ID=31 (Index of Generic Clock), MASTER_SLAVE_MODE=1 (TC type 0 : NA, 1 : Master, 2 : Slave), OW_NUM=2 (Number of Output Waveforms), INSTANCE_ID=78 (Instance index for TC2)
TC3 at 0x42003C00 (TC)
  pins: WO0 PA20/E or PB00/E or PB22/E; WO1 PA21/E or PB01/E or PB23/E
  parameters: CC_NUM=2, DMAC_ID_MC_0=37 (Indexes of DMA Match/Compare triggers 0), DMAC_ID_MC_1=38 (Indexes of DMA Match/Compare triggers 1), DMAC_ID_OVF=36 (Indexes of DMA Overflow trigger), EXT=0 (Coding of implemented extended features (keep 0 value)), GCLK_ID=31 (Index of Generic Clock), MASTER_SLAVE_MODE=2 (TC type 0 : NA, 1 : Master, 2 : Slave), OW_NUM=2 (Number of Output Waveforms), INSTANCE_ID=79 (Instance index for TC3)
TC4 at 0x42004000 (TC)
  pins: WO0 PA18/E or PA14/E; WO1 PA19/E or PA15/E
  parameters: CC_NUM=2, DMAC_ID_MC_0=40 (Indexes of DMA Match/Compare triggers 0), DMAC_ID_MC_1=41 (Indexes of DMA Match/Compare triggers 1), DMAC_ID_OVF=39 (Indexes of DMA Overflow trigger), EXT=0 (Coding of implemented extended features (keep 0 value)), GCLK_ID=32 (Index of Generic Clock), MASTER_SLAVE_MODE=0 (TC type 0 : NA, 1 : Master, 2 : Slave), OW_NUM=2 (Number of Output Waveforms), INSTANCE_ID=80 (Instance index for TC4)
TC5 at 0x43000800 (TC)
  pins: WO0 PA04/F or PB02/F; WO1 PA05/F or PB03/F
  parameters: CC_NUM=2, DMAC_ID_MC_0=54 (Indexes of DMA Match/Compare triggers 0), DMAC_ID_MC_1=55 (Indexes of DMA Match/Compare triggers 1), DMAC_ID_OVF=53 (Indexes of DMA Overflow trigger), EXT=0 (Coding of implemented extended features (keep 0 value)), GCLK_ID=33 (Index of Generic Clock), MASTER_SLAVE_MODE=0 (TC type 0 : NA, 1 : Master, 2 : Slave), OW_NUM=2 (Number of Output Waveforms), INSTANCE_ID=98 (Instance index for TC5)
TC6 at 0x43000C00 (TC)
  pins: WO0 PA06/F or PB00/F; WO1 PA07/F or PB01/F
  parameters: CC_NUM=2, DMAC_ID_MC_0=57 (Indexes of DMA Match/Compare triggers 0), DMAC_ID_MC_1=58 (Indexes of DMA Match/Compare triggers 1), DMAC_ID_OVF=56 (Indexes of DMA Overflow trigger), EXT=0 (Coding of implemented extended features (keep 0 value)), GCLK_ID=34 (Index of Generic Clock), MASTER_SLAVE_MODE=0 (TC type 0 : NA, 1 : Master, 2 : Slave), OW_NUM=2 (Number of Output Waveforms), INSTANCE_ID=99 (Instance index for TC6)
TC7 at 0x43001000 (TC)
  pins: WO0 PA00/F or PB14/F; WO1 PA01/F or PB15/F
  parameters: CC_NUM=2, DMAC_ID_MC_0=60 (Indexes of DMA Match/Compare triggers 0), DMAC_ID_MC_1=61 (Indexes of DMA Match/Compare triggers 1), DMAC_ID_OVF=59 (Indexes of DMA Overflow trigger), EXT=0 (Coding of implemented extended features (keep 0 value)), GCLK_ID=35 (Index of Generic Clock), MASTER_SLAVE_MODE=0 (TC type 0 : NA, 1 : Master, 2 : Slave), OW_NUM=2 (Number of Output Waveforms), INSTANCE_ID=100 (Instance index for TC7)
TCC0 at 0x42002400 (TCC)
  pins: WO0 PA04/E or PA08/E or PB30/E; WO1 PA05/E or PA09/E or PB31/E; WO2 PA10/F or PA18/F; WO3 PA11/F or PA19/F; WO4 PA22/F or PB10/F or PB16/F or PA14/F; WO5 PA15/F or PA23/F or PB11/F or PB17/F; WO6 PA12/F or PA16/F or PA20/F or PB12/F; WO7 PA13/F or PA17/F or PA21/F or PB13/F
  parameters: CC_NUM=4 (Number of Compare/Capture units), DITHERING=1 (Dithering feature implemented), DMAC_ID_MC_0=17 (Indexes of DMA Match/Compare triggers 0), DMAC_ID_MC_1=18 (Indexes of DMA Match/Compare triggers 1), DMAC_ID_MC_2=19 (Indexes of DMA Match/Compare triggers 2), DMAC_ID_MC_3=20 (Indexes of DMA Match/Compare triggers 3), DMAC_ID_OVF=16 (DMA overflow/underflow/retrigger trigger), DTI=1 (Dead-Time-Insertion feature implemented), GCLK_ID=28 (Index of Generic Clock), MASTER_SLAVE_MODE=0 (TCC type 0 : NA, 1 : Master, 2 : Slave), OTMX=1 (Output Matrix feature implemented), OW_NUM=8 (Number of Output Waveforms), PG=1 (Pattern Generation feature implemented), SIZE=24, SWAP=1 (DTI outputs swap feature implemented), INSTANCE_ID=73 (Instance index for TCC0)
TCC1 at 0x42002800 (TCC)
  pins: WO0 PA06/E or PA10/E or PA30/E; WO1 PA07/E or PA11/E or PA31/E; WO2 PA08/F or PA24/F or PB30/F; WO3 PA09/F or PA25/F or PB31/F
  parameters: CC_NUM=2 (Number of Compare/Capture units), DITHERING=1 (Dithering feature implemented), DMAC_ID_MC_0=22 (Indexes of DMA Match/Compare triggers 0), DMAC_ID_MC_1=23 (Indexes of DMA Match/Compare triggers 1), DMAC_ID_OVF=21 (DMA overflow/underflow/retrigger trigger), DTI=0 (Dead-Time-Insertion feature implemented), GCLK_ID=28 (Index of Generic Clock), MASTER_SLAVE_MODE=0 (TCC type 0 : NA, 1 : Master, 2 : Slave), OTMX=0 (Output Matrix feature implemented), OW_NUM=4 (Number of Output Waveforms), PG=1 (Pattern Generation feature implemented), SIZE=24, SWAP=0 (DTI outputs swap feature implemented), INSTANCE_ID=74 (Instance index for TCC1)
TCC2 at 0x42002C00 (TCC)
  pins: WO0 PC03/F or PA12/E or PA16/E or PA00/E; WO1 PC05/F or PA13/E or PA17/E or PA01/E
  parameters: CC_NUM=2 (Number of Compare/Capture units), DITHERING=0 (Dithering feature implemented), DMAC_ID_MC_0=25 (Indexes of DMA Match/Compare triggers 0), DMAC_ID_MC_1=26 (Indexes of DMA Match/Compare triggers 1), DMAC_ID_OVF=24 (DMA overflow/underflow/retrigger trigger), DTI=0 (Dead-Time-Insertion feature implemented), GCLK_ID=29 (Index of Generic Clock), MASTER_SLAVE_MODE=0 (TCC type 0 : NA, 1 : Master, 2 : Slave), OTMX=0 (Output Matrix feature implemented), OW_NUM=2 (Number of Output Waveforms), PG=0 (Pattern Generation feature implemented), SIZE=16, SWAP=0 (DTI outputs swap feature implemented), INSTANCE_ID=75 (Instance index for TCC2)
WDT at 0x40002000
  parameters: INSTANCE_ID=8 (Instance index for WDT)

## Interrupts
-15 Reset — Reset Vector, invoked on Power up and warm reset
-14 NonMaskableInt — Non maskable Interrupt, cannot be stopped or preempted
-13 HardFault — Hard Fault, all classes of Fault
-5 SVCall — System Service Call via SVC instruction
-2 PendSV — Pendable request for system service
-1 SysTick — System Tick Timer
0 SYSTEM (MCLK OSCCTRL OSC32KCTRL PAC PM SUPC) — System peripherals shared interrupt
1 WDT — Watchdog Timer
2 RTC — Real Time Counter
3 EIC — External Interrupt Controller
4 FREQM — Frequency Meter
5 MCRAMC — SRAM Memory Controller
6 NVMCTRL — Non-Volatile Memory Controller
7 DMAC — Direct Memory Access Controller
8 EVSYS — Event Systems
9 SERCOM0_6 (SERCOM0 SERCOM6) — Serial Communication Interface 0_6
10 SERCOM1_7 (SERCOM1 SERCOM7) — Serial Communication Interface 1_7
11 SERCOM2 — Serial Communication Interface 2
12 SERCOM3 — Serial Communication Interface 3
13 SERCOM4 — Serial Communication Interface 4
14 SERCOM5 — Serial Communication Interface 5
15 CAN0 — Control Area Network 0
16 CAN1 — Control Area Network 1
17 TCC0 — Timer/Counter for Control Applications 0
18 TCC1 — Timer/Counter for Control Applications 1
19 TCC2 — Timer/Counter for Control Applications 2
20 TC0_5 (TC0 TC5) — Timer/Counter 0_5
21 TC1_6 (TC1 TC6) — Timer/Counter 1_6
22 TC2_7 (TC2 TC7) — Timer/Counter 2_7
23 TC3 — Timer/Counter 3
24 TC4 — Timer/Counter 4
25 ADC0 — Analog-to-Digital Converter 0
26 ADC1 — Analog-to-Digital Converter 1
27 AC — Analog Comparators
28 DAC — Digital-to-Analog Converter
29 PDEC — Position Decoder
30 PTC — Peripheral Touch Controller
31 ICM — Integrity Check Monitor

## Event generators
1 RTC_PERD, 3 OSCCTRL_XOSC_FAIL, 4 OSC32KCTRL_XOSC32K_FAIL, 5 RTC_CMP_0, 6 RTC_CMP_1, 7 RTC_OVF, {n+8} RTC_PER_{n} (n=0..7), {n+16} EIC_EXTINT_{n} (n=0..15), {n+32} DMAC_CH_{n} (n=0..3), 36 TCC0_OVF, 37 TCC0_TRG, 38 TCC0_CNT, {n+39} TCC0_MC_{n} (n=0..3), 43 TCC1_OVF, 44 TCC1_TRG, 45 TCC1_CNT, 46 TCC1_MC_0, 47 TCC1_MC_1, 48 TCC2_OVF, 49 TCC2_TRG, 50 TCC2_CNT, 51 TCC2_MC_0, 52 TCC2_MC_1, {3n+53} TC{n}_OVF (n=0..4), {3n+54} TC{n}_MC_0 (n=0..4), {3n+55} TC{n}_MC_1 (n=0..4), 68 ADC0_RESRDY, 69 ADC0_WINMON, 70 ADC1_RESRDY, 71 ADC1_WINMON, {n+72} AC_COMP_{n} (n=0..3), 76 AC_WIN_0, 77 AC_WIN_1, 78 DAC_EMPTY, 79 PTC_EOC, 80 PTC_WCOMP, {n+81} CCL_LUTOUT_{n} (n=0..3), 85 PAC_ACCERR, {3n+72} TC{n}_OVF (n=5..7), {3n+73} TC{n}_MC_0 (n=5..7), {3n+74} TC{n}_MC_1 (n=5..7), 96 PDEC_OVF, 97 PDEC_ERR, 98 PDEC_DIR, 99 PDEC_VLC, 100 PDEC_MC_0, 101 PDEC_MC_1

## Event users
{n+1} PORT_EV_{n} (n=0..3), {n+5} DMAC_CH_{n} (n=0..3), 9 TCC0_EV_0, 10 TCC0_EV_1, {n+11} TCC0_MC_{n} (n=0..3), 15 TCC1_EV_0, 16 TCC1_EV_1, 17 TCC1_MC_0, 18 TCC1_MC_1, 19 TCC2_EV_0, 20 TCC2_EV_1, 21 TCC2_MC_0, 22 TCC2_MC_1, {n+23} TC{n}_EVU (n=0..4), 28 ADC0_START, 29 ADC0_SYNC, 30 ADC1_START, 31 ADC1_SYNC, {n+32} AC_SOC_{n} (n=0..3), 36 DAC_START, 37 PTC_STCONV, {n+38} CCL_LUTIN_{n} (n=0..3), 43 MTB_START, 44 MTB_STOP, {n+40} TC{n}_EVU (n=5..7), {n+48} PDEC_EVU_{n} (n=0..2)

## Properties
SIGNATURES: DSU_DID=0x11060000

## Pinouts (pin number, pad)
CMJH100: 1 PA00, 2 PA01, 3 PC00, 4 PC01, 5 PC02, 6 PC03, 7 PA02, 8 PA03, 9 PB04, 10 PB05, 11 AVSS, 12 AVDD, 13 PB06, 14 PB07, 15 PB08, 16 PB09, 17 PA04, 18 PA05, 19 PA06, 20 PA07, 21 PC05, 22 PC06, 23 PC07, 24 VDDIO, 25 GND, 26 PA08, 27 PA09, 28 PA10, 29 PA11, 30 VDDIO, 31 GND, 32 PB10, 33 PB11, 34 PB12, 35 PB13, 36 PB14, 37 PB15, 38 PC08, 39 PC09, 40 PC10, 41 PC11, 42 PC12, 43 PC13, 44 PC14, 45 PC15, 46 PA12, 47 PA13, 48 PA14, 49 PA15, 50 GND, 51 VDDIO, 52 PA16, 53 PA17, 54 PA18, 55 PA19, 56 PC16, 57 PC17, 58 PC18, 59 PC19, 60 PC20, 61 PC21, 62 GND, 63 VDDIO, 64 PB16, 65 PB17, 66 PB18, 67 PB19, 68 PB20, 69 PB21, 70 PA20, 71 PA21, 72 PA22, 73 PA23, 74 PA24, 75 PA25, 76 GND, 77 VDDIO, 78 PB22, 79 PB23, 80 PB24, 81 PB25, 82 PC24, 83 PC25, 84 PC26, 85 PC27, 86 PC28, 87 PA27, 88 RESET_N, 89 PA28, 90 GND, 91 VDDCORE, 92 VDDIN, 93 PA30, 94 PA31, 95 PB30, 96 PB31, 97 PB00, 98 PB01, 99 PB02, 100 PB03

## Notices in the file
Copyright (c) 2019 Microchip Technology Inc.
SPDX-License-Identifier: Apache-2.0
Licensed under the Apache License, Version 2.0 (the "License");
you may not use this file except in compliance with the License.
You may obtain a copy of the License at
http://www.apache.org/licenses/LICENSE-2.0
Unless required by applicable law or agreed to in writing, software
distributed under the License is distributed on an "AS IS" BASIS,
WITHOUT WARRANTIES OR CONDITIONS OF ANY KIND, either express or implied.
See the License for the specific language governing permissions and
limitations under the License.
