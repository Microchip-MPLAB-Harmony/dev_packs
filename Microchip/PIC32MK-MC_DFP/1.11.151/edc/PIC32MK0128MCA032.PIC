# PIC32MK0128MCA032 register map
Vendor: Microchip
Architecture 32xxxx. Special function registers and configuration words.
Registers are 32-bit, read-write, reset 0x0 unless marked. A register's access mark holds for its fields unless they carry their own. Addresses are absolute, and some are shared; only a register's first bit layout is shown; lines under a group give offsets from that group; [hi:lo] are bit positions; {n}, {i} and the like mark numbered series; 'fields as' and 'values as' point back to an identical list; <NAME> marks a mode.

## Further device data
pins=1: RPB14/PWMH1/RB14; 2: RPB15/PWML1/RB15; 3: MCLR; 4: VSS; 5: VDD; 6: OA2OUT/AN0/C2IN2-/RPA0/RA0; 7: OA2IN+/AN1/C2IN1+/C2IN3-/RPA1/RA1; 8: PGD3/VREF-/OA2IN-/AN2/C2IN1-/RPB0/CTED2/RB0; 9: PGC3/OA1OUT/VREF+/AN3/C1IN2-/RPB1/CTED1/RB1; 10: PGC1/OA1IN+/AN4/C1IN1+/C1IN3-/RPB2/RB2; 11: PGD1/OA1IN-/AN5/CTCMP/C1IN1-/RTCC/RPB3/RB3; 12: AVDD; 13: AVSS; 14: AN9/C3IN4-/FLT4/RC11; 15: DAC1/AN12/RPA8/SDA2/RA8; 16: TDI/FLT15/RPB4/SCL2/RB4; 17: AN13/RPA4/T1G/RA4; 18: VDD; 19: OSCI/CLKI/AN17/RPC12/RC12; 20: OSCO/CLKO/RPC15/RC15; 21: VSS; 22: PGD2/RPB5/SDA1/RB5; 23: PGC2/RPB6/SCL1/RB6; 24: AN15/RPB7/SCK1/INT0/RB7; 25: TMS/AN16/LVDIN/RPB9/RB9; 26: VSS; 27: TDO/RPB10/PWMH3/RB10; 28: TCK/RPB11/PWML3/RB11; 29: RPB12/PWMH2/RB12; 30: RPB13/PWML2/CTPLS/RB13; 31: PWMH4/RA10; 32: RPA7/PWML4/RA7, interrupts=0 CORE_TIMER — Core Timer Interrupt; 1 CORE_SOFTWARE_0 — Core Software Interrupt 0; 2 CORE_SOFTWARE_1 — Core Software Interrupt 1; 3 EXTERNAL_0 — External Interrupt 0; 4 TIMER_1 — Timer1; 5 INPUT_CAPTURE_1_ERROR — Input Capture 1 Error; 6 INPUT_CAPTURE_1 — Input Capture 1; 7 OUTPUT_COMPARE_1 — Output Compare 1; 8 EXTERNAL_1 — External Interrupt 1; 9 TIMER_2 — Timer2; 10 INPUT_CAPTURE_2_ERROR — Input Capture 2 Error; 11 INPUT_CAPTURE_2 — Input Capture 2; 12 OUTPUT_COMPARE_2 — Output Compare 2; 13 EXTERNAL_2 — External Interrupt 2; 14 TIMER_3 — Timer3; 15 INPUT_CAPTURE_3_ERROR — Input Capture 3 Error; 16 INPUT_CAPTURE_3 — Input Capture 3; 17 OUTPUT_COMPARE_3 — Output Compare 3; 18 EXTERNAL_3 — External Interrupt 3; 19 TIMER_4 — Timer4; 20 INPUT_CAPTURE_4_ERROR — Input Capture 4 Error; 21 INPUT_CAPTURE_4 — Input Capture 4; 22 OUTPUT_COMPARE_4 — Output Compare 4; 23 EXTERNAL_4 — External Interrupt 4; 24 TIMER_5 — Timer5; 30 RTCC — Real Time Clock; 31 FLASH_CONTROL — Flash Control Event; 32 COMPARATOR_1 — Comparator 1 Interrupt; 33 COMPARATOR_2 — Comparator 2 Interrupt; 35 SPI1_FAULT — SPI1 Fault; 36 SPI1_RX — SPI1 Receive Done; 37 SPI1_TX — SPI1 Transfer Done; 38 UART1_FAULT — UART1 Fault; 39 UART1_RX — UART1 Receive Done; 40 UART1_TX — UART1 Transfer Done; 41 I2C1_BUS — I2C1 Bus Collision Event; 42 I2C1_SLAVE — I2C1 Slave Event; 43 I2C1_MASTER — I2C1 Master Event; 44 CHANGE_NOTICE_A — PORTA Input Change Interrupt; 45 CHANGE_NOTICE_B — PORTB Input Change Interrupt; 46 CHANGE_NOTICE_C — PORTC Input Change Interrupt; 47 CHANGE_NOTICE_D — PORTD Input Change Interrupt; 53 SPI2_FAULT — SPI2 Fault; 54 SPI2_RX — SPI2 Receive Done; 55 SPI2_TX — SPI2 Transfer Done; 56 UART2_FAULT — UART2 Fault; 57 UART2_RX — UART2 Receive Done; 58 UART2_TX — UART2 Transfer Done; 59 I2C2_BUS — I2C2 Bus Collision Event; 60 I2C2_SLAVE — I2C2 Slave Event; 61 I2C2_MASTER — I2C2 Master Event; 71 CTMU — CTMU Interrupt; 72 DMA0 — DMA Channel 0; 73 DMA1 — DMA Channel 1; 74 DMA2 — DMA Channel 2; 75 DMA3 — DMA Channel 3; 92 ADC — ADC Global Interrupt; 94 ADC_DC1 — ADC Digital Comparator 1; 95 ADC_DC2 — ADC Digital Comparator 2; 96 ADC_DF1 — ADC Digital Filter 1; 97 ADC_DF2 — ADC Digital Filter 2; 100 ADC_FAULT — ADC Fault; 101 ADC_EOS — ADC End of Scan; 102 ADC_ARDY — ADC Ready; 103 ADC_URDY — ADC Update Ready After Suspend; 104 ADC_DMA — ADC First Class Channels DMA; 105 ADC_EARLY — ADC Early Group Interrupt; 106 ADC_DATA0 — ADC Data 0; 107 ADC_DATA1 — ADC Data 1; 108 ADC_DATA2 — ADC Data 2; 109 ADC_DATA3 — ADC Data 3; 110 ADC_DATA4 — ADC Data 4; 111 ADC_DATA5 — ADC Data 5; 115 ADC_DATA9 — ADC Data 9; 118 ADC_DATA12 — ADC Data 12; 119 ADC_DATA13 — ADC Data 13; 121 ADC_DATA15 — ADC Data 15; 122 ADC_DATA16 — ADC Data 16; 123 ADC_DATA17 — ADC Data 17; 156 ADC_DATA50; 159 ADC_DATA53 — ADC Data 53; 160 COMPARATOR_3 — Comparator 3 Interrupt; 169 QEI1 — QEI 1 Interrupt; 170 QEI2 — QEI 2 Interrupt; 171 PWM_PRI — PWM Primary Event; 172 PWM_SEC — PWM Secondary Event; 173 PWM1 — PWM 1 Interrupt; 174 PWM2 — PWM 2 Interrupt; 175 PWM3 — PWM 3 Interrupt; 176 PWM4 — PWM 4 Interrupt; 182 DMA4 — DMA Channel 4; 183 DMA5 — DMA Channel 5; 184 DMA6 — DMA Channel 6; 185 DMA7 — DMA Channel 7; 230 SYSTEM_BUS_PROTECTION — System Bus Protection Violation; 247 PCACHE — P - Cache Event Interrupt; 249 CLC1; 254 CORE_PERF_COUNT — MPU Core Performance Counter Event; 255 CORE_FAST_DEBUG_CHAN — Core Fast Debug Channel
