# CEC1712H_N2_SX register map
Vendor: Microchip Technology; Series: CEC1712H_N2_SX; File version: 0
Microchip CEC1712H_N2_SX Microcontroller
CPU: CM4 r1p0, little endian, no MPU, 3 interrupt priority bits, 172 interrupts
Registers are 32-bit, read-write, reset 0x0 unless marked. A register's access mark holds for its fields unless they carry their own. Offsets are from the block's base; lines under a group give offsets from that group; [hi:lo] are bit positions; {n}, {i} and the like mark numbered series; 'fields as' and 'values as' point back to an identical list; <NAME> marks a mode.

## Memory map
0x40000400 WDT size 0x15 — The function of the Watchdog Timer is to provide a mechanism to detect if the internal embedded controller has failed.
0x40000C00 TIMER16_0 size 0x14 — This 16-bit timer block offers a simple mechanism for firmware to maintain a time base
0x40000C20 TIMER16_1 size 0x14
0x40000C80 TIMER32_0 size 0x14 — This 32-bit timer block offers a simple mechanism for firmware to maintain a time base
0x40000CA0 TIMER32_1 size 0x14
0x40001000 CCT size 0x34 — This is a 16-bit auto-reloading timer/counter.
0x40002400 DMA_MAIN size 0x8 — DMA Main Registers
0x40002440 DMA_CHAN00 size 0x2C — DMA Channel 00 Registers
0x40002480 DMA_CHAN01 size 0x2C — DMA Channel 01 Registers
0x400024C0 DMA_CHAN02 size 0x19 — DMA Channel 02 Registers
{0x40002440+0x40*n} DMA_CHAN{n:02} size 0x19 (n=3..11)
0x40004000 SMB0 size 0x79 — The SMBus interface can handle standard SMBus 2.0 protocols as well as I2C interface.
0x40004400 SMB1 size 0x79
0x40004800 SMB2 size 0x79
0x40004C00 SMB3 size 0x79
0x40005000 SMB4 size 0x79
0x40005100 I2C0 size 0x79 — The I2C interface can handle standard I2C interface.
0x40005200 I2C1 size 0x79
0x40005300 I2C2 size 0x79
0x40005800 PWM0 size 0xC — The PWM block generates an arbitrary duty cycle output at frequencies from less than 0.1 Hz to 24 MHz
0x40005820 PWM2 size 0xC
0x40005830 PWM3 size 0xC
0x40005850 PWM5 size 0xC
0x40005860 PWM6 size 0xC
0x40005870 PWM7 size 0xC
0x40006000 TACH0 size 0x10 — This block monitors TACH output signals from various types of fans, and determines their speed.
0x40006010 TACH1 size 0x10
0x40007400 RTOS size 0x10 — RTOS is a 32-bit timer designed to operate on the 32kHz oscillator which is available during all chip sleep states.
0x40007C00 ADC size 0x90 — This block is designed to convert external analog voltage readings into digital values.
0x40008C00 TFDP size 0x5 — The TFDP serially transmits EC-originated diagnostic vectors to an external debug trace system.
0x40009800 HTM0 size 0xA — The Hibernation Timer can generate a wake event to the Embedded Controller (EC) when it is in a hibernation mode
0x40009820 HTM1 size 0xA
0x4000A400 VBAT size 0x2C — The VBAT Register Bank block is a block implemented for miscellaneous battery-backed registers
0x4000A800 VBAT_RAM size 0x58 — The VBAT RAM is operational while the main power rail is operational, and will retain its values powered by battery power while the main rail is unpowered.
0x4000AC80 WEEK size 0x1C — The Week Timer and the Sub-Week Timer assert the Power-Up Event Output which automatically powers-up the system from the G3 state
0x4000AE00 VCI size 0x24 — The VBAT-Powered Control Interfaces with the RTC With Date and DST Adjustment as well as the Week Alarm.
0x4000B800 LED0 size 0x18 — The LED is implemented using a PWM that can be driven either by the 48 MHz clock or by a 32.768 KHz clock input.
0x4000B900 LED1 size 0x18
0x4000E000 ECIA size 0x20C — The ECIA works in conjunction with the processor interrupt interface to handle hardware interrupts andd exceptions.
0x4000FC00 EC_REG_BANK size 0x190 — This block is designed to be accessed internally by the EC via the register interface.
0x40070000 QMSPI size 0x88 — The QMSPI may be used to communicate with various peripheral devices that use a Serial Peripheral Interface
0x40080100 PCR size 0x88 — The Power, Clocks, and Resets (PCR) Section identifies clock sources, and reset inputs to the chip
0x40081000 GPIO size 0x7C4 — GPIO Pin Control Registers
0x40082000 OTP — OTP Programming registers.
0x400F2400 UART0 size 0x3F1 — The 16550 UART is a full-function Two Pin Serial Port that supports the standard RS-232 Interface.
0x400F2800 UART1 size 0x3F1
0x400F2C00 UART2 size 0x3F1
0x400F5000 RTC size 0x20 — This is the set of registers that are automatically counted by hardware every 1 second while the block is enabled
0x400FFF00 GCR size 0x22 — The Logical Device Configuration registers support motherboard designs in which the resources required by their components are known and assigned by the BIOS at POST.
0xE000E000 SystemControl size 0xD8C — System Control Registers
0xE000E010 SysTick size 0x10 — System timer
0xE000E100 NVIC size 0xE04 — Nested Vectored Interrupt Controller

## Interrupts
0 GIRQ08 (GPIO)
1 GIRQ09 (GPIO)
2 GIRQ10 (GPIO)
3 GIRQ11 (GPIO)
4 GIRQ12 (GPIO)
5 GIRQ13 (SMB0)
6 GIRQ14 (DMA_CHAN00)
7 GIRQ15 (UART0)
10 GIRQ18 (QMSPI)
12 GIRQ20 (OTP)
13 GIRQ21 (WDT)
14 GIRQ23 (TIMER16_0)
17 GIRQ26 (GPIO)
20 I2CSMB0 (SMB0)
21 I2CSMB1 (SMB1)
22 I2CSMB2 (SMB2)
23 I2CSMB3 (SMB3)
{n+24} DMA_CH{n:02} (DMA_CHAN{n:02}) (n=0..11)
40 UART0
41 UART1
44 UART2
71 TACH0
72 TACH1
78 ADC_SNGL (ADC)
79 ADC_RPT (ADC)
83 LED0
84 LED1
91 QMSPI
111 TMR (RTOS)
112 HTMR0 (HTM0)
113 HTMR1 (HTM1)
114 WK (WEEK)
115 WKSUB (WEEK)
116 WKSEC (WEEK)
117 WKSUBSEC (WEEK)
118 SYSPWR (WEEK)
119 RTC
120 RTC_ALARM (RTC)
122 VCI_IN0 (VCI)
123 VCI_IN1 (VCI)
136 TIMER16_0
137 TIMER16_1
140 TIMER32_0
141 TIMER32_1
146 CCT
147 CCT_CAP0 (CCT)
148 CCT_CAP1 (CCT)
149 CCT_CAP2 (CCT)
150 CCT_CAP3 (CCT)
151 CCT_CAP4 (CCT)
152 CCT_CAP5 (CCT)
153 CCT_CMP0 (CCT)
154 CCT_CMP1 (CCT)
158 I2CSMB4 (SMB4)
168 I2C0
169 I2C1
170 I2C2
171 WDT

## Notices in the file
Copyright (c) 2023 Microchip Technology Inc.
SPDX-License-Identifier: Apache-2.0
Licensed under the Apache License, Version 2.0 (the "License");
you may not use this file except in compliance with the License.
You may obtain a copy of the License at
http://www.apache.org/licenses/LICENSE-2.0
Unless required by applicable law or agreed to in writing, software
distributed under the License is distributed on an "AS IS" BASIS,
WITHOUT WARRANTIES OR CONDITIONS OF ANY KIND, either express or implied.
See the License for the specific language governing permissions and
limitations under the License.
