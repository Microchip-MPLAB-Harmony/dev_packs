# ATSAML22J18A device description
Architecture: CORTEX-M0PLUS; Family: SAML; Series: SAML22
Parameters: NUM_IRQ=26 (Number of interrupt request lines), __CM0PLUS_REV=0x0001 (Cortex-M0+ Core Revision), __MPU_PRESENT=1 (MPU present or not), __NVIC_PRIO_BITS=2 (Number of Bits used for Priority Levels), __VTOR_PRESENT=1 (Vector Table Offset Register present or not), __Vendor_SysTickConfig=0 (Set to 1 if different SysTick Config is used), __ARCH_ARM=1, __ARCH_ARM_CORTEX_M=1, __DEVICE_IS_SAM=1
Programming and debug interfaces: SWD
Registers are 32-bit, read-write, reset 0x0 unless marked. A register's access mark holds for its fields unless they carry their own. Offsets are from the block's base; lines under a group give offsets from that group; [hi:lo] are bit positions; {n}, {i} and the like mark numbered series; 'fields as' and 'values as' point back to an identical list; <NAME> marks a mode.

## Ordering variants
ATSAML22J18A-MU: QFN64, pinout SAML22J, up to 32 MHz, -40 to 85 C, 1.62 to 3.63 V
ATSAML22J18A-MN: QFN64, pinout SAML22J, up to 32 MHz, -40 to 105 C, 1.62 to 3.63 V
ATSAML22J18A-AU: TQFP64, pinout SAML22J, up to 32 MHz, -40 to 85 C, 1.62 to 3.63 V
ATSAML22J18A-AN: TQFP64, pinout SAML22J, up to 32 MHz, -40 to 105 C, 1.62 to 3.63 V

## Memory
base space: start 0 size 0x100000000, little endian
  0x00000000 FLASH size 0x40000 flash, rw, executable, page 64
  0x00800000 CAL size 0x8 fuses, ro
  0x00802000 LOCKBIT size 0x4 fuses, ro
  0x00806000 OTP1 size 0x8 fuses, ro
  0x00806008 OTP2 size 0x8 fuses, ro
  0x00806010 OTP3 size 0x8 fuses, ro
  0x00806018 OTP4 size 0x8 fuses, ro
  0x00806020 OTP5 size 0x8 fuses, ro
  0x00804000 USER_PAGE size 0x100 user_page, rw, page 64
  0x00400000 RWW size 0x2000 flash, rw, executable, page 64
  0x20000000 HSRAM size 0x8000 ram, rw, executable
  0x40000000 HPB0 size 0x4000 io, rw
  0x41000000 HPB1 size 0x10000 io, rw
  0x42000000 HPB2 size 0x6000 io, rw
  0xE0000000 PPB size 0x100000 io, rw
  0xE000E000 SCS size 0x00001000 io, rw
  0x40000000 PERIPHERALS size 0x20000000 io, rw
fuses space: start 0x00000000 size 0x20000000, little endian

## Peripheral instances (address, pins/pin function, parameters)
AC at 0x42003400
  pins: AIN0 PA02/B; AIN1 PA03/B; AIN2 PB04/B; AIN3 PB05/B; CMP0 PA12/H or PA18/H; CMP1 PA13/H or PA19/H
  parameters: COMPCTRL_MUXNEG_OPAMP=7 (OPAMP selection for MUXNEG), GCLK_ID=26 (Index of Generic Clock), NUM_CMP=2 (Number of comparators), PAIRS=1 (Number of pairs of comparators), HYST_LVL_CONFIG=1 (Hysteresis level configuration), INSTANCE_ID=77
ADC at 0x42003000
  pins: AIN0 PA02/B; AIN1 PA03/B; AIN2 PB08/B; AIN3 PB09/B; AIN4 PA04/B; AIN5 PA05/B; AIN6 PA06/B; AIN7 PA07/B; AIN{n} PB{n-8:02}/B (n=8..15); VREFA PA03/B; VREFB PA02/B
  parameters: DMAC_ID_RESRDY=31 (index of DMA RESRDY trigger), EXTCHANNEL_MSB=19 (Number of external channels), GCLK_ID=25 (index of Generic Clock), INT_CH30=2 (Select OPAMP or CTAT on Channel 30), MASTER_SLAVE_MODE=0 (ADC Master/Slave Mode), LOAD_CALIB=1 (CALIB register to be loaded from NVM), INSTANCE_ID=76
AES at 0x42004000
  parameters: DMAC_ID_RD=36 (DMA DATA Read trigger), DMAC_ID_WR=35 (DMA DATA Write trigger), INSTANCE_ID=80
CCL at 0x42004800
  pins: IN0 PA04/I or PA16/I or PB22/I; IN1 PA05/I or PA17/I or PB00/I; IN2 PA06/I or PA18/I or PB01/I; IN3 PA08/I or PA30/I; IN4 PA09/I; IN5 PA10/I; IN6 PA22/I or PB06/I; IN7 PA23/I or PB07/I; IN8 PA24/I or PB08/I; IN9 PB14/I; IN10 PB15/I; IN11 PB16/I; OUT0 PA07/I or PA19/I or PB02/I or PB23/I; OUT1 PA11/I or PA31/I or PB11/I; OUT2 PA25/I or PB09/I; OUT3 PB17/I
  parameters: GCLK_ID=28 (GCLK index for CCL), IO_NUM=12 (Numer of input pins), LUT_NUM=4 (Number of LUT in a CCL), SEQ_NUM=2 (Number of SEQ in a CCL), INSTANCE_ID=82
DMAC at 0x41008000
  parameters: CH_BITS=4 (Number of bits to select channel), CH_NUM=16 (Number of channels), EVIN_NUM=4 (Number of input events), EVOUT_NUM=4 (Number of output events), LVL_BITS=2 (Number of bit to select level priority), LVL_NUM=4 (Enable priority level number), QOSCTRL_D_RESETVALUE=2 (QOS dmac ahb interface reset value), QOSCTRL_F_RESETVALUE=2 (QOS dmac fetch interface reset value), QOSCTRL_WRB_RESETVALUE=2 (QOS dmac write back interface reset value), TRIG_BITS=6 (Number of bits to select trigger source), TRIG_NUM=40 (Number of peripheral triggers), INSTANCE_ID=36
DSU at 0x41002000
  parameters: INSTANCE_ID=33
EIC at 0x40002800
  pins: EXTINT0 PA16/A or PB00/A or PB16/A or PA00/A; EXTINT1 PA17/A or PB01/A or PB17/A or PA01/A; EXTINT2 PA02/A or PA18/A or PB02/A; EXTINT3 PA03/A or PA19/A or PB03/A; EXTINT4 PA04/A or PA20/A or PB04/A; EXTINT5 PA05/A or PA21/A or PB05/A; EXTINT6 PA06/A or PA22/A or PB06/A or PB22/A; EXTINT7 PA07/A or PA23/A or PB07/A or PB23/A; EXTINT8 PB08/A; EXTINT9 PA09/A or PB09/A; EXTINT10 PA10/A or PA30/A; EXTINT11 PA11/A or PA31/A or PB11/A; EXTINT12 PA12/A or PA24/A or PB12/A; EXTINT13 PA13/A or PA25/A or PB13/A; EXTINT14 PB14/A or PB30/A or PA14/A; EXTINT15 PA27/A or PB15/A or PB31/A or PA15/A; NMI PA08/A
  parameters: EXTINT_NUM=16, GCLK_ID=3, NUMBER_OF_CONFIG_REGS=2, NUMBER_OF_INTERRUPTS=16, INSTANCE_ID=10
EVSYS at 0x42000000
  parameters: CHANNELS=8 (Number of Channels), CHANNELS_BITS=3 (Number of bits to select Channel), CHANNELS_MSB=7 (Number of Channels - 1), EXTEVT_NUM=0 (Number of External Event Generators), GCLK_ID_{n}={n+7} (Index of Generic Clock {n}) (n=0..7), GENERATORS=71 (Total Number of Event Generators), GENERATORS_BITS=7 (Number of bits to select Event Generator), USERS=31 (Total Number of Event Users), USERS_BITS=5 (Number of bits to select Event User), INSTANCE_ID=64
FREQM at 0x40002C00
  parameters: GCLK_ID_MSR=4 (Index of measure generic clock), GCLK_ID_REF=5 (Index of reference generic clock), INSTANCE_ID=11
GCLK at 0x40001C00
  pins: IO0 PB14/H or PB22/H or PA14/H or PA27/H or PA30/H; IO1 PB15/H or PB23/H or PA15/H; IO2 PB16/H or PA16/H; IO3 PA17/H or PB17/H; IO4 PA10/H or PA20/H
  parameters: GENDIV_BITS=16, GEN_BITS=3, GEN_NUM=5 (Number of Generic Clock Generators), GEN_NUM_MSB=4 (Number of Generic Clock Generators - 1), GEN_SOURCE_NUM_MSB=7 (Number of Generic Clock Sources - 1), NUM=30 (Number of Generic Clock Users), SOURCE_BITS=3, SOURCE_DFLL48M=6, SOURCE_DPLL96M=7, SOURCE_GCLKGEN1=2, SOURCE_GCLKIN=1, SOURCE_NUM=8 (Number of Generic Clock Sources), SOURCE_OSCULP32K=3, SOURCE_OSC16M=5, SOURCE_XOSC=0, SOURCE_XOSC32K=4, INSTANCE_ID=7
MCLK at 0x40000800
  parameters: BUPDIV_IMPLEMENTED=1, CTRLA_MCSEL_GCLK=1, CTRLA_MCSEL_OSC8M=0, MCLK_CLK_APB_NUM=3, SYSTEM_CLOCK=1000000 (System Clock Frequency at Reset), INSTANCE_ID=2
  clocks: AHB HPB0 bit 0, HPB1 bit 1, HPB2 bit 2, DMAC bit 3, USB bit 4, DSU bit 5, PAC bit 7, NVMCTRL bit 8, HSRAM bit 9, NVMCTRL_PICACHU bit 10
MTB at 0x4100A000
  parameters: INSTANCE_ID=37
NVMCTRL at 0x41004000
  pins: MARGIN VMARGIN
  parameters: FACTORY_WORD_IMPLEMENTED_MASK=0XC0000007FFFFFFFF, GCLK_ID=29 (Index of Generic Clock for test), PMSB=3, PSZ_BITS=6, USER_PAGE_OFFSET=0x00800000, USER_WORD_IMPLEMENTED_MASK=0XC01FFFFFFFFFFFFF, RWWEE_PAGES=128, RWWEE_ROW_SIZE=256, RWW_EEPROM_ADDR=0x00400000 (Start address of the WWR EEPROM area), RWW_EEPROM_SIZE=8192 (Byte size of the WWR EEPROM area), FLASH_SIZE=262144, PAGE_SIZE=64, PAGES=4096, PAGES_PR_REGION=256, ROW_SIZE=256, PSM_0_FRMFW_FWS_1_MAX_FREQ=12000000, PSM_0_FRMLP_FWS_0_MAX_FREQ=18000000, PSM_0_FRMLP_FWS_1_MAX_FREQ=36000000, PSM_0_FRMHS_FWS_0_MAX_FREQ=25000000, PSM_0_FRMHS_FWS_1_MAX_FREQ=50000000, PSM_1_FRMFW_FWS_1_MAX_FREQ=12000000, PSM_1_FRMLP_FWS_0_MAX_FREQ=8000000, PSM_1_FRMLP_FWS_1_MAX_FREQ=12000000, INSTANCE_ID=34
FUSES at OTP5_FUSES 0x00806020 in fuses, USER_FUSES 0x00804000 in fuses
OSCCTRL at 0x40001000
  pins: XIN PB22/XIN; XOUT PB23/XOUT
  parameters: DFLL48M_COARSE_MSB=5, DFLL48M_FINE_MSB=9, GCLK_ID_DFLL48=0 (Index of Generic Clock for DFLL48), GCLK_ID_FDPLL=1 (Index of Generic Clock for DPLL), GCLK_ID_FDPLL32K=2 (Index of Generic Clock for DPLL 32K), CFD_VERSION=0x100, DFLL48M_VERSION=0x320, FDPLL_VERSION=0x211, OSC16M_VERSION=0x101, XOSC_VERSION=0x201, INSTANCE_ID=4
OSC32KCTRL at 0x40001400
  pins: XIN32 PA00/XIN32; XOUT32 PA01/XOUT32
  parameters: OSC32K_COARSE_CALIB_MSB=6, INSTANCE_ID=5
PAC at 0x40000000
  parameters: HPB_NUM=3 (Number of bridges AHB/APB), INTFLAG_NUM=4 (Number of intflag registers), INSTANCE_ID=0
PM at 0x40000400
  pins: RESET_N RESET_N
  parameters: BIAS_RAM_HS=1 (one if RAM HS can be back biased), PD_NUM=0 (Number of switchable Power Domain), INSTANCE_ID=1, HAS_BACKUP_SLEEP=1 (BACKUP Sleep mode supported), HAS_OFF_SLEEP=1 (OFF Sleep mode supported), HAS_BBIASHS_FIELD=1 (BBIASHS field is present), HAS_PLCFG=1 (Performance Level Configuration supported), HAS_IORET_BIT=1 (IORET bit is present)
PORT at 0x41006000, PORT_IOBUS 0x60000000
  pins: P{n} PA{n:02} (n=0..25); P27 PA27; P30 PA30; P31 PA31; P{n} PB{n-32:02} (n=32..41); P43 PB11; P44 PB12; P45 PB13; P46 PB14; P47 PB15; P48 PB16; P49 PB17; P54 PB22; P55 PB23; P62 PB30; P63 PB31
  parameters: BITS=93, DRVSTR=1 (DRVSTR supported), EV_NUM=4, GROUPS=2, ODRAIN=0 (ODRAIN supported), SLEWLIM=0 (SLEWLIM supported), INSTANCE_ID=35
PTC at 0x42003800
  pins: X24 PA04/B; X25 PA05/B; X26 PA06/B; X27 PA07/B; X28 PA16/B; X29 PA17/B; X30 PA18/B; X31 PA19/B; X0 PA11/B; Y0 PA11/B; X1 PA10/B; Y1 PA10/B; X2 PA09/B; Y2 PA09/B; X3 PA08/B; Y3 PA08/B; X8 PA02/B; Y8 PA02/B; X9 PA03/B; Y9 PA03/B; X10 PB04/B; Y10 PB04/B; X11 PB05/B; Y11 PB05/B; X12 PB06/B; Y12 PB06/B; X13 PB07/B; Y13 PB07/B; X14 PB08/B; Y14 PB08/B; X15 PB09/B; Y15 PB09/B; X16 PA20/B; Y16 PA20/B; X17 PA21/B; Y17 PA21/B; X18 PA22/B; Y18 PA22/B; X19 PA23/B; Y19 PA23/B; X21 PA27/B; Y21 PA27/B; X22 PA30/B; Y22 PA30/B; X23 PA31/B; Y23 PA31/B
  parameters: DMAC_ID_EOC=37 (Index of DMA EOC trigger), DMAC_ID_SEQ=38 (Index of DMA SEQ trigger), DMAC_ID_WCOMP=39 (Index of DMA WCOMP trigger), GCLK_ID=27 (Index of Generic Clock), LINES_MSB=31, LINES_NUM=32 (Number of PTC lines), Y_LINES_MSB=23, Y_LINES_NUM=24 (Number of Y lines), INSTANCE_ID=78
RSTC at 0x40000C00
  parameters: BACKUP_IMPLEMENTED=1, NUMBER_OF_EXTWAKE=0 (number of external wakeup line), INSTANCE_ID=3
RTC at 0x40002400
  pins: IN0 PB00/G; IN1 PB02/G; IN2 PA02/G or PB01/F; OUT PB01/G
  parameters: ALARM_NUM=1 (Number of Alarms), BKUP_NUM=8 (Number of Backup Registers), COMP16_NUM=2 (Number of 16-bit Comparators), COMP32_NUM=1 (Number of 32-bit Comparators), DMAC_ID_TIMESTAMP=1 (DMA RTC timestamp trigger), GPR_NUM=2 (Number of General-Purpose Registers), PER_NUM=8 (Number of Periodic Intervals), TAMPER_NUM=5 (Number of Tamper Inputs), INSTANCE_ID=9
SERCOM0 at 0x42000400 (SERCOM)
  pins: PAD0 PA04/D or PA08/C or PA20/C; PAD1 PA05/D or PA09/C or PA21/C; PAD2 PA06/D or PA10/C or PA22/C or PB22/C; PAD3 PA07/D or PA11/C or PA23/C or PB23/C
  parameters: DMAC_ID_RX=2 (Index of DMA RX trigger), DMAC_ID_TX=3 (Index of DMA TX trigger), GCLK_ID_CORE=16, GCLK_ID_SLOW=15, INT_MSB=6, PMSB=3, SPI=1 (SPI mode implemented?), TWIM=0 (TWI Master mode implemented?), TWIS=0 (TWI Slave mode implemented?), TWI_HSMODE=0 (TWI HighSpeed mode implemented?), USART=1 (USART mode implemented?), USART_ISO7816=1 (USART ISO7816 mode implemented?), USART_LIN_MASTER=0 (USART LIN Master mode implemented?), USART_RS485=1 (USART RS485 mode implemented?), INSTANCE_ID=65
SERCOM1 at 0x42000800 (SERCOM)
  pins: PAD0 PB30/C or PA00/D or PA16/C; PAD1 PB31/C or PA01/D or PA17/C; PAD2 PA30/D or PA18/C; PAD3 PA31/D or PA19/C
  parameters: DMAC_ID_RX=4 (Index of DMA RX trigger), DMAC_ID_TX=5 (Index of DMA TX trigger), GCLK_ID_CORE=17, GCLK_ID_SLOW=15, INT_MSB=6, PMSB=3, SPI=1 (SPI mode implemented?), TWIM=1 (TWI Master mode implemented?), TWIS=1 (TWI Slave mode implemented?), TWI_HSMODE=1 (TWI HighSpeed mode implemented?), USART=1 (USART mode implemented?), USART_ISO7816=1 (USART ISO7816 mode implemented?), USART_LIN_MASTER=0 (USART LIN Master mode implemented?), USART_RS485=1 (USART RS485 mode implemented?), INSTANCE_ID=66
SERCOM2 at 0x42000C00 (SERCOM)
  pins: PAD0 PA22/D or PA16/D; PAD1 PA23/D or PA17/D; PAD2 PA18/D or PA20/D or PA24/C; PAD3 PA19/D or PA21/D or PA25/C
  parameters: DMAC_ID_RX=6 (Index of DMA RX trigger), DMAC_ID_TX=7 (Index of DMA TX trigger), GCLK_ID_CORE=18, GCLK_ID_SLOW=15, INT_MSB=6, PMSB=3, SPI=1 (SPI mode implemented?), TWIM=1 (TWI Master mode implemented?), TWIS=1 (TWI Slave mode implemented?), TWI_HSMODE=0 (TWI HighSpeed mode implemented?), USART=1 (USART mode implemented?), USART_ISO7816=1 (USART ISO7816 mode implemented?), USART_LIN_MASTER=0 (USART LIN Master mode implemented?), USART_RS485=1 (USART RS485 mode implemented?), INSTANCE_ID=67
SERCOM3 at 0x42001000 (SERCOM)
  pins: PAD0 PB12/C or PA12/D or PB08/D or PB02/C; PAD1 PB13/C or PA13/D or PB09/D or PB03/C; PAD2 PB14/C or PA14/D or PB00/C; PAD3 PB15/C or PA15/D or PB11/D or PB01/C
  parameters: DMAC_ID_RX=8 (Index of DMA RX trigger), DMAC_ID_TX=9 (Index of DMA TX trigger), GCLK_ID_CORE=19, GCLK_ID_SLOW=15, INT_MSB=6, PMSB=3, SPI=1 (SPI mode implemented?), TWIM=1 (TWI Master mode implemented?), TWIS=1 (TWI Slave mode implemented?), TWI_HSMODE=0 (TWI HighSpeed mode implemented?), USART=1 (USART mode implemented?), USART_ISO7816=1 (USART ISO7816 mode implemented?), USART_LIN_MASTER=0 (USART LIN Master mode implemented?), USART_RS485=1 (USART RS485 mode implemented?), INSTANCE_ID=68
SLCD at 0x42003C00
  pins: LP0 PB06/B; LP1 PB07/B; LP2 PB08/B; LP3 PB09/B; LP4 PA04/B; LP5 PA05/B; LP6 PA06/B; LP7 PA07/B; LP11 PA08/B; LP12 PA09/B; LP13 PA10/B; LP14 PA11/B; LP21 PB11/B; LP22 PB12/B; LP23 PB13/B; LP24 PB14/B; LP25 PB15/B; LP{n} PA{n-16}/B (n=28..35); LP42 PB16/B; LP43 PB17/B; LP48 PA20/B; LP49 PA21/B; LP50 PA22/B; LP51 PA23/B
  parameters: DMAC_ID_ABMDRDY=34, DMAC_ID_ACMDRDY=33, DMAC_ID_DMU=32, MAX_COM=8 (Max number of COM lines (4 or 8)), MAX_SEG=44 (Max number of SEG lines (24 or 44)), NB_LP=52 (Number of LCD pins ([28..64] or [48..64])), INSTANCE_ID=79
SUPC at 0x40001800
  pins: OUT0 PB01/H; OUT1 PB02/H; PSOK PB00/H; VBAT PB03/H
  parameters: BOD12_CALIB_MSB=5, BOD33_CALIB_MSB=5, OUT_NUM_MSB=1 (MSB of backup output pad Number), HAS_VMON_BIT=1 (VMON bit is present), HAS_RUNBKUP_BIT=1 (RUNBKUP bit is present), HAS_STDBYPL0_BIT=1 (STDBYPL0 bit is present), HAS_LPEFF_BIT=1 (LPEFF bit is present), HAS_SEL_BIT=1 (SEL bit is present), HAS_BOD33_REG_NAME=1 (Name of BOD register is BOD33), HAS_NO_TSEN=1 (SUPC does not have TSEN), INSTANCE_ID=6
TC0 at 0x42002000 (TC)
  pins: WO0 PA22/E or PB08/E or PB12/E; WO1 PA23/E or PB09/E or PB13/E
  parameters: CC_NUM=2, DMAC_ID_OVF=19 (Indexes of DMA Overflow trigger), DMAC_ID_MC0=20 (Indexes of DMA Match/Compare 0 trigger), DMAC_ID_MC1=21 (Indexes of DMA Match/Compare 1 trigger), EXT=0, GCLK_ID=23, MASTER_SLAVE_MODE=1 (TC type 1 : Master, 2 : Slave), OW_NUM=2, INSTANCE_ID=72
TC1 at 0x42002400 (TC)
  pins: WO0 PA24/E or PB14/E; WO1 PA25/E or PB11/E or PB15/E
  parameters: CC_NUM=2, DMAC_ID_OVF=22 (Indexes of DMA Overflow trigger), DMAC_ID_MC0=23 (Indexes of DMA Match/Compare 0 trigger), DMAC_ID_MC1=24 (Indexes of DMA Match/Compare 1 trigger), EXT=0, GCLK_ID=23, MASTER_SLAVE_MODE=2 (TC type 1 : Master, 2 : Slave), OW_NUM=2, INSTANCE_ID=73
TC2 at 0x42002800 (TC)
  pins: WO0 PB02/E or PB16/E; WO1 PB03/E or PB17/E
  parameters: CC_NUM=2, DMAC_ID_OVF=25 (Indexes of DMA Overflow trigger), DMAC_ID_MC0=26 (Indexes of DMA Match/Compare 0 trigger), DMAC_ID_MC1=27 (Indexes of DMA Match/Compare 1 trigger), EXT=0, GCLK_ID=24, MASTER_SLAVE_MODE=1 (TC type 1 : Master, 2 : Slave), OW_NUM=2, INSTANCE_ID=74
TC3 at 0x42002C00 (TC)
  pins: WO0 PA20/E or PB00/E or PB22/E; WO1 PA21/E or PB01/E or PB23/E
  parameters: CC_NUM=2, DMAC_ID_OVF=28 (Indexes of DMA Overflow trigger), DMAC_ID_MC0=29 (Indexes of DMA Match/Compare 0 trigger), DMAC_ID_MC1=30 (Indexes of DMA Match/Compare 1 trigger), EXT=0, GCLK_ID=24, MASTER_SLAVE_MODE=2 (TC type 1 : Master, 2 : Slave), OW_NUM=2, INSTANCE_ID=75
TCC0 at 0x42001C00 (TCC)
  pins: WO0 PA24/F or PA04/E or PA08/E or PB30/E; WO1 PA25/F or PA05/E or PA09/E or PB31/E; WO2 PA10/F or PA18/F or PB22/F; WO3 PA11/F or PA19/F or PB23/F; WO4 PA22/F or PB16/F or PA14/F; WO5 PA15/F or PA23/F or PA27/F or PB11/F or PB17/F; WO6 PA12/F or PA16/F or PA20/F or PB12/F; WO7 PA13/F or PA17/F or PA21/F or PB13/F
  parameters: CC_NUM=4 (Number of Compare/Capture units), DITHERING=1 (Dithering feature implemented), DMAC_ID_OVF=14 (DMA overflow/underflow/retrigger trigger), DMAC_ID_MC0=15 (Indexes of DMA Match/Compare 0 trigger), DMAC_ID_MC1=16 (Indexes of DMA Match/Compare 1 trigger), DMAC_ID_MC2=17 (Indexes of DMA Match/Compare 2 trigger), DMAC_ID_MC3=18 (Indexes of DMA Match/Compare 3 trigger), DTI=1 (Dead-Time-Insertion feature implemented), EXT=31 (Coding of implemented extended features), GCLK_ID=22 (Index of Generic Clock), OTMX=1 (Output Matrix feature implemented), OW_NUM=8 (Number of Output Waveforms), PG=1 (Pattern Generation feature implemented), SIZE=24, SWAP=1 (DTI outputs swap feature implemented), TYPE=0 (TCC type 0 : NA, 1 : Master, 2 : Slave), INSTANCE_ID=71
TRNG at 0x42004400
  parameters: INSTANCE_ID=81
USB at 0x41000000
  pins: DM PA24/G; DP PA25/G; SOF_1KHZ PA23/G or PB22/G
  parameters: EPT_NBR=8 (Number of USB end points (obsolete)), EPT_NUM=8 (Number of USB end points), GCLK_ID=6 (Index of Generic Clock), PIPE_NUM=0 (Number of USB pipes), INSTANCE_ID=32
WDT at 0x40002000
  parameters: INSTANCE_ID=8
MPU at 0xE000ED90
NVIC at 0xE000E100
  parameters: NUM_IRQ=26 (Number of interrupt requests), __NVIC_PRIO_BITS=2 (Number of NVIC interrupt priority bits)
SysTick at 0xE000E010
SystemControl at 0xE000E000
  parameters: __VTOR_PRESENT=1 (Vector Table Offset Register present)

## Interrupts
-15 Reset — Reset Vector, invoked on Power up and warm reset
-14 NonMaskableInt — Non maskable Interrupt, cannot be stopped or preempted
-13 HardFault — Hard Fault, all classes of Fault
-5 SVCall — System Service Call via SVC instruction
-2 PendSV — Pendable request for system service
-1 SysTick — System Tick Timer
0 SYSTEM (MCLK OSCCTRL OSC32KCTRL PAC PM SUPC) — System peripherals shared interrupt
1 WDT — Watchdog Timer
2 RTC — Real Time Counter
3 EIC — External Interrupt Controller
4 FREQM — Frequency Meter
5 USB — Universal Serial Bus
6 NVMCTRL — Non-Volatile Memory Controller
7 DMAC — Direct Memory Controller
8 EVSYS — Event Systems
9 SERCOM0 — Serial Communication Interface 0
10 SERCOM1 — Serial Communication Interface 1
11 SERCOM2 — Serial Communication Interface 2
12 SERCOM3 — Serial Communication Interface 3
15 TCC0 — Timer/Counter for Control Applications 0
16 TC0 — Timer/Counter 0
17 TC1 — Timer/Counter 1
18 TC2 — Timer/Counter 2
19 TC3 — Timer/Counter 3
20 ADC — Analog-to-Digital Converter
21 AC — Analog Comparators
22 PTC — Peripheral Touch Controller
23 SLCD — Segment Liquid Crytal Display Controller
24 AES — Advanced Encryption Standard
25 TRNG — True Random Number Generator

## Event generators
1 OSCCTRL_XOSC_FAIL, 2 OSC32KCTRL_XOSC32K_FAIL, 3 RTC_CMP_0, 4 RTC_CMP_1, 5 RTC_TAMPER, 6 RTC_OVF, {n+7} RTC_PER_{n} (n=0..7), {n+15} EIC_EXTINT_{n} (n=0..15), {n+31} DMAC_CH_{n} (n=0..3), 35 TCC0_OVF, 36 TCC0_TRG, 37 TCC0_CNT, {n+38} TCC0_MC_{n} (n=0..3), {3n+42} TC{n}_OVF (n=0..3), {3n+43} TC{n}_MC_0 (n=0..3), {3n+44} TC{n}_MC_1 (n=0..3), 54 ADC_RESRDY, 55 ADC_WINMON, 56 AC_COMP_0, 57 AC_COMP_1, 58 AC_WIN_0, {n+61} SLCD_FC{n}OVERFLOW (n=0..2), 64 SLCD_DT, 65 TRNG_READY, {n+66} CCL_LUTOUT_{n} (n=0..3), 70 PAC_ACCERR

## Event users
0 RTC_TAMPER, {n+1} PORT_EV_{n} (n=0..3), {n+5} DMAC_CH_{n} (n=0..3), 9 TCC0_EV_0, 10 TCC0_EV_1, {n+11} TCC0_MC_{n} (n=0..3), {n+15} TC{n}_EVU (n=0..3), 19 ADC_START, 20 ADC_SYNC, 21 AC_SOC_0, 22 AC_SOC_1, {n+24} CCL_LUTIN_{n} (n=0..3), 29 MTB_START, 30 MTB_STOP

## Properties
SIGNATURES: DSU_DID=0x10820105

## Pinouts (pin number, pad)
SAML22J: 1 PA00, 2 PA01, 3 PA02, 4 PA03, 5 PB04, 6 PB05, 7 GNDANA, 8 VDDANA, 9 PB06, 10 PB07, 11 PB08, 12 PB09, 13 PA04, 14 PA05, 15 PA06, 16 PA07, 17 PA08, 18 PA09, 19 PA10, 20 PA11, 21 VDDIO, 22 GNDIO, 23 VLCD, 24 PB11, 25 PB12, 26 PB13, 27 PB14, 28 PB15, 29 PA12, 30 PA13, 31 PA14, 32 PA15, 33 GNDIO, 34 VDDIO, 35 PA16, 36 PA17, 37 PA18, 38 PA19, 39 PB16, 40 PB17, 41 PA20, 42 PA21, 43 PA22, 44 PA23, 45 PA24, 46 PA25, 47 GNDIO, 48 VDDIO, 49 PB22, 50 PB23, 51 PA27, 52 RESET_N, 53 VDDCORE, 54 GNDIO, 55 VSW, 56 VDDIO, 57 PA30, 58 PA31, 59 PB30, 60 PB31, 61 PB00, 62 PB01, 63 PB02, 64 PB03

## Notices in the file
Copyright (c) 2018 Microchip Technology Inc.
SPDX-License-Identifier: Apache-2.0
Licensed under the Apache License, Version 2.0 (the "License");
you may not use this file except in compliance with the License.
You may obtain a copy of the License at
http://www.apache.org/licenses/LICENSE-2.0
Unless required by applicable law or agreed to in writing, software
distributed under the License is distributed on an "AS IS" BASIS,
WITHOUT WARRANTIES OR CONDITIONS OF ANY KIND, either express or implied.
See the License for the specific language governing permissions and
limitations under the License.
