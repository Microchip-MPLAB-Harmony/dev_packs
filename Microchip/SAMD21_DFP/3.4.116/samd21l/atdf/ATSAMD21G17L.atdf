# ATSAMD21G17L device description
Architecture: CORTEX-M0PLUS; Family: SAMD; Series: SAMD21
Parameters: NUM_IRQ=30 (Number of Interrupt Requests), __CM0PLUS_REV=0x0001 (Cortex-M0+ revision), __MPU_PRESENT=0 (MPU feature implemented), __NVIC_PRIO_BITS=2 (Number of NVIC priority bits), __VTOR_PRESENT=1 (Vector Table Offset Register feature implemented), __Vendor_SysTickConfig=0 (SysTick feature implemented), __ARCH_ARM=1, __ARCH_ARM_CORTEX_M=1, __DEVICE_IS_SAM=1
Programming and debug interfaces: SWD
Registers are 32-bit, read-write, reset 0x0 unless marked. A register's access mark holds for its fields unless they carry their own. Offsets are from the block's base; lines under a group give offsets from that group; [hi:lo] are bit positions; {n}, {i} and the like mark numbered series; 'fields as' and 'values as' point back to an identical list; <NAME> marks a mode.

## Ordering variants
ATSAMD21G17L-MU: QFN48, pinout SAMD21G1xL, up to 48 MHz, -40 to 85 C, 1.62 to 3.63 V
ATSAMD21G17L-MN: QFN48, pinout SAMD21G1xL, up to 48 MHz, -40 to 105 C, 1.62 to 3.63 V
ATSAMD21G17L-MF: QFN48, pinout SAMD21G1xL, up to 48 MHz, -40 to 125 C, 1.62 to 3.63 V

## Memory
base space: start 0 size 0x100000000, little endian
  0x00000000 FLASH size 0x20000 flash, rw, executable, page 64
  0x0080A000 AUX3 size 0x100 fuses, rw, page 64
  0x00800000 CAL size 0x8 fuses, ro
  0x00802000 LOCKBIT size 0x4 fuses, ro
  0x00806000 OTP1 size 0x8 fuses, ro
  0x00806008 OTP2 size 0x8 fuses, ro
  0x00806020 OTP4 size 0xE0 fuses, rw, page 64
  0x00806030 TEMP_LOG size 0x8 fuses, ro
  0x00804000 USER_PAGE size 0x100 user_page, rw, page 64
  0x00400000 RWW size 0x1000 flash, rw, executable, page 64
  0x20000000 HMCRAMC0 size 0x4000 ram, rw, executable
  0x40000000 HPB0 size 0x10000 io, rw
  0x41000000 HPB1 size 0x10000 io, rw
  0x42000000 HPB2 size 0x10000 io, rw
  0xE0000000 PPB size 0x100000 io, rw
  0xE000E000 SCS size 0x00001000 io, rw
  0x40000000 PERIPHERALS size 0x20000000 io, rw
fuses space: start 0x00000000 size 0x20000000, little endian

## Peripheral instances (address, pins/pin function, parameters)
AC at 0x42004400
  pins: AIN0 PA04/B; AIN1 PA05/B; AIN2 PA06/B; AIN3 PA07/B; CMP0 PA12/H or PA18/H; CMP1 PA13/H or PA19/H
  parameters: CMP_NUM=2 (Number of comparators), GCLK_ID_ANA=32 (Index of Generic Clock for analog), GCLK_ID_DIG=31 (Index of Generic Clock for digital), NUM_CMP=2, PAIRS=1 (Number of pairs of comparators), INSTANCE_ID=81
AC1 at 0x42005400 (AC)
  pins: AIN0 PB04/B; AIN1 PB05/B; AIN2 PB02/B; AIN3 PB03/B; CMP0 PA24/H; CMP1 PA25/H
  parameters: CMP_NUM=2 (Number of comparators), GCLK_ID_ANA=32 (Index of Generic Clock for analog), GCLK_ID_DIG=31 (Index of Generic Clock for digital), NUM_CMP=2, PAIRS=1 (Number of pairs of comparators), INSTANCE_ID=85
ADC at 0x42004000
  pins: AIN0 PA02/B; AIN1 PA03/B; AIN2 PB08/B; AIN3 PB09/B; AIN4 PA04/B; AIN5 PA05/B; AIN6 PA06/B; AIN7 PA07/B; AIN8 PB00/B; AIN9 PB01/B; AIN10 PB02/B; AIN11 PB03/B; AIN12 PB04/B; AIN13 PB05/B; AIN16 PA08/B; AIN17 PA09/B; AIN18 PA10/B; AIN19 PA11/B; VREFP PA04/B
  parameters: DMAC_ID_RESRDY=39 (Index of DMA RESRDY trigger), EXTCHANNEL_MSB=19 (Number of external channels), GCLK_ID=30 (Index of Generic Clock), RESULT_BITS=16 (Size of RESULT.RESULT bitfield), RESULT_MSB=15 (Size of Result), INSTANCE_ID=80
DAC at 0x42004800
  pins: VOUT PA02/B; VREFP PA03/B
  parameters: DMAC_ID_EMPTY=40 (Index of DMAC EMPTY trigger), GCLK_ID=33 (Index of Generic Clock), INSTANCE_ID=82
DMAC at 0x41004800
  parameters: CH_BITS=4 (Number of bits to select channel), CH_NUM=12 (Number of channels), EVIN_NUM=4 (Number of input events), EVOUT_NUM=4 (Number of output events), LVL_BITS=2 (Number of bit to select level priority), LVL_NUM=4 (Enable priority level number), TRIG_BITS=6 (Number of bits to select trigger source), TRIG_NUM=50 (Number of peripheral triggers), INSTANCE_ID=36
DSU at 0x41002000
  parameters: INSTANCE_ID=33
EIC at 0x40001800
  pins: EXTINT0 PA16/A or PB00/A; EXTINT1 PA17/A or PB01/A; EXTINT2 PA02/A or PA18/A or PB02/A; EXTINT3 PA03/A or PA19/A or PB03/A; EXTINT4 PA04/A or PA20/A or PB04/A; EXTINT5 PA05/A or PA21/A or PB05/A; EXTINT6 PA06/A or PA22/A; EXTINT7 PA07/A or PA23/A; EXTINT8 PA28/A or PB08/A; EXTINT9 PA09/A or PB09/A; EXTINT10 PA10/A or PA30/A or PB10/A; EXTINT11 PA11/A or PA31/A or PB11/A; EXTINT12 PA12/A or PA24/A; EXTINT13 PA13/A or PA25/A; EXTINT14 PA14/A; EXTINT15 PA27/A or PA15/A; NMI PA08/A
  parameters: CONFIG_NUM=2 (Number of CONFIG registers), EXTINT_NUM=16 (Number of External Interrupts), GCLK_ID=5 (Index of Generic Clock), INSTANCE_ID=6
EVSYS at 0x42000400
  parameters: CHANNELS=12 (Number of Channels), CHANNELS_BITS=4 (Number of bits to select Channel), CHANNELS_MSB=11 (Number of Channels - 1), EXTEVT_NUM=0 (Number of External Event Generators), GCLK_ID_{n}={n+7} (Index of Generic Clock {n}) (n=0..11), GENERATORS=83 (Total Number of Event Generators), GENERATORS_BITS=7 (Number of bits to select Event Generator), USERS=37 (Total Number of Event Users), USERS_BITS=6 (Number of bits to select Event User), INSTANCE_ID=65
GCLK at 0x40000C00
  pins: IO0 PA14/H or PA27/H or PA28/H or PA30/H; IO1 PA15/H; IO2 PA16/H; IO3 PA17/H; IO4 PA10/H or PA20/H or PB10/H; IO5 PA11/H or PA21/H or PB11/H; IO6 PA22/H; IO7 PA23/H
  parameters: GENDIV_BITS=16, GEN_NUM=9 (Number of Generic Clock Generators), GEN_NUM_MSB=8 (Number of Generic Clock Generators - 1), GEN_SOURCE_NUM_MSB=8 (Number of Generic Clock Sources - 1), NUM=38 (Number of Generic Clock Users), SOURCE_DFLL48M=7 (DFLL48M output), SOURCE_FDPLL=8 (FDPLL output), SOURCE_GCLKGEN1=2 (Generic clock generator 1 output), SOURCE_GCLKIN=1 (Generator input pad), SOURCE_NUM=9 (Number of Generic Clock Sources), SOURCE_OSCULP32K=3 (OSCULP32K oscillator output), SOURCE_OSC8M=6 (OSC8M oscillator output), SOURCE_OSC32K=4 (OSC32K oscillator outpur), SOURCE_XOSC=0 (XOSC oscillator output), SOURCE_XOSC32K=5 (XOSC32K oscillator output), INSTANCE_ID=3
SBMATRIX at 0x41007000 (HMATRIXB)
  parameters: MASTER_NUM=3, MASTER_CM0PLUS=0, MASTER_DSU=1, MASTER_DMAC=2, SLAVE_NUM=7, SLAVE_FLASH=0, SLAVE_HPB0=1, SLAVE_HPB1=2, SLAVE_HPB2=3, SLAVE_HMCRAMC0=4, SLAVE_HMCRAMC0_ALT0=5, SLAVE_HMCRAMC0_ALT1=6, INSTANCE_ID=39
MTB at 0x41006000
  parameters: INSTANCE_ID=38
NVMCTRL at 0x41004000
  pins: MARGIN VMARGIN
  parameters: FACTORY_WORD_IMPLEMENTED_MASK=0xC0000007FFFFFFFF, PMSB=3, PSZ_BITS=6, ROW_PAGES=4, USER_PAGE_OFFSET=0x00800000, USER_WORD_IMPLEMENTED_MASK=0xC01FFFFFFFFFFFFF, RWWEE_PAGES=64 (Page size), RWWEE_ROW_SIZE=256, RWW_EEPROM_ADDR=0x00400000 (Start address of the WWR EEPROM area), RWW_EEPROM_SIZE=4096 (Byte size of the WWR EEPROM area), FLASH_SIZE=131072, PAGE_SIZE=64, PAGES=2048, PAGES_PR_REGION=128, ROW_SIZE=256, PSM_0_FRMFW_FWS_1_MAX_FREQ=12000000, PSM_0_FRMLP_FWS_0_MAX_FREQ=18000000, PSM_0_FRMLP_FWS_1_MAX_FREQ=36000000, PSM_0_FRMHS_FWS_0_MAX_FREQ=25000000, PSM_0_FRMHS_FWS_1_MAX_FREQ=50000000, PSM_1_FRMFW_FWS_1_MAX_FREQ=12000000, PSM_1_FRMLP_FWS_0_MAX_FREQ=8000000, PSM_1_FRMLP_FWS_1_MAX_FREQ=12000000, INSTANCE_ID=34
FUSES at AUX3_FUSES 0x0080A000 in fuses, OTP4_FUSES 0x00806020 in fuses, TEMP_LOG_FUSES 0x00806030 in fuses, USER_FUSES 0x00804000 in fuses
PAC0 at 0x40000000 (PAC)
  parameters: WPROT_DEFAULT_VAL=0x00000000 (PAC protection mask at reset), INSTANCE_ID=0
PAC1 at 0x41000000 (PAC)
  parameters: WPROT_DEFAULT_VAL=0x00000002 (PAC protection mask at reset), INSTANCE_ID=32
PAC2 at 0x42000000 (PAC)
  parameters: WPROT_DEFAULT_VAL=0x00800000 (PAC protection mask at reset), INSTANCE_ID=64
PM at 0x40000400
  pins: RESET_N RESET_N
  parameters: CTRL_MCSEL_DFLL48M=3, CTRL_MCSEL_GCLK=0, CTRL_MCSEL_OSC8M=1, CTRL_MCSEL_XOSC=2, PM_CLK_APB_NUM=2, INSTANCE_ID=1
  clocks: AHB HPB0 bit 0, HPB1 bit 1, HPB2 bit 2, DSU bit 3, NVMCTRL bit 4, DMAC bit 5
PORT at 0x41004400, PORT_IOBUS 0x60000000
  pins: P{n} PA{n:02} (n=2..25); P27 PA27; P28 PA28; P30 PA30; P31 PA31; P32 PB00; P33 PB01; P34 PB02; P35 PB03; P36 PB04; P37 PB05; P40 PB08; P41 PB09; P42 PB10; P43 PB11
  parameters: BITS=64 (Number of PORT pins), DRVSTR=1 (DRVSTR supported), GROUPS=2 (Number of 32-bit PORT groups), ODRAIN=0 (ODRAIN supported), SLEWLIM=0 (SLEWLIM supported), INSTANCE_ID=35
RTC at 0x40001400
  parameters: ALARM_NUM=1 (Number of Alarms), COMP16_NUM=2 (Number of 16-bit Comparators), COMP32_NUM=1 (Number of 32-bit Comparators), GCLK_ID=4 (Index of Generic Clock), NUM_OF_ALARMS=1 (Number of Alarms (obsolete)), NUM_OF_COMP16=2 (Number of 16-bit Comparators (obsolete)), NUM_OF_COMP32=1 (Number of 32-bit Comparators (obsolete)), INSTANCE_ID=5
SERCOM0 at 0x42000800 (SERCOM)
  pins: PAD0 PA04/D or PA08/C; PAD1 PA05/D or PA09/C; PAD2 PA06/D or PA10/C; PAD3 PA07/D or PA11/C
  parameters: DMAC_ID_RX=1 (Index of DMA RX trigger), DMAC_ID_TX=2 (Index of DMA TX trigger), GCLK_ID_CORE=20 (Index of Generic Clock for Core), GCLK_ID_SLOW=19 (Index of Generic Clock for SMbus timeout), INT_MSB=6, INSTANCE_ID=66
SERCOM1 at 0x42000C00 (SERCOM)
  pins: PAD0 PA16/C; PAD1 PA17/C; PAD2 PA30/D or PA18/C; PAD3 PA31/D or PA19/C
  parameters: DMAC_ID_RX=3 (Index of DMA RX trigger), DMAC_ID_TX=4 (Index of DMA TX trigger), GCLK_ID_CORE=21 (Index of Generic Clock for Core), GCLK_ID_SLOW=19 (Index of Generic Clock for SMbus timeout), INT_MSB=6, INSTANCE_ID=67
SERCOM2 at 0x42001000 (SERCOM)
  pins: PAD0 PA08/D or PA12/C; PAD1 PA09/D or PA13/C; PAD2 PA10/D or PA14/C; PAD3 PA11/D or PA15/C
  parameters: DMAC_ID_RX=5 (Index of DMA RX trigger), DMAC_ID_TX=6 (Index of DMA TX trigger), GCLK_ID_CORE=22 (Index of Generic Clock for Core), GCLK_ID_SLOW=19 (Index of Generic Clock for SMbus timeout), INT_MSB=6, INSTANCE_ID=68
SERCOM3 at 0x42001400 (SERCOM)
  pins: PAD0 PA16/D or PA22/C; PAD1 PA17/D or PA23/C; PAD2 PA18/D or PA20/D or PA24/C; PAD3 PA19/D or PA21/D or PA25/C
  parameters: DMAC_ID_RX=7 (Index of DMA RX trigger), DMAC_ID_TX=8 (Index of DMA TX trigger), GCLK_ID_CORE=23 (Index of Generic Clock for Core), GCLK_ID_SLOW=19 (Index of Generic Clock for SMbus timeout), INT_MSB=6, INSTANCE_ID=69
SERCOM4 at 0x42001800 (SERCOM)
  pins: PAD0 PA12/D or PB08/D; PAD1 PA13/D or PB09/D; PAD2 PA14/D or PB10/D; PAD3 PA15/D or PB11/D
  parameters: DMAC_ID_RX=9 (Index of DMA RX trigger), DMAC_ID_TX=10 (Index of DMA TX trigger), GCLK_ID_CORE=24 (Index of Generic Clock for Core), GCLK_ID_SLOW=19 (Index of Generic Clock for SMbus timeout), INT_MSB=6, INSTANCE_ID=70
SERCOM5 at 0x42001C00 (SERCOM)
  pins: PAD0 PA22/D or PB02/D; PAD1 PA23/D or PB03/D; PAD2 PA24/D or PB00/D or PA20/C; PAD3 PA25/D or PB01/D or PA21/C
  parameters: DMAC_ID_RX=11 (Index of DMA RX trigger), DMAC_ID_TX=12 (Index of DMA TX trigger), GCLK_ID_CORE=25 (Index of Generic Clock for Core), GCLK_ID_SLOW=19 (Index of Generic Clock for SMbus timeout), INT_MSB=6, INSTANCE_ID=71
SYSCTRL at 0x40000800
  pins: XIN PA14/XIN; XOUT PA15/XOUT
  parameters: BGAP_CALIB_MSB=11, BOD33_CALIB_MSB=5, DFLL48M_COARSE_MSB=5, DFLL48M_FINE_MSB=9, GCLK_ID_DFLL48=0 (Index of Generic Clock for DFLL48), GCLK_ID_FDPLL=1 (Index of Generic Clock for DPLL), GCLK_ID_FDPLL32K=2 (Index of Generic Clock for DPLL 32K), OSC32K_COARSE_CALIB_MSB=6, POR33_ENTEST_MSB=1, SYSTEM_CLOCK=1000000 (Initial system clock frequency), ULPVREF_DIVLEV_MSB=3, ULPVREG_FORCEGAIN_MSB=1, ULPVREG_RAMREFSEL_MSB=2, VREF_CONTROL_MSB=48, VREF_STATUS_MSB=7, VREG_LEVEL_MSB=2, BOD12_VERSION=0x112, BOD33_VERSION=0x112, DFLL48M_VERSION=0x301, FDPLL_VERSION=0x111, OSCULP32K_VERSION=0x111, OSC8M_VERSION=0x120, OSC32K_VERSION=0x112, VREF_VERSION=0x201, VREG_VERSION=0x201, XOSC_VERSION=0x114, XOSC32K_VERSION=0x113, INSTANCE_ID=2
TC3 at 0x42002C00 (TC)
  pins: WO0 PA18/E or PA14/E; WO1 PA19/E or PA15/E
  parameters: CC8_NUM=2 (Number of 8-bit Counters), CC16_NUM=2 (Number of 16-bit Counters), CC32_NUM=2 (Number of 32-bit Counters), DITHERING_EXT=0 (Dithering feature implemented), DMAC_ID_OVF=24 (Indexes of DMA Overflow trigger), DMAC_ID_MC0=25 (Indexes of DMA Match/Compare 0 trigger), DMAC_ID_MC1=26 (Indexes of DMA Match/Compare 1 trigger), GCLK_ID=27 (Index of Generic Clock), MASTER=0, OW_NUM=2 (Number of Output Waveforms), PERIOD_EXT=0 (Period feature implemented), SHADOW_EXT=0 (Shadow feature implemented), INSTANCE_ID=75
TC4 at 0x42003000 (TC)
  pins: WO0 PA22/E or PB08/E; WO1 PA23/E or PB09/E
  parameters: CC8_NUM=2 (Number of 8-bit Counters), CC16_NUM=2 (Number of 16-bit Counters), CC32_NUM=2 (Number of 32-bit Counters), DITHERING_EXT=0 (Dithering feature implemented), DMAC_ID_OVF=27 (Indexes of DMA Overflow trigger), DMAC_ID_MC0=28 (Indexes of DMA Match/Compare 0 trigger), DMAC_ID_MC1=29 (Indexes of DMA Match/Compare 1 trigger), GCLK_ID=28 (Index of Generic Clock), MASTER=1, OW_NUM=2 (Number of Output Waveforms), PERIOD_EXT=0 (Period feature implemented), SHADOW_EXT=0 (Shadow feature implemented), INSTANCE_ID=76
TC5 at 0x42003400 (TC)
  pins: WO0 PA24/E or PB10/E; WO1 PA25/E or PB11/E
  parameters: CC8_NUM=2 (Number of 8-bit Counters), CC16_NUM=2 (Number of 16-bit Counters), CC32_NUM=2 (Number of 32-bit Counters), DITHERING_EXT=0 (Dithering feature implemented), DMAC_ID_OVF=30 (Indexes of DMA Overflow trigger), DMAC_ID_MC0=21 (Indexes of DMA Match/Compare 0 trigger), DMAC_ID_MC1=32 (Indexes of DMA Match/Compare 1 trigger), GCLK_ID=28 (Index of Generic Clock), MASTER=0, OW_NUM=2 (Number of Output Waveforms), PERIOD_EXT=0 (Period feature implemented), SHADOW_EXT=0 (Shadow feature implemented), INSTANCE_ID=77
TC6 at 0x42003800 (TC)
  pins: WO0 PB02/E; WO1 PB03/E
  parameters: CC8_NUM=2 (Number of 8-bit Counters), CC16_NUM=2 (Number of 16-bit Counters), CC32_NUM=2 (Number of 32-bit Counters), DITHERING_EXT=0 (Dithering feature implemented), DMAC_ID_OVF=33 (Indexes of DMA Overflow trigger), DMAC_ID_MC0=34 (Indexes of DMA Match/Compare 0 trigger), DMAC_ID_MC1=35 (Indexes of DMA Match/Compare 1 trigger), GCLK_ID=29 (Index of Generic Clock), MASTER=1, OW_NUM=2 (Number of Output Waveforms), PERIOD_EXT=0 (Period feature implemented), SHADOW_EXT=0 (Shadow feature implemented), INSTANCE_ID=78
TC7 at 0x42003C00 (TC)
  pins: WO0 PA20/E or PB00/E; WO1 PA21/E or PB01/E
  parameters: CC8_NUM=2 (Number of 8-bit Counters), CC16_NUM=2 (Number of 16-bit Counters), CC32_NUM=2 (Number of 32-bit Counters), DITHERING_EXT=0 (Dithering feature implemented), DMAC_ID_OVF=36 (Indexes of DMA Overflow trigger), DMAC_ID_MC0=37 (Indexes of DMA Match/Compare 0 trigger), DMAC_ID_MC1=38 (Indexes of DMA Match/Compare 1 trigger), GCLK_ID=29 (Index of Generic Clock), MASTER=0, OW_NUM=2 (Number of Output Waveforms), PERIOD_EXT=0 (Period feature implemented), SHADOW_EXT=0 (Shadow feature implemented), INSTANCE_ID=79
TCC0 at 0x42002000 (TCC)
  pins: WO0 PA04/E or PA08/E; WO1 PA05/E or PA09/E; WO2 PA10/F or PA18/F; WO3 PA11/F or PA19/F; WO4 PA22/F or PB10/F or PA14/F; WO5 PA23/F or PB11/F or PA15/F; WO6 PA12/F or PA20/F or PA16/F; WO7 PA13/F or PA21/F or PA17/F
  parameters: CC_NUM=4 (Number of Compare/Capture units), DITHERING=1 (Dithering feature implemented), DMAC_ID_OVF=13 (DMA overflow/underflow/retrigger trigger), DMAC_ID_MC0=14 (DMA Match/Compare 0 trigger), DMAC_ID_MC1=15 (DMA Match/Compare 1 trigger), DMAC_ID_MC2=16 (DMA Match/Compare 2 trigger), DMAC_ID_MC3=17 (DMA Match/Compare 3 trigger), DTI=1 (Dead-Time-Insertion feature implemented), EXT=31 ((@_DITHERING*16+@_PG*8+@_SWAP*4+@_DTI*2+@_OTMX*1)), GCLK_ID=26 (Index of Generic Clock), MASTER=0, OTMX=1 (Output Matrix feature implemented), OW_NUM=8 (Number of Output Waveforms), PG=1 (Pattern Generation feature implemented), SIZE=24, SWAP=1 (DTI outputs swap feature implemented), TYPE=1 (TCC type 0 : NA, 1 : Master, 2 : Slave), INSTANCE_ID=72
TCC1 at 0x42002400 (TCC)
  pins: WO0 PA06/E or PA10/E or PA30/E; WO1 PA07/E or PA11/E or PA31/E; WO2 PA08/F or PA24/F; WO3 PA09/F or PA25/F
  parameters: CC_NUM=2 (Number of Compare/Capture units), DITHERING=1 (Dithering feature implemented), DMAC_ID_OVF=18 (DMA overflow/underflow/retrigger trigger), DMAC_ID_MC0=19 (DMA Match/Compare 0 trigger), DMAC_ID_MC1=20 (DMA Match/Compare 1 trigger), DTI=0 (Dead-Time-Insertion feature implemented), EXT=24 (Coding of implemented extended features), GCLK_ID=26 (Index of Generic Clock), MASTER=1, OTMX=0 (Output Matrix feature implemented), OW_NUM=4 (Number of Output Waveforms), PG=1 (Pattern Generation feature implemented), SIZE=24, SWAP=0 (DTI outputs swap feature implemented), TYPE=2 (TCC type 0 : NA, 1 : Master, 2 : Slave), INSTANCE_ID=73
TCC2 at 0x42002800 (TCC)
  pins: WO0 PA12/E or PA16/E; WO1 PA13/E or PA17/E
  parameters: CC_NUM=2 (Number of Compare/Capture units), DITHERING=0 (Dithering feature implemented), DMAC_ID_OVF=21 (DMA overflow/underflow/retrigger trigger), DMAC_ID_MC0=22 (DMA Match/Compare 0 trigger), DMAC_ID_MC1=23 (DMA Match/Compare 1 trigger), DTI=0 (Dead-Time-Insertion feature implemented), EXT=0 (Coding of implemented extended features), GCLK_ID=27 (Index of Generic Clock), MASTER=0, OTMX=0 (Output Matrix feature implemented), OW_NUM=2 (Number of Output Waveforms), PG=0 (Pattern Generation feature implemented), SIZE=16, SWAP=0 (DTI outputs swap feature implemented), TYPE=0 (TCC type 0 : NA, 1 : Master, 2 : Slave), INSTANCE_ID=74
TCC3 at 0x42006000 (TCC)
  pins: WO0 PA02/F; WO1 PA03/F; WO2 PA04/F or PB02/F; WO3 PA05/F or PB03/F; WO4 PA06/F or PA30/F; WO5 PA07/F or PA31/F; WO6 PA27/F or PB08/F; WO7 PA28/F or PB09/F
  parameters: CC_NUM=4 (Number of Compare/Capture units), DITHERING=1 (Dithering feature implemented), DMAC_ID_OVF=45 (DMA overflow/underflow/retrigger trigger), DMAC_ID_MC0=46 (DMA Match/Compare 0 trigger), DMAC_ID_MC1=47 (DMA Match/Compare 1 trigger), DTI=1 (Dead-Time-Insertion feature implemented), EXT=31 (Coding of implemented extended features), GCLK_ID=37 (Index of Generic Clock), MASTER=0, OTMX=1 (Output Matrix feature implemented), OW_NUM=8 (Number of Output Waveforms), PG=1 (Pattern Generation feature implemented), SIZE=24, SWAP=1 (DTI outputs swap feature implemented), TYPE=0 (TCC type 0 : NA, 1 : Master, 2 : Slave), INSTANCE_ID=88
WDT at 0x40001000
  parameters: GCLK_ID=3 (Index of Generic Clock), INSTANCE_ID=4
NVIC at 0xE000E100
  parameters: NUM_IRQ=30 (Number of interrupt requests), __NVIC_PRIO_BITS=2 (Number of NVIC interrupt priority bits)
SysTick at 0xE000E010
SystemControl at 0xE000E000
  parameters: __VTOR_PRESENT=1 (Vector Table Offset Register present)

## Interrupts
-15 Reset — Reset Vector, invoked on Power up and warm reset
-14 NonMaskableInt — Non maskable Interrupt, cannot be stopped or preempted
-13 HardFault — Hard Fault, all classes of Fault
-5 SVCall — System Service Call via SVC instruction
-2 PendSV — Pendable request for system service
-1 SysTick — System Tick Timer
0 PM — Power Manager
1 SYSCTRL — System Controller
2 WDT — Watchdog Timer
3 RTC — Real Time Counter
4 EIC — External Interrupt Controller
5 NVMCTRL — Non-Volatile Memory Controller
6 DMAC — Direct Memory Controller
8 EVSYS — Event Systems
9 SERCOM0 — Serial Communication Interface 0
10 SERCOM1 — Serial Communication Interface 1
11 SERCOM2 — Serial Communication Interface 2
12 SERCOM3 — Serial Communication Interface 3
13 SERCOM4 — Serial Communication Interface 4
14 SERCOM5 — Serial Communication Interface 5
15 TCC0 — Timer/Counter for Control Applications 0
16 TCC1 — Timer/Counter for Control Applications 1
17 TCC2 — Timer/Counter for Control Applications 2
18 TC3 — Timer/Counter 3
19 TC4 — Timer/Counter 4
20 TC5 — Timer/Counter 5
21 TC6 — Timer/Counter 6
22 TC7 — Timer/Counter 7
23 ADC — Analog-to-Digital Converter
24 AC — Analog Comparators
25 DAC — Digital-to-Analog Converter
28 AC1 — Analog Comparators 1
29 TCC3 — Timer/Counter for Control Applications 3

## Event generators
1 RTC_CMP_0, 2 RTC_CMP_1, 3 RTC_OVF, {n+4} RTC_PER_{n} (n=0..7), {n+12} EIC_EXTINT_{n} (n=0..17), {n+30} DMAC_CH_{n} (n=0..3), 34 TCC0_OVF, 35 TCC0_TRG, 36 TCC0_CNT, {n+37} TCC0_MC_{n} (n=0..3), 41 TCC1_OVF, 42 TCC1_TRG, 43 TCC1_CNT, 44 TCC1_MC_0, 45 TCC1_MC_1, 46 TCC2_OVF, 47 TCC2_TRG, 48 TCC2_CNT, 49 TCC2_MC_0, 50 TCC2_MC_1, {3n+42} TC{n}_OVF (n=3..7), {3n+43} TC{n}_MC_0 (n=3..7), {3n+44} TC{n}_MC_1 (n=3..7), 66 ADC_RESRDY, 67 ADC_WINMON, 68 AC_COMP_0, 69 AC_COMP_1, 70 AC_WIN_0, 71 DAC_EMPTY, 74 AC1_COMP_0, 75 AC1_COMP_1, 76 AC1_WIN_0, 77 TCC3_OVF, 78 TCC3_TRG, 79 TCC3_CNT, {n+80} TCC3_MC_{n} (n=0..3)

## Event users
{n} DMAC_CH_{n} (n=0..3), 4 TCC0_EV_0, 5 TCC0_EV_1, {n+6} TCC0_MC_{n} (n=0..3), 10 TCC1_EV_0, 11 TCC1_EV_1, 12 TCC1_MC_0, 13 TCC1_MC_1, 14 TCC2_EV_0, 15 TCC2_EV_1, 16 TCC2_MC_0, 17 TCC2_MC_1, {n+15} TC{n}_EVU (n=3..7), 23 ADC_START, 24 ADC_SYNC, 25 AC_SOC_0, 26 AC_SOC_1, 27 DAC_START, 29 AC1_SOC_0, 30 AC1_SOC_1, 31 TCC3_EV_0, 32 TCC3_EV_1, {n+33} TCC3_MC_{n} (n=0..3)

## Properties
SIGNATURES: DSU_DID=0x10012696

## Pinouts (pin number, pad)
SAMD21G1xL: 1 PA02, 2 PA03, 3 PB04, 4 PB05, 5 GNDANA, 6 VDDANA, 7 PB08, 8 PB09, 9 PA04, 10 PA05, 11 PA06, 12 PA07, 13 PA08, 14 PA09, 15 PA10, 16 PA11, 17 VDDIO, 18 GNDIO, 19 PB10, 20 PB11, 21 PA12, 22 PA13, 23 PA14, 24 PA15, 25 PA16, 26 PA17, 27 PA18, 28 PA19, 29 PA20, 30 PA21, 31 PA22, 32 PA23, 33 PA24, 34 PA25, 35 GNDIO, 36 VDDIO, 37 PA27, 38 RESET_N, 39 PA28, 40 GNDIO, 41 VDDCORE, 42 VDDIN, 43 PA30, 44 PA31, 45 PB00, 46 PB01, 47 PB02, 48 PB03

## Notices in the file
Copyright (c) 2018 Microchip Technology Inc.
SPDX-License-Identifier: Apache-2.0
Licensed under the Apache License, Version 2.0 (the "License");
you may not use this file except in compliance with the License.
You may obtain a copy of the License at
http://www.apache.org/licenses/LICENSE-2.0
Unless required by applicable law or agreed to in writing, software
distributed under the License is distributed on an "AS IS" BASIS,
WITHOUT WARRANTIES OR CONDITIONS OF ANY KIND, either express or implied.
See the License for the specific language governing permissions and
limitations under the License.
