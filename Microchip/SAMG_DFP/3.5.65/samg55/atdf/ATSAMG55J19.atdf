# ATSAMG55J19 device description
Architecture: CORTEX-M4; Family: SAMG; Series: SAMG55
Parameters: __CM4_REV=0x0001 (CM4 Core Revision), __NVIC_PRIO_BITS=4 (Number of Bits used for Priority Levels), __Vendor_SysTickConfig=0 (Set to 1 if different SysTick Config is used), __MPU_PRESENT=1 (MPU present or not), __VTOR_PRESENT=1 (Vector Table Offset Register present or not), __FPU_PRESENT=1 (FPU present or not), LITTLE_ENDIAN=1, __ARCH_ARM=1, __ARCH_ARM_CORTEX_M=1, __DEVICE_IS_SAM=1
Programming and debug interfaces: JTAG, SWD
Registers are 32-bit, read-write, no defined reset value unless marked. A register's access mark holds for its fields unless they carry their own. Offsets are from the block's base; lines under a group give offsets from that group; [hi:lo] are bit positions; {n}, {i} and the like mark numbered series; 'fields as' and 'values as' point back to an identical list; <NAME> marks a mode.

## Ordering variants
ATSAMG55J19A-MU, ATSAMG55J19A-MUT: QFN64, up to 120 MHz, -40 to +105 C, 1.62 to 3.6 V
ATSAMG55J19A-AU, ATSAMG55J19A-AUT: LQFP64, up to 120 MHz, -40 to +105 C, 1.62 to 3.6 V

## Memory
base space: start 0 size 0x100000000, little endian
  0x40000000 PERIPHERALS size 0x20000000 io, rw
  0xE0000000 SYSTEM size 0x10000000 io, rw
  0x00400000 IFLASH size 0x00080000 flash, rw, executable, page 512
  0x00800000 IROM size 0x00400000 rom, executable
  0x20000000 IRAM size 0x00028000 ram, rw, executable
  0x1FC00000 CMCC size 0x4000 other
fuses space: start 0 size 1, little endian
lockbits space: start 0 size 0x8, little endian

## Peripheral instances (address, pins/pin function, parameters)
ADC at 0x40038000
  pins: ADTRG PA8/B; AD0 PA17/X1; AD1 PA18/X1; AD2 PA19/X1; AD3 PA20/X1; AD4 PB0/X1; AD5 PB1/X1; AD6 PB2/X1; WKUP12 PB2/X1; AD7 PB3/X1; WKUP13 PB3/X1
  parameters: DMAC_ID_RX=6, INSTANCE_ID=29, CLOCK_ID=29, TRGSEL_ADC_TRIG0=0x0 (External ADC Trigger Input (ADTRG pin)), TRGSEL_ADC_TRIG1=0x1 (TC0 Channel 0 Output (TIOA0)), TRGSEL_ADC_TRIG2=0x2 (TC0 Channel 1 Output (TIOA1)), TRGSEL_ADC_TRIG3=0x3 (TC0 Channel 2 Output (TIOA2)), TRGSEL_ADC_TRIG4=0x4 (RTCOUT0), TRGSEL_ADC_TRIG5=0x5 (RTT 16-bit prescaler output), TRGSEL_ADC_TRIG6=0x6 (RTTEVENT), SRCCLK_PERIPH_CLK=0x0 (MCK), SRCCLK_PMC_PCK=0x1 (PCK5)
CHIPID at 0x400E0740
CMCC at 0x4003C000
CRCCU at 0x40048000
  parameters: INSTANCE_ID=49, CLOCK_ID=49
EFC at 0x400E0A00
  pins: ERASE PB12/X1
  parameters: FLASH_SIZE=524288, PAGE_SIZE=512, PAGES_PR_REGION=16, INSTANCE_ID=6
FLEXCOM0 at 0x4000C000 (FLEXCOM)
  parameters: DMAC_ID_TX=24, DMAC_ID_RX=10, INSTANCE_ID=8, CLOCK_ID=8
FLEXCOM1 at 0x40020000 (FLEXCOM)
  parameters: DMAC_ID_TX=23, DMAC_ID_RX=9, INSTANCE_ID=9, CLOCK_ID=9
FLEXCOM2 at 0x40024000 (FLEXCOM)
  parameters: DMAC_ID_TX=22, DMAC_ID_RX=8, INSTANCE_ID=14, CLOCK_ID=14
FLEXCOM3 at 0x40018000 (FLEXCOM)
  parameters: DMAC_ID_TX=17, DMAC_ID_RX=0, INSTANCE_ID=19, CLOCK_ID=19
FLEXCOM4 at 0x4001C000 (FLEXCOM)
  parameters: DMAC_ID_TX=26, DMAC_ID_RX=12, INSTANCE_ID=20, CLOCK_ID=20
FLEXCOM5 at 0x40008000 (FLEXCOM)
  parameters: DMAC_ID_TX=27, DMAC_ID_RX=13, INSTANCE_ID=21, CLOCK_ID=21
FLEXCOM6 at 0x40040000 (FLEXCOM)
  parameters: DMAC_ID_TX=25, DMAC_ID_RX=11, INSTANCE_ID=22, CLOCK_ID=22
FLEXCOM7 at 0x40034000 (FLEXCOM)
  parameters: DMAC_ID_TX=29, DMAC_ID_RX=16, INSTANCE_ID=7, CLOCK_ID=7
GPBR at 0x400E1490
ICE
  pins: TDI PB4/X1; TDO PB5/X1; TRACESWO PB5/X1; TMS PB6/X1; SWDIO PB6/X1; TCK PB7/X1; SWDCLK PB7/X1
I2SC0 at 0x40000000 (I2SC)
  pins: I2SCK0 PA0/A; I2SDI0 PA2/B; I2SDO0 PA3/B or PA17/A; I2SMCK0 PA4/B or PA18/A; I2SWS0 PA1/A
  parameters: DMAC_ID_TX0=2, DMAC_ID_TX1=3, DMAC_ID_RX0=18, DMAC_ID_RX1=19, INSTANCE_ID=16, CLOCK_ID=16
I2SC1 at 0x40004000 (I2SC)
  pins: I2SCK1 PA19/B; I2SDI1 PA22/B; I2SDO1 PA23/A or PA25/B; I2SMCK1 PA24/A or PA26/B; I2SWS1 PA20/B
  parameters: DMAC_ID_TX0=4, DMAC_ID_TX1=5, DMAC_ID_RX0=20, DMAC_ID_RX1=21, INSTANCE_ID=17, CLOCK_ID=17
MATRIX at 0x400E0200
MEM2MEM at 0x40028000
  parameters: INSTANCE_ID=15, CLOCK_ID=15
PDMIC0 at 0x4002C000 (PDMIC)
  pins: PDMIC0_CLK PA10/B; PDMIC0_DAT PA9/B
  parameters: DMAC_ID_RX=6, INSTANCE_ID=13, CLOCK_ID=13
PDMIC1 at 0x40030000 (PDMIC)
  parameters: INSTANCE_ID=18, CLOCK_ID=18
PIOA at 0x400E0E00 (PIO)
  pins: P{n} PA{n} (n=0..31)
  parameters: INSTANCE_ID=11, CLOCK_ID=11
PIOB at 0x400E1000 (PIO)
  pins: P{n} PB{n-32} (n=32..47)
  parameters: INSTANCE_ID=12, CLOCK_ID=12
PMC at 0x400E0400
  pins: PCK0 PA6/B; PCK1 PA17/B or PA21/B or PA30/A; PCK2 PA18/B or PA31/A or PB3/B
  parameters: INSTANCE_ID=5
RSTC at 0x400E1400
  parameters: INSTANCE_ID=1
RTC at 0x400E1460
  parameters: INSTANCE_ID=2
RTT at 0x400E1430
  parameters: INSTANCE_ID=3
SPI0 at 0x4000C400 (SPI)
  pins: SPI0_MISO PA9/A; SPI0_SPCK PB0/A; SPI0_NPCS0 PA25/A; SPI0_NPCS1 PA26/A; SPI0_MOSI PA10/A
  parameters: DMAC_ID_TX=24, DMAC_ID_RX=10
SPI1 at 0x40020400 (SPI)
  pins: SPI1_MISO PB2/A; SPI1_SPCK PA27/A; SPI1_NPCS0 PA28/A; SPI1_NPCS1 PA29/A; SPI1_MOSI PB3/A
  parameters: DMAC_ID_TX=23, DMAC_ID_RX=9
SPI2 at 0x40024400 (SPI)
  pins: SPI2_MISO PA5/A; SPI2_SPCK PA15/B or PA24/B; SPI2_NPCS0 PA16/A; SPI2_NPCS1 PA15/A; SPI2_MOSI PA6/A
  parameters: DMAC_ID_TX=22, DMAC_ID_RX=8
SPI3 at 0x40018400 (SPI)
  pins: SPI3_MISO PA4/A; SPI3_SPCK PB13/A; SPI3_NPCS0 PB14/A; SPI3_NPCS1 PB15/A; SPI3_MOSI PA3/A
  parameters: DMAC_ID_TX=17, DMAC_ID_RX=0
SPI4 at 0x4001C400 (SPI)
  pins: SPI4_MISO PB9/A or PB11/A; SPI4_SPCK PB1/A; SPI4_NPCS0 PB8/B; SPI4_NPCS1 PB9/B; SPI4_MOSI PB8/A or PB10/A
  parameters: DMAC_ID_TX=26, DMAC_ID_RX=12
SPI5 at 0x40008400 (SPI)
  pins: SPI5_MISO PA12/A; SPI5_SPCK PA14/A; SPI5_NPCS0 PA11/A; SPI5_NPCS1 PA5/B or PB2/B; SPI5_MOSI PA13/A
  parameters: DMAC_ID_TX=27, DMAC_ID_RX=13
SPI6 at 0x40040400 (SPI)
  pins: SPI6_MISO PB1/B or PB11/B; SPI6_SPCK PB13/B; SPI6_NPCS0 PB14/B; SPI6_NPCS1 PB15/B; SPI6_MOSI PB0/B or PB10/B
  parameters: DMAC_ID_TX=25, DMAC_ID_RX=11
SPI7 at 0x40034400 (SPI)
  pins: SPI7_MISO PA27/B; SPI7_SPCK PA29/B; SPI7_NPCS0 PA30/B; SPI7_NPCS1 PA31/B; SPI7_MOSI PA28/B
  parameters: DMAC_ID_TX=29, DMAC_ID_RX=16
SUPC at 0x400E1410
  pins: WKUP0 PA0/X1; WKUP1 PA1/X1; WKUP2 PA2/X1; WKUP9 PA3/X1; WKUP10 PA4/X1; WKUP4 PA5/X1; WKUP5 PA8/X1; WKUP6 PA9/X1; WKUP8 PA14/X1; WKUP7 PA16/X1; WKUP3 PA23/X1; WKUP11 PA24/X1; WKUP12 PB2/X1; WKUP13 PB3/X1; WKUP14 PB8/X1; WKUP15 PB9/X1
  parameters: INSTANCE_ID=0
TC0 at 0x40010000 (TC)
  pins: TCLK0 PA2/A; TCLK1 PA19/A; TCLK2 PA20/A; TIOA0 PA0/B; TIOA1 PA23/B; TIOA2 PA21/A; TIOB0 PA1/B; TIOB1 PA16/B; TIOB2 PA22/A
  parameters: DMAC_ID_RX=14, INSTANCE_ID_CHANNEL0=23, INSTANCE_ID_CHANNEL1=24, INSTANCE_ID_CHANNEL2=25, CLOCK_ID_CHANNEL0=23, CLOCK_ID_CHANNEL1=24, CLOCK_ID_CHANNEL2=25, TCCLKS_TIMER_CLOCK1=1 (MCK/2), TCCLKS_TIMER_CLOCK2=2 (MCK/8), TCCLKS_TIMER_CLOCK3=3 (MCK/32), TCCLKS_TIMER_CLOCK4=4 (MCK/128), TCCLKS_TIMER_CLOCK5=5 (PCK3), TCCLKS_XC0=6 (XC0), TCCLKS_XC1=7 (XC1), TCCLKS_XC2=8 (XC2), NUM_INTERRUPT_LINES=3, TIMER_WIDTH=16, QDEC_PRESENT=0
TC1 at 0x40014000 (TC)
  parameters: INSTANCE_ID_CHANNEL0=26, INSTANCE_ID_CHANNEL1=27, INSTANCE_ID_CHANNEL2=28, CLOCK_ID_CHANNEL0=26, CLOCK_ID_CHANNEL1=27, CLOCK_ID_CHANNEL2=28, TCCLKS_TIMER_CLOCK1=1 (MCK/2), TCCLKS_TIMER_CLOCK2=2 (MCK/8), TCCLKS_TIMER_CLOCK3=3 (MCK/32), TCCLKS_TIMER_CLOCK4=4 (MCK/128), TCCLKS_TIMER_CLOCK5=5 (PCK3), TCCLKS_XC0=6 (XC0), TCCLKS_XC1=7 (XC1), TCCLKS_XC2=8 (XC2), NUM_INTERRUPT_LINES=3, TIMER_WIDTH=16, QDEC_PRESENT=0
TWI0 at 0x4000C600 (TWI)
  pins: TWCK PA9/A; TWD PA10/A
  parameters: DMAC_ID_TX=24, DMAC_ID_RX=10
TWI1 at 0x40020600 (TWI)
  pins: TWCK PB2/A; TWD PB3/A
  parameters: DMAC_ID_TX=23, DMAC_ID_RX=9
TWI2 at 0x40024600 (TWI)
  pins: TWCK PA5/A; TWD PA6/A
  parameters: DMAC_ID_TX=22, DMAC_ID_RX=8
TWI3 at 0x40018600 (TWI)
  pins: TWCK PA4/A; TWD PA3/A
  parameters: DMAC_ID_TX=17, DMAC_ID_RX=0
TWI4 at 0x4001C600 (TWI)
  pins: TWCK PB9/A or PB11/A; TWD PB8/A or PB10/A
  parameters: DMAC_ID_TX=26, DMAC_ID_RX=12
TWI5 at 0x40008600 (TWI)
  pins: TWCK PA12/A; TWD PA13/A
  parameters: DMAC_ID_TX=27, DMAC_ID_RX=13
TWI6 at 0x40040600 (TWI)
  pins: TWCK PB1/B or PB11/B; TWD PB0/B or PB10/B
  parameters: DMAC_ID_TX=25, DMAC_ID_RX=11
TWI7 at 0x40034600 (TWI)
  pins: TWCK PA27/B; TWD PA28/B
  parameters: DMAC_ID_TX=29, DMAC_ID_RX=16
UDP at 0x40044000
  parameters: INSTANCE_ID=48, CLOCK_ID=48
UHP at 0x20400000
  pins: DM PA21/X1; DP PA22/X1
  parameters: INSTANCE_ID=47, CLOCK_ID=47
USART0 at 0x4000C200 (USART)
  pins: RXD PA9/A; SCK PB0/A; CTS PA25/A; RTS PA26/A; TXD PA10/A
  parameters: DMAC_ID_TX=24, DMAC_ID_RX=10
USART1 at 0x40020200 (USART)
  pins: RXD PB2/A; SCK PA27/A; CTS PA28/A; RTS PA29/A; TXD PB3/A
  parameters: DMAC_ID_TX=23, DMAC_ID_RX=9
USART2 at 0x40024200 (USART)
  pins: RXD PA5/A; SCK PA15/B or PA24/B; CTS PA16/A; RTS PA15/A; TXD PA6/A
  parameters: DMAC_ID_TX=22, DMAC_ID_RX=8
USART3 at 0x40018200 (USART)
  pins: RXD PA4/A; SCK PB13/A; CTS PB14/A; RTS PB15/A; TXD PA3/A
  parameters: DMAC_ID_TX=17, DMAC_ID_RX=0
USART4 at 0x4001C200 (USART)
  pins: RXD PB9/A or PB11/A; SCK PB1/A; CTS PB8/B; RTS PB9/B; TXD PB8/A or PB10/A
  parameters: DMAC_ID_TX=26, DMAC_ID_RX=12
USART5 at 0x40008200 (USART)
  pins: RXD PA12/A; SCK PA14/A; CTS PA11/A; RTS PA5/B or PB2/B; TXD PA13/A
  parameters: DMAC_ID_TX=27, DMAC_ID_RX=13
USART6 at 0x40040200 (USART)
  pins: RXD PB1/B or PB11/B; SCK PB13/B; CTS PB14/B; RTS PB15/B; TXD PB0/B or PB10/B
  parameters: DMAC_ID_TX=25, DMAC_ID_RX=11
USART7 at 0x40034200 (USART)
  pins: RXD PA27/B; SCK PA29/B; CTS PA30/B; RTS PA31/B; TXD PA28/B
  parameters: DMAC_ID_TX=29, DMAC_ID_RX=16
WDT at 0x400E1450
  parameters: INSTANCE_ID=4
FUSES at GPNVMBITS 0 in fuses
LOCKBIT at 0 in lockbits
SystemControl at 0xE000E000
SysTick at 0xE000E010
NVIC at 0xE000E100
MPU at 0xE000ED90

## Interrupts
-15 Reset — Reset Vector, invoked on Power up and warm reset
-14 NonMaskableInt — Non maskable Interrupt, cannot be stopped or preempted
-13 HardFault — Hard Fault, all classes of Fault
-12 MemoryManagement — Memory Management, MPU mismatch, including Access Violation and No Match
-11 BusFault — Bus Fault, Pre-Fetch-, Memory Access Fault, other address/memory related Fault
-10 UsageFault — Usage Fault, i.e. Undef Instruction, Illegal State Transition
-5 SVCall — System Service Call via SVC instruction
-4 DebugMonitor
-2 PendSV — Pendable request for system service
-1 SysTick — System Tick Timer
0 SUPC — Supply Controller
1 RSTC — Reset Controller
2 RTC — Real Time Clock
3 RTT — Real Time Timer
4 WDT — Watchdog Timer
5 PMC — Power Management Controller
6 EFC — Enhanced Flash Controller
7 FLEXCOM7
8 FLEXCOM0
9 FLEXCOM1
11 PIOA — Parallel I/O Controller A
12 PIOB — Parallel I/O Controller B
13 PDMIC0 — PDM 0
14 FLEXCOM2
15 MEM2MEM
16 I2SC0
17 I2SC1
18 PDMIC1 — PDM 1
19 FLEXCOM3
20 FLEXCOM4
21 FLEXCOM5
22 FLEXCOM6
23 TC0 — Timer/Counter 0
24 TC1 (TC0) — Timer/Counter 1
25 TC2 (TC0) — Timer/Counter 2
26 TC3 (TC1) — Timer/Counter 3
27 TC4 (TC1) — Timer/Counter 4
28 TC5 (TC1) — Timer/Counter 5
29 ADC — Analog To Digital Converter
47 UHP — USB OHCI
48 UDP — USB Device FS
49 CRCCU

## Properties
SIGNATURES: JTAGID=0x05B3E03F, CHIPID_CIDR=0x24570AE0, CHIPID_EXID=0x0
ELECTRICAL_CHARACTERISTICS: CHIP_FREQ_SLCK_RC_MIN=20000, CHIP_FREQ_SLCK_RC=32000 (Typical Slow Clock Internal RC frequency), CHIP_FREQ_SLCK_RC_MAX=44000, CHIP_FREQ_MAINCK_RC_8MHZ=8000000, CHIP_FREQ_MAINCK_RC_16MHZ=16000000, CHIP_FREQ_MAINCK_RC_24MHZ=24000000, CHIP_FREQ_CPU_MAX=120000000, CHIP_FREQ_XTAL_32K=32768, CHIP_FLASH_WRITE_WAIT_STATE=8 (Embedded Flash Write Wait State), CHIP_FREQ_FWS_0=14000000 (Maximum operating frequency when FWS is 0), CHIP_FREQ_FWS_1=28000000 (Maximum operating frequency when FWS is 1), CHIP_FREQ_FWS_2=42000000 (Maximum operating frequency when FWS is 2), CHIP_FREQ_FWS_3=56000000 (Maximum operating frequency when FWS is 3), CHIP_FREQ_FWS_4=70000000 (Maximum operating frequency when FWS is 4), CHIP_FREQ_FWS_5=84000000 (Maximum operating frequency when FWS is 5), CHIP_FREQ_FWS_6=96000000 (Maximum operating frequency when FWS is 6), CHIP_FREQ_FWS_7=108000000 (Maximum operating frequency when FWS is 7), CHIP_FREQ_FWS_8=120000000 (Maximum operating frequency when FWS is 8), CHIP_FREQ_FWS_NUMBER=9 (Number of FWS ranges)

## Pinouts (pin number, pad)
LQFP64, QFN64: 6 PA0, 7 PA1, 61 PA2, 5 PA3, 4 PA4, 8 PA5, 17 PA6, 11 PA7, 12 PA8, 49 PA9, 48 PA10, 44 PA11, 43 PA12, 42 PA13, 41 PA14, 22 PA15, 18 PA16, 33 PA17, 34 PA18, 35 PA19, 36 PA20, 25 PA21, 24 PA22, 23 PA23, 58 PA24, 56 PA25, 52 PA26, 51 PA27, 21 PA28, 20 PA29, 19 PA30, 16 PA31, 37 PB0, 38 PB1, 39 PB2, 40 PB3, 62 PB4, 50 PB5, 54 PB6, 55 PB7, 59 PB8, 60 PB9, 46 PB10, 47 PB11, 3 PB12, 57 PB13, 15 PB14, 14 PB15, 28 ADVREF, 30 VDDOUT, 2 NRST, 10 TEST, 31 VDDIO, 32 VDDIO, 27 VDDIO, 64 VDDIO, 1 VDDIO, 26 VDDUSB, 63 JTAGSEL, 9 VDDCORE, 45 VDDCORE, 53 GND, 13 GND, 29 GND

## Notices in the file
Copyright (c) 2017 Microchip Technology Inc.
SPDX-License-Identifier: Apache-2.0
Licensed under the Apache License, Version 2.0 (the "License");
you may not use this file except in compliance with the License.
You may obtain a copy of the License at
http://www.apache.org/licenses/LICENSE-2.0
Unless required by applicable law or agreed to in writing, software
distributed under the License is distributed on an "AS IS" BASIS,
WITHOUT WARRANTIES OR CONDITIONS OF ANY KIND, either express or implied.
See the License for the specific language governing permissions and
limitations under the License.
