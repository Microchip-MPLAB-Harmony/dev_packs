# ATSAME54N20A device description
Architecture: CORTEX-M4; Family: SAME; Series: SAME54

## Interrupts
-15 Reset — Reset Vector, invoked on Power up and warm reset
-14 NonMaskableInt — Non maskable Interrupt, cannot be stopped or preempted
-13 HardFault — Hard Fault, all classes of Fault
-12 MemoryManagement — Memory Management, MPU mismatch, including Access Violation and No Match
-11 BusFault — Bus Fault, Pre-Fetch-, Memory Access Fault, other address/memory related Fault
-10 UsageFault — Usage Fault, i.e. Undef Instruction, Illegal State Transition
-5 SVCall — System Service Call via SVC instruction
-4 DebugMonitor
-2 PendSV — Pendable request for system service
-1 SysTick — System Tick Timer
0 PM — Power Manager
1 MCLK — Main Clock
2 OSCCTRL_XOSC0 (OSCCTRL) — External Oscillator 0
3 OSCCTRL_XOSC1 (OSCCTRL) — External Oscillator 1
4 OSCCTRL_DFLL (OSCCTRL) — Digital Frequency Locked Loop
5 OSCCTRL_DPLL0 (OSCCTRL) — Digital Phase Locked Loop 0
6 OSCCTRL_DPLL1 (OSCCTRL) — Digital Phase Locked Loop 1
7 OSC32KCTRL — 32Khz Oscillator Controller
8 SUPC_OTHER (SUPC) — Suppyly controller
9 SUPC_BODDET (SUPC) — Brown Out Detection
10 WDT — Watch Dog Timer
11 RTC — Real Time Counter
{n+12} EIC_EXTINT_{n} (EIC) (n=0..15) — EIC Channel {n}
28 FREQM — Frequency Meter
29 NVMCTRL_0 (NVMCTRL) — Non-Volatile Memory Controller
30 NVMCTRL_1 (NVMCTRL) — NVMCTRL SmartEEPROM Interrupts
31 DMAC_0 (DMAC) — DMA Channel 0
32 DMAC_1 (DMAC) — DMA Channel 1
33 DMAC_2 (DMAC) — DMA Channel 2
34 DMAC_3 (DMAC) — DMA Channel 3
35 DMAC_OTHER (DMAC) — DMA Channel 4..X
36 EVSYS_0 (EVSYS) — Event System Channel 0
37 EVSYS_1 (EVSYS) — Event System Channel 1
38 EVSYS_2 (EVSYS) — Event System Channel 2
39 EVSYS_3 (EVSYS) — Event System Channel 3
40 EVSYS_OTHER (EVSYS) — Event System Channel 4..X
41 PAC — Peripheral Access Controller
45 RAMECC — RAM Error Correction Code
{4n+46} SERCOM{n}_0 (SERCOM{n}) (n=0..7) — Serial Communication Interface {n}
{4n+47} SERCOM{n}_1 (SERCOM{n}) (n=0..7) — Serial Communication Interface {n}
{4n+48} SERCOM{n}_2 (SERCOM{n}) (n=0..7) — Serial Communication Interface {n}
{4n+49} SERCOM{n}_OTHER (SERCOM{n}) (n=0..7) — Serial Communication Interface {n}
78 CAN0 — Controller Area Network 0
79 CAN1 — Controller Area Network 1
80 USB_OTHER (USB) — Universal Serial Bus
81 USB_SOF_HSOF (USB) — USB Start of Frame
82 USB_TRCPT0 (USB) — USB Transfer Complete 0
83 USB_TRCPT1 (USB) — USB Transfer Complete 1
84 GMAC — Ethernet MAC
85 TCC0_OTHER (TCC0) — Timer Counter Control 0
86 TCC0_MC0 (TCC0) — TCC Match/Compare 0
87 TCC0_MC1 (TCC0) — TCC Match/Compare 1
88 TCC0_MC2 (TCC0) — TCC Match/Compare 2
89 TCC0_MC3 (TCC0) — TCC Match/Compare 3
90 TCC0_MC4 (TCC0) — TCC Match/Compare 4
91 TCC0_MC5 (TCC0) — TCC Match/Compare 5
92 TCC1_OTHER (TCC1) — Timer Counter Control 1
93 TCC1_MC0 (TCC1) — TCC Match/Compare 0
94 TCC1_MC1 (TCC1) — TCC Match/Compare 1
95 TCC1_MC2 (TCC1) — TCC Match/Compare 2
96 TCC1_MC3 (TCC1) — TCC Match/Compare 3
97 TCC2_OTHER (TCC2) — Timer Counter Control 2
98 TCC2_MC0 (TCC2) — TCC Match/Compare 0
99 TCC2_MC1 (TCC2) — TCC Match/Compare 1
100 TCC2_MC2 (TCC2) — TCC Match/Compare 2
101 TCC3_OTHER (TCC3) — Timer Counter Control 3
102 TCC3_MC0 (TCC3) — TCC Match/Compare 0
103 TCC3_MC1 (TCC3) — TCC Match/Compare 1
104 TCC4_OTHER (TCC4) — Timer Counter Control 4
105 TCC4_MC0 (TCC4) — TCC Match/Compare 0
106 TCC4_MC1 (TCC4) — TCC Match/Compare 1
{n+107} TC{n} (n=0..7) — Timer Counter {n}
115 PDEC_OTHER (PDEC) — Position Decoder
116 PDEC_MC0 (PDEC) — PDEC Match/Compare 0
117 PDEC_MC1 (PDEC) — PDEC Match Compare 1
118 ADC0_OTHER (ADC0) — Analog To Digital Converter 0
119 ADC0_RESRDY (ADC0) — ADC0 Result Ready
120 ADC1_OTHER (ADC1) — Analog To Digital Converter 1
121 ADC1_RESRDY (ADC1) — ADC1 Result Ready
122 AC — Analog Comparator
123 DAC_OTHER (DAC) — Digital to Analog Converter
124 DAC_EMPTY_0 (DAC) — DAC Buffer 0 Empty
125 DAC_EMPTY_1 (DAC) — DAC Buffer 1 Empty
126 DAC_RESRDY_0 (DAC) — DAC Filter 0 Result Ready
127 DAC_RESRDY_1 (DAC) — DAC Filter 1 Result Ready
128 I2S — Inter-IC Sound Interface
129 PCC — Parallel Capture Controller
130 AES — Advanced Encryption Standard
131 TRNG — True Random Generator
132 ICM — Integrity Check Monitor
133 PUKCC — Public-Key Cryptography Controller
134 QSPI — Quad SPI interface
135 SDHC0 — SD/MMC Host Controller 0
136 SDHC1 — SD/MMC Host Controller 1

## Event generators
1 OSCCTRL_XOSC_FAIL_0, 2 OSCCTRL_XOSC_FAIL_1, 3 OSC32KCTRL_XOSC32K_FAIL, {n+4} RTC_PER_{n} (n=0..7), {n+12} RTC_CMP_{n} (n=0..3), 16 RTC_TAMPER, 17 RTC_OVF, {n+18} EIC_EXTINT_{n} (n=0..15), {n+34} DMAC_CH_{n} (n=0..3), 38 PAC_ACCERR, 41 TCC0_OVF, 42 TCC0_TRG, 43 TCC0_CNT, {n+44} TCC0_MC_{n} (n=0..5), 50 TCC1_OVF, 51 TCC1_TRG, 52 TCC1_CNT, {n+53} TCC1_MC_{n} (n=0..3), 57 TCC2_OVF, 58 TCC2_TRG, 59 TCC2_CNT, {n+60} TCC2_MC_{n} (n=0..2), 63 TCC3_OVF, 64 TCC3_TRG, 65 TCC3_CNT, 66 TCC3_MC_0, 67 TCC3_MC_1, 68 TCC4_OVF, 69 TCC4_TRG, 70 TCC4_CNT, 71 TCC4_MC_0, 72 TCC4_MC_1, {3n+73} TC{n}_OVF (n=0..7), {3n+74} TC{n}_MC_0 (n=0..7), {3n+75} TC{n}_MC_1 (n=0..7), 97 PDEC_OVF, 98 PDEC_ERR, 99 PDEC_DIR, 100 PDEC_VLC, 101 PDEC_MC_0, 102 PDEC_MC_1, 103 ADC0_RESRDY, 104 ADC0_WINMON, 105 ADC1_RESRDY, 106 ADC1_WINMON, 107 AC_COMP_0, 108 AC_COMP_1, 109 AC_WIN_0, 110 DAC_EMPTY_0, 111 DAC_EMPTY_1, 112 DAC_RESRDY_0, 113 DAC_RESRDY_1, 114 GMAC_TSU_CMP, 115 TRNG_READY, {n+116} CCL_LUTOUT_{n} (n=0..3)

## Event users
0 RTC_TAMPER, {n+1} PORT_EV_{n} (n=0..3), {n+5} DMAC_CH_{n} (n=0..7), 14 CM4_TRACE_START, 15 CM4_TRACE_STOP, 16 CM4_TRACE_TRIG, 17 TCC0_EV_0, 18 TCC0_EV_1, {n+19} TCC0_MC_{n} (n=0..5), 25 TCC1_EV_0, 26 TCC1_EV_1, {n+27} TCC1_MC_{n} (n=0..3), 31 TCC2_EV_0, 32 TCC2_EV_1, {n+33} TCC2_MC_{n} (n=0..2), 36 TCC3_EV_0, 37 TCC3_EV_1, 38 TCC3_MC_0, 39 TCC3_MC_1, 40 TCC4_EV_0, 41 TCC4_EV_1, 42 TCC4_MC_0, 43 TCC4_MC_1, {n+44} TC{n}_EVU (n=0..7), {n+52} PDEC_EVU_{n} (n=0..2), 55 ADC0_START, 56 ADC0_SYNC, 57 ADC1_START, 58 ADC1_SYNC, 59 AC_SOC_0, 60 AC_SOC_1, 61 DAC_START_0, 62 DAC_START_1, {n+63} CCL_LUTIN_{n} (n=0..3)

## Properties
SIGNATURES: DSU_DID=0x61840302

## Pinouts (pin number, pad)
SAMD51N: 1 PA00, 2 PA01, 3 PC00, 4 PC01, 5 PC02, 6 PC03, 7 PA02, 8 PA03, 9 PB04, 10 PB05, 11 GNDANA, 12 VDDANA, 13 PB06, 14 PB07, 15 PB08, 16 PB09, 17 PA04, 18 PA05, 19 PA06, 20 PA07, 21 PC05, 22 PC06, 23 PC07, 24 GND, 25 VDDIO, 26 PA08, 27 PA09, 28 PA10, 29 PA11, 30 VDDIO, 31 GND, 32 PB10, 33 PB11, 34 PB12, 35 PB13, 36 PB14, 37 PB15, 38 GND, 39 VDDIO, 40 PC10, 41 PC11, 42 PC12, 43 PC13, 44 PC14, 45 PC15, 46 PA12, 47 PA13, 48 PA14, 49 PA15, 50 GND, 51 VDDIO, 52 PA16, 53 PA17, 54 PA18, 55 PA19, 56 PC16, 57 PC17, 58 PC18, 59 PC19, 60 PC20, 61 PC21, 62 GND, 63 VDDIO, 64 PB16, 65 PB17, 66 PB18, 67 PB19, 68 PB20, 69 PB21, 70 PA20, 71 PA21, 72 PA22, 73 PA23, 74 PA24, 75 PA25, 76 GND, 77 VDDIO, 78 PB22, 79 PB23, 80 PB24, 81 PB25, 82 PC24, 83 PC25, 84 PC26, 85 PC27, 86 PC28, 87 PA27, 88 RESET_N, 89 VDDCORE, 90 GND, 91 VSW, 92 VDDIO, 93 PA30, 94 PA31, 95 PB30, 96 PB31, 97 PB00, 98 PB01, 99 PB02, 100 PB03

## Notices in the file
Copyright (c) 2018 Microchip Technology Inc.
SPDX-License-Identifier: Apache-2.0
Licensed under the Apache License, Version 2.0 (the "License");
you may not use this file except in compliance with the License.
You may obtain a copy of the License at
http://www.apache.org/licenses/LICENSE-2.0
Unless required by applicable law or agreed to in writing, software
distributed under the License is distributed on an "AS IS" BASIS,
WITHOUT WARRANTIES OR CONDITIONS OF ANY KIND, either express or implied.
See the License for the specific language governing permissions and
limitations under the License.
