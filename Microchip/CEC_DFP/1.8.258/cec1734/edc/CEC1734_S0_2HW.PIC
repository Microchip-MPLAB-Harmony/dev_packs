# CEC1734_S0_2HW register map
Vendor: Microchip
Architecture arm32bit. Special function registers and configuration words.
Registers are 32-bit, read-write, reset 0x0 unless marked. A register's access mark holds for its fields unless they carry their own. Addresses are absolute, and some are shared; only a register's first bit layout is shown; lines under a group give offsets from that group; [hi:lo] are bit positions; {n}, {i} and the like mark numbered series; 'fields as' and 'values as' point back to an identical list; <NAME> marks a mode.

## Further device data
pins=1: GPIO000/SPI0_KILL/SPI0_RESET_n; 2: GPIO002/QSPI0_CS1_n/SPIMON_QSPI0_CS1_n; 3: GPIO003/SDA0/SDA0/SDA0/SDA0/SDA0; 4: GPIO004/SCL0/SCL0/SCL0/SCL0/SCL0; 5: GPIO012; 6: GPIO013/SP1_ALT_IO3; 7: GPIO015/ICT10; 8: GPIO016/QSPI0_IO3/QSPI0_IO3_CLAMP; 9: GPIO020/QSPI0_IN_CS0_n; 10: GPIO021/QSPI0_IN_CS1_n; 11: GPIO022/QSPI0_IN_IO1/QSPI0_IN_IO1; 12: GPIO023/QSPI0_IN_IO0/QSPI0_IN_IO0; 13: GPIO026/SP0_AP_INTR; 14: GPIO027/ALT_TFDP_CLK; 15: GPIO030/SDA10/SDA10/SDA10/SDA10/SDA10; 16: GPIO031/SP1_ALT_IO0; 17: GPIO034/SP1_AP_INTR/SP1_AP_INTR; 18: GPIO046/SP1_ALT_CS_n; 19: GPIO047/SP1_ALT_IO1; 20: GPIO050/ICT0; 21: GPIO053/PWM0/SP0_AP_INTR; 22: GPIO055/QSPI0_CS0_n/SPIMON_QSPI0_CS0_n; 23: GPIO056/QSPI0_CLK/QSPI0_CLK_CLAMP; 24: GPIO057/VCC_PWRGD; 25: GPIO063/SP1_ALT_CLK; 26: GPIO104/UART0_TX/TFDP_CLK; 27: GPIO105/UART0_RX/TFDP_DATA; 28: GPIO106/AP0_RESET_n; 29: GPIO107/SCL10/SCL10/SCL10/SCL10/SCL10/ALT_VIOL_0; 30: GPIO112/ALT_VIOL_1/ALT_TFDP_DATA; 31: GPIO127/SP1_ALT_IO2; 32: GPIO130/CLK32KHZ_IN; 33: GPIO132/SDA6/SDA6/SDA6/SDA6/SDA6; 34: GPIO140/SCL6/SCL6/SCL6/SCL6/SCL6; 35: GPIO143/SDA4/SDA4/SDA4/SDA4/SDA4; 36: GPIO144/SCL4/SCL4/SCL4/SCL4/SCL4; 37: GPIO145/SDA9/SDA9/SDA9/SDA9/SDA9; 38: GPIO146/SCL9/SCL9/SCL9/SCL9/SCL9; 39: GPIO147/SDA15/SDA15/SDA15/SDA15/SDA15; 40: GPIO150/SCL15/SCL15/SCL15/SCL15/SCL15; 41: GPIO156/LED0; 42: GPIO157/LED1; 43: GPIO170/TFDP_CLK; 44: GPIO201/CLK32KHZ_OUT; 45: GPIO202/QSPI0_IN_IO2/QSPI0_IN_IO2; 46: GPIO203/QSPI0_IN_IO3/QSPI0_IN_IO3; 47: GPIO204/QSPI0_IN_CLK/QSPI0_IN_CLK; 48: GPIO223/QSPI0_IO0/QSPI0_IO0_CLAMP; 49: GPIO224/QSPI0_IO1/QSPI0_IO1_CLAMP; 50: GPIO227/QSPI0_IO2/QSPI0_IO2_CLAMP; 51: GPIO250/SPI0PER_CS_n; 52: GPIO253/TST_CLK_OUT; 53: JTAG_RST_N; 54: nRESET_IN; 55: VSS_ANALOG; 56: VTR_PLL; 57: VSS; 58: VTR_REG; 59: VTR1; 60: VTR_ANALOG; 61: VR_CAP; 62: VSS; 63: VSS; 64: VSS, interrupts=-15 Reset — Reset Vector, invoked on Power up and warm reset; -14 NonMaskableInt — Non maskable Interrupt, cannot be stopped or preempted; -13 HardFault — Hard Fault, all classes of Fault; -12 MemoryManagement — Memory Management, MPU mismatch, including Access Violation and No Match; -11 BusFault — Bus Fault, Pre-Fetch-, Memory Access Fault, other address/memory related Fault; -10 UsageFault — Usage Fault, i.e. Undef Instruction, Illegal State Transition; -5 SVCall — System Service Call via SVC instruction; -4 DebugMonitor — Debug Monitor; -2 PendSV — Pendable request for system service; -1 SysTick — System Tick Timer; 0 GIRQ08 — GIRQ08; 1 GIRQ09 — GIRQ09; 2 GIRQ10 — GIRQ10; 3 GIRQ11 — GIRQ11; 4 GIRQ12 — GIRQ12; 5 GIRQ13 — GIRQ13; 6 GIRQ14 — GIRQ14; 7 GIRQ15 — GIRQ15; 8 GIRQ16 — GIRQ16; 9 GIRQ17 — GIRQ17; 10 GIRQ18 — GIRQ18; 12 GIRQ20 — GIRQ20; 13 GIRQ21 — GIRQ21; 14 GIRQ23 — GIRQ23; 15 GIRQ24 — GIRQ24; 17 GIRQ26 — GIRQ26; 20 I2CSMB0 — I2CSMB0; 21 I2CSMB1 — I2CSMB1; 22 I2CSMB2 — I2CSMB2; 23 I2CSMB3 — I2CSMB3; 24 DMA_CH00 — DMA_CH00; 25 DMA_CH01 — DMA_CH01; 26 DMA_CH02 — DMA_CH02; 27 DMA_CH03 — DMA_CH03; 28 DMA_CH04 — DMA_CH04; 29 DMA_CH05 — DMA_CH05; 30 DMA_CH06 — DMA_CH06; 31 DMA_CH07 — DMA_CH07; 32 DMA_CH08 — DMA_CH08; 33 DMA_CH09 — DMA_CH09; 40 UART0 — UART0; 65 PKE_ERR — PKE_ERR; 66 PKE_END — PKE_END; 67 RNG — RNG; 68 AES — AES; 69 HASH — HASH; 83 LED0 — LED0; 84 LED1 — LED1; 90 SPT0 — SPT0; 91 QMSPI0 — QMSPI0; 92 QMSPI1 — QMSPI1; 111 RTMR — RTMR; 112 HTMR0 — HTMR0; 113 HTMR1 — HTMR1; 134 EMC — EMC; 140 TIMER32_0 — TIMER32_0; 141 TIMER32_1 — TIMER32_1; 146 CCT — CCT; 147 CCT_CAP0 — CCT_CAP0; 148 CCT_CAP1 — CCT_CAP1; 149 CCT_CAP2 — CCT_CAP2; 150 CCT_CAP3 — CCT_CAP3; 151 CCT_CAP4 — CCT_CAP4; 152 CCT_CAP5 — CCT_CAP5; 153 CCT_CMP0 — CCT_CMP0; 154 CCT_CMP1 — CCT_CMP1; 158 I2CSMB4 — I2CSMB4; 171 WDT — WDT; 174 CLK_MON — CLK_MON; 181 SWI0 — SWI0; 182 SWI1 — SWI1; 183 SWI2 — SWI2; 184 SWI3 — SWI3; 185 IMSPI — IMSPI; 187 SPT1 — SPT1; 188 SPIMON0_VLTN — SPIMON0_VLTN; 189 SPIMON0_MTMON — SPIMON0_MTMON; 190 SPIMON0_LTMON — SPIMON0_LTMON; 191 SPIMON1_VLTN — SPIMON1_VLTN; 192 SPIMON1_MTMON — SPIMON1_MTMON; 193 SPIMON1_LTMON — SPIMON1_LTMON; 194 VTR1_PAD_MON — VTR1_PAD_MON; 195 VTR2_PAD_MON — VTR2_PAD_MON
