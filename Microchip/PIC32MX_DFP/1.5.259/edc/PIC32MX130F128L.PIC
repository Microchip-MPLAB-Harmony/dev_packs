# PIC32MX130F128L register map
Vendor: Microchip
Architecture 32xxxx. Special function registers and configuration words.
Registers are 32-bit, read-write, reset 0x0 unless marked. A register's access mark holds for its fields unless they carry their own. Addresses are absolute, and some are shared; only a register's first bit layout is shown; lines under a group give offsets from that group; [hi:lo] are bit positions; {n}, {i} and the like mark numbered series; 'fields as' and 'values as' point back to an identical list; <NAME> marks a mode.

## Further device data
pins=1: RG15/AN28; 2: VDD; 3: RE5/PMD5/RPE5/AN22; 4: RE6/PMD6/AN23; 5: RE7/PMD7/AN27; 6: RC1/RPC1/AN29; 7: RC2/RPC2/AN30; 8: RC3/RPC3/AN31; 9: RC4/CTED7/RPC4; 10: RG6/PMA5/SCK2/RPG6/C1IND/AN16; 11: RG7/PMA4/RPG7/C1INC/AN17; 12: RG8/PMA3/RPG8/C2IND/AN18; 13: MCLR; 14: RG9/PMA2/RPG9/C2INC/AN19; 15: VSS; 16: VDD; 17: RA0/CTED1/TMS; 18: RE8/RPE8/AN32; 19: RE9/RPE9/AN33; 20: RB5/RPB5/C1INA/AN5; 21: RB4/C1INB/AN4; 22: RB3/RPB3/C2INA/AN3/PGED3; 23: RB2/CTED13/RPB2/C2INB/CTCMP/AN2/PGEC3; 24: RB1/CTED12/RPB1/AN1/PGEC1; 25: RB0/RPB0/AN0/PGED1; 26: RB6/RPB6/AN6/PGEC2; 27: RB7/CTED3/RPB7/AN7/PGED2; 28: RA9/PMA7/VREF-; 29: RA10/PMA6/VREF+; 30: AVDD; 31: AVSS; 32: RB8/CTED10/RPB8/AN8; 33: RB9/CTED4/RPB9/AN9; 34: RB10/PMA13/CTED11/RPB10/AN10/CVREFOUT; 35: RB11/PMA12/AN11; 36: VSS; 37: VDD; 38: RA1/CTED2/TCK; 39: RF13/SCK3/RPF13/AN34; 40: RF12/RPF12/AN35; 41: RB12/PMA11/AN12; 42: RB13/PMA10/AN13; 43: RB14/PMA1/CTED5/RPB14/AN14; 44: RB15/PMA0/CTED6/OCFB/RPB15/AN15; 45: VSS; 46: VDD; 47: RD14/RPD14/AN36; 48: RD15/SCK4/RPD15/AN37; 49: RF4/PMA9/RPF4; 50: RF5/PMA8/RPF5; 51: RF3/RPF3; 52: RF2/RPF2/AN38; 53: RF8/RPF8/AN39; 54: RF7/RPF7; 55: RF6/INT0/SCK1/RPF6; 56: RG3/SDA1; 57: RG2/SCL1; 58: RA2/SCL2; 59: RA3/SDA2; 60: RA4/CTED9/TDI; 61: RA5/TDO; 62: VDD; 63: RC12/CLKI/OSC1; 64: RC15/CLKO/OSC2; 65: VSS; 66: RA14/RPA14; 67: RA15/RPA15; 68: RD8/RTCC/RPD8; 69: RD9/RPD9; 70: RD10/PMA15/RPD10; 71: RD11/PMA14/RPD11; 72: RD0/RPD0; 73: RC13/RPC13/SOSCI; 74: RC14/T1CK/RPC14/SOSCO; 75: VSS; 76: RD1/RPD1/AN24; 77: RD2/RPD2/AN25; 78: RD3/RPD3/C3IND/AN26; 79: RD12/PMD12/RPD12/AN40; 80: RD13/PMD13/AN41; 81: RD4/PMWR/RPD4; 82: RD5/PMRD/RPD5; 83: RD6/PMD14/C3INC/AN42; 84: RD7/PMD15/C3INB/AN43; 85: VCAP; 86: VDD; 87: RF0/PMD11/RPF0/C3INA/AN44; 88: RF1/PMD10/RPF1/AN45; 89: RG1/PMD9/RPG1; 90: RG0/PMD8/RPG0; 91: RA6; 92: RA7/CTED8; 93: RE0/PMD0/AN46; 94: RE1/PMD1/AN47; 95: RG14; 96: RG12; 97: RG13; 98: RE2/PMD2/AN20; 99: RE3/PMD3/CTPLS/RPE3; 100: RE4/PMD4/AN21, interrupts=0 CORE_TIMER — Core Timer; 1 CORE_SOFTWARE_0 — Core Software 0; 2 CORE_SOFTWARE_1 — Core Software 1; 3 EXTERNAL_0 — Ext INT 0; 4 TIMER_1 — Timer1; 5 INPUT_CAPTURE_1 — Input Capture 1; 6 OUTPUT_COMPARE_1 — Output Compare 1; 7 EXTERNAL_1 — Ext INT 1; 8 TIMER_2 — Timer2; 9 INPUT_CAPTURE_2 — Input Capture 2; 10 OUTPUT_COMPARE_2 — Output Compare 2; 11 EXTERNAL_2 — Ext INT 2; 12 TIMER_3 — Timer3; 13 INPUT_CAPTURE_3 — Input Capture 3; 14 OUTPUT_COMPARE_3 — Output Compare 3; 15 EXTERNAL_3 — Ext INT 3; 16 TIMER_4 — Timer4; 17 INPUT_CAPTURE_4 — Input Capture 4; 18 OUTPUT_COMPARE_4 — Output Compare 4; 19 EXTERNAL_4 — Ext INT 4; 20 TIMER_5 — Timer5; 21 INPUT_CAPTURE_5 — Input Capture 5; 22 OUTPUT_COMPARE_5 — Output Compare 5; 23 ADC — ADC; 24 FAIL_SAFE_MONITOR — Fail Safe Clock Monitor; 25 RTCC — Real Time Clock Calendar; 26 FCE — Flash Control Event; 27 COMPARATOR_1 — Comparator 1; 28 COMPARATOR_2 — Comparator 2; 29 USB_1 — USB Module 1; 30 SPI_1 — SPI1; 31 UART_1 — UART 1; 32 I2C_1 — I2C 1; 33 CHANGE_NOTICE — Change Notice; 34 PMP — PMP; 35 SPI_2 — SPI 2; 36 UART_2 — UART 2; 37 I2C_2 — I2C 2; 38 UART_3 — UART 3; 39 UART_4 — UART 4; 40 UART_5 — UART 5; 41 CTMU — CTMU Event; 42 DMA_0 — DMA Channel 0; 43 DMA_1 — DMA Channel 1; 44 DMA_2 — DMA Channel 2; 45 DMA_3 — DMA Channel 3; 46 COMPARATOR_3 — Comparator 3; 47 CAN_1 — CAN 1; 48 SPI_3 — SPI 3; 49 SPI_4 — SPI 4
