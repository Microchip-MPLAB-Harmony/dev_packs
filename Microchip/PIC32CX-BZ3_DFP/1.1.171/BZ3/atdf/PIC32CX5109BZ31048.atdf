# PIC32CX5109BZ31048 device description
Architecture: CORTEX-M4; Family: PIC32CX; Series: PIC32CXBZ31
Parameters: LITTLE_ENDIAN=1, NUM_IRQ=43, __CM4_REV=0x0001, __DEBUG_LVL=3, __FPU_PRESENT=1, __FRC_DEF_FREQ=8000000 (FRC Default Frequency), __MPU_PRESENT=1, __NUM_DMA_CHANNELS=16 (Number of DMA Channels), __NVIC_PRIO_BITS=3, __PB1_DEF_FREQ=64000000 (Peripheral Bus 1 Default Clock Frequency), __PB2_DEF_FREQ=64000000 (Peripheral Bus 2 Default Clock Frequency), __PB3_DEF_FREQ=64000000 (Peripheral Bus 3 Default Clock Frequency), __POSC_DEF_FREQ=16000000 (Primary Oscillator Input Default Frequency), __REFCLK1_DEF_FREQ=64000000 (Reference Clock 1 Default Frequency), __REFCLK2_DEF_FREQ=64000000 (Reference Clock 2 Default Frequency), __REFCLK3_DEF_FREQ=64000000 (Reference Clock 3 Default Frequency), __REFCLK4_DEF_FREQ=64000000 (Reference Clock 4 Default Frequency), __REFCLK5_DEF_FREQ=64000000 (Reference Clock 5 Default Frequency), __REFCLK6_DEF_FREQ=64000000 (Reference Clock 6 Default Frequency), __REFCLKI_DEF_FREQ=8000000 (REFCLKI Pin Input Default Frequency), __RFPLL_DEF_FREQ=64000000 (RFPLL Default Frequency), __SOSC_DEF_FREQ=32768 (Secondary Oscillator Input Default Frequency), __SYS_DEF_FREQ=64000000 (System Clock Default Frequency), __TRACE_LVL=2, __VENDOR_SYSTICKCONFIG=0, __VTOR_PRESENT=1, POWER_DOMAIN=PD_CORE, __BOOT_ROM_HDR_SIZE=512 (Secure Boot Header)
Programming and debug interfaces: SWD
Registers are 32-bit, read-write, reset 0x0 unless marked. A register's access mark holds for its fields unless they carry their own. Offsets are from the block's base; lines under a group give offsets from that group; [hi:lo] are bit positions; {n}, {i} and the like mark numbered series; 'fields as' and 'values as' point back to an identical list; <NAME> marks a mode.

## Ordering variants
PIC32CX5109BZ31048-I/M: QFN48, up to 64 MHz, -40 to 105 C, 1.90 to 3.60 V

## Memory
base space: start 0 size 0x100000000, little endian
  0x0 ROM_SECURE_BOOT_ROM size 0x10000 rom, ro, executable
  0x18000 ROM_SECURE_BOOT_PATCH size 0x00000800 rom, ro, executable
  0x1000000 FCR_PFM size 0x80000 flash, rw, executable, page 4096
  0x800000 FCR_BFM size 0x5000 flash, rw, executable, page 4096
  0x805000 FCR_CFM size 0x00001000 fuses, rw, page 4096
  0x806000 FCR_OTP_PAGE size 0x00001000 flash, ro, executable, page 4096
  0x2000000 CMCC_TCM size 0x1000 other, rw
  0x20000000 RAM_SYSTEM_RAM size 0x18000 ram, rw, executable
  0x4000000 QSPI size 0x1000000 other, rw, executable, external
  0x40000000 PBA_BRIDGE size 0x00004000 io, rw
  0x41000000 PBB_BRIDGE size 0x00017000 io, rw
  0x42000000 PBC_BRIDGE size 0x00012000 io, rw
  0x43000000 SILEX_SFR size 0x20000 io, rw
  0x44000000 PBPIC_BRIDGE size 0x00014000 io, rw
  0x45000000 MCROM_ROM size 0x2000 rom, ro, executable
  0xE0000000 SYSTEM_CM4F_SYSTEM_REGISTERS size 0x1fff4000 io, rw

## Peripheral instances (address, pins/pin function, parameters)
AC at 0x42001C00
  pins: AIN0 PB2/COMPARATOR__ANALOG; AIN1 PB3/COMPARATOR__ANALOG; AIN2 PB0/COMPARATOR__ANALOG; AIN3 PB1/COMPARATOR__ANALOG; CMP0 PA5/COMPARATOR__DIGITAL; CMP1 PA13/COMPARATOR__DIGITAL or PA6/COMPARATOR__DIGITAL; CMPTEN PA6/COMPARATOR__DIGITAL; CMPTOUT PA13/COMPARATOR__DIGITAL; CMPTRDY PA5/COMPARATOR__DIGITAL
  parameters: INSTANCE_ID=71, CHIP_AC_PADDR_MSB=9, CHIP_AC_IMPLEMENTS_VDBLR=0, CHIP_AC_PAIRS=1, CHIP_AC_NUM_CMP=2, CHIP_AC_FUSES_DATA_MSB=127, CHIP_AC_FUSES_RDY_MSB=3, CHIP_AC_FUSES_BIAS0_ROWID=4, CHIP_AC_FUSES_BIAS0_START=0, CHIP_AC_FUSES_BIAS0_SIZE=2, GCLK_ID=20, LOAD_CALIB=0
ADCHS at 0x44001400
  pins: ADCSVCLKI PA7/SILICON_VALIDATION__DFT_; ADCSVFRM PA9/SILICON_VALIDATION__DFT_; ADCSVSARCLK PA10/SILICON_VALIDATION__DFT_; ADCSVSOUT PB9/SILICON_VALIDATION__DFT_; ADCSVTRG PA8/SILICON_VALIDATION__DFT_; AIN0 PB4/ADC; AIN1 PB5/ADC; AIN2 PB6/ADC; AIN3 PB7/ADC; AIN4 PB0/ADC; AIN5 PB1/ADC; AIN6 PB2/ADC; AIN7 PB3/ADC; ANN0 PA3/ADC__DIFFERENTIAL_; CVD0 PB4/ADC; CVD1 PB5/ADC; CVD2 PB6/ADC; CVD3 PB7/ADC; CVD4 PB0/ADC; CVD5 PB1/ADC; CVD6 PB2/ADC; CVD7 PB3/ADC
  parameters: NUM_INTS=2, SET_CLR_INV_PRESENT=1 (Present), ADC_EXTERN_ANALOG_IP=0 (Microchip SARCORE), ADC_USE_SYNP_MUX=0 (Microchip SARCORE), ADC_INPUTS_NMBR=12 (Number of Analog ADC Channels), ADC_VREF_STARTUP_TIME=50 (from Rio-2), ADC_CORE_CALIBRATE_TIME=81 (from Rio-2), ADC_CORES_NMBR=1 (Number of SARCOREs), ADC_FCC_NMBR=0 (No 1st class channels present), ADC_ITRIG_NMBR=6, ADC_UPB_FIFO_PRESENT=0 (FIFO present), ADC_UPB_FIFO_DEPTH=0, ADC_BVCI_PORT_PRESENT=1, ADC_BVCI_FIFO_DEPTH=16, ADC_BVCI_ADDR_WIDTH=15, ADC_DCMP_NMBR=2, ADC_FLTR_NMBR=2, ADC_INTR_NMBR=114, ADC_EARLY_INTR_PRESENT=0 (No early interrupts), ADC_32BIT_REG_ADDR=1 (32-bit wide registers), ADC_32BIT_OUTPUT_DATA=1 (32-bit wide register data), ADC_CVD_PRESENT=1 (CVD present), AIN_8=8 (BandGap Reference (internal AN8)), AIN_9=9 (IVref 1.2V (internal AN9)), AIN_10=10 (VBAT/2 (internal AN10)), AIN_11=11 (VDD33/2 (internal AN11))
ARB at 0x41011000
BLE at 0x41012000
BTZBSYS at 0x41014000
  pins: AC_CMP1_ALT PA6/COMPARATOR__DIGITAL; CLDO_IN CLDO_IN2/RF__ANALOG or CLDO_IN_CLKGEN/RF__ANALOG; CLDO_OUT CLDO_OUT_2/RF__ANALOG or CLDO_OUT_1/RF__ANALOG; COEXCTRL0 PA13/RF__DIGITAL; COEXCTRL1 PA14/RF__DIGITAL; COEXCTRL2 PB0/RF__DIGITAL; FECTRL0 PA8/RF__DIGITAL; FECTRL1 PA9/RF__DIGITAL; FECTRL2 PA10/RF__DIGITAL; FECTRL3 PB4/RF__DIGITAL; FECTRL4 PB5/RF__DIGITAL; FECTRL5 PB6/RF__DIGITAL; FEM_PD_EXT_PA PB9/RF__ANALOG; MBISTCLK PA10/TEST_MODES; RFLDO_OUT RFLDO_OUT/POWER_SUPPLY; RF_IO RFINOUT_2/RF__ANALOG or RFINOUT_1/RF__ANALOG; RTC_IN0_ALT PA9/RTCC; RTC_OUT_ALT PA10/RTCC; TA4D_ALT PA6/TEST_MODES; TP2 PB8/RF__ANALOG; TP3 PB9/RF__ANALOG; TP4 PB4/RF__ANALOG; TP5 PB5/RF__ANALOG; TP6 PB8/RF__ANALOG; VDD_RF VDD_PLL_LF/RF__ANALOG or VDD_PLL_HF/RF__ANALOG or RFLDO_IN/RF__ANALOG; xo_n XO_N/RF__ANALOG; xo_p XO_P/RF__ANALOG
CCL at 0x42001800
  pins: IN0 PA03/1 set 1 or PA07/2 set 1 or PA11/3 set 1 or PB00/4 set 1 or PB04/5 set 1 or PB08/6 set 1 or PB12/7 set 1 or PA02/8 set 1 or PA06/9 set 1 or PA10/10 set 1 or PA14/11 set 1 or PB03/12 set 1 or PB07/13 set 1 or PB11/14 set 1 or PA09/15 set 1; IN1 PA04/1 set 2 or PA08/2 set 2 or PA12/3 set 2 or PB01/4 set 2 or PB05/5 set 2 or PB09/6 set 2 or PB13/7 set 2 or PA03/8 set 2 or PA07/9 set 2 or PA11/10 set 2 or PB00/11 set 2 or PB04/12 set 2 or PB08/13 set 2 or PB12/14 set 2 or PA00/15 set 2; IN2 PA05/1 set 3 or PA09/2 set 3 or PA13/3 set 3 or PB02/4 set 3 or PB06/5 set 3 or PB10/6 set 3 or PA00/7 set 3 or PA04/8 set 3 or PA08/9 set 3 or PA12/10 set 3 or PB01/11 set 3 or PB05/12 set 3 or PB09/13 set 3 or PB13/14 set 3 or PA01/15 set 3; IN3 PA03/1 set 1 or PA07/2 set 1 or PA11/3 set 1 or PB00/4 set 1 or PB04/5 set 1 or PB08/6 set 1 or PB12/7 set 1 or PA02/8 set 1 or PA06/9 set 1 or PA10/10 set 1 or PA14/11 set 1 or PB03/12 set 1 or PB07/13 set 1 or PB11/14 set 1 or PA09/15 set 1; IN4 PA04/1 set 2 or PA08/2 set 2 or PA12/3 set 2 or PB01/4 set 2 or PB05/5 set 2 or PB09/6 set 2 or PB13/7 set 2 or PA03/8 set 2 or PA07/9 set 2 or PA11/10 set 2 or PB00/11 set 2 or PB04/12 set 2 or PB08/13 set 2 or PB12/14 set 2 or PA00/15 set 2; IN5 PA05/1 set 3 or PA09/2 set 3 or PA13/3 set 3 or PB02/4 set 3 or PB06/5 set 3 or PB10/6 set 3 or PA00/7 set 3 or PA04/8 set 3 or PA08/9 set 3 or PA12/10 set 3 or PB01/11 set 3 or PB05/12 set 3 or PB09/13 set 3 or PB13/14 set 3 or PA01/15 set 3; OUT0 PA00/27 set 2 or PA03/27 set 2 or PA04/27 set 2 or PA06/27 set 2 or PA07/27 set 2 or PA08/27 set 2 or PB00/27 set 2 or PB01/27 set 2 or PB04/27 set 2 or PB05/27 set 2 or PB08/27 set 2 or PB12/27 set 2 or PB13/27 set 2 or PA00/27 set 3 or PA01/27 set 3 or PA03/27 set 3 or PA04/27 set 3 or PA05/27 set 3 or PA08/27 set 3 or PA09/27 set 3 or PA13/27 set 3 or PB01/27 set 3 or PB02/27 set 3 or PB06/27 set 3 or PB09/27 set 3 or PB10/27 set 3 or PB13/27 set 3; OUT1 PA01/27 set 4 or PA02/27 set 4 or PA04/27 set 4 or PA05/27 set 4 or PA06/27 set 4 or PA08/27 set 4 or PA09/27 set 4 or PA10/27 set 4 or PA13/27 set 4 or PA14/27 set 4 or PB02/27 set 4 or PB03/27 set 4 or PB07/27 set 4 or PB10/27 set 4 or PB11/27 set 4
  parameters: INSTANCE_ID=70, CHIP_CCL_PADDR_MSB=9, CHIP_CCL_LUT_NUM=2, GCLK_ID=0
CFG at 0x44000000
CMCC at 0x41002000
CRU at 0x44000A00
CVD at 0x44002400
  pins: CVDR0 PB4/ADC; CVDR1 PB5/ADC; CVDR2 PB6/ADC; CVDR3 PB7/ADC; CVDR4 PB0/ADC; CVDR5 PB1/ADC; CVDR6 PB2/ADC; CVDR7 PB3/ADC; CVDT0 PB4/ADC; CVDT1 PB5/ADC; CVDT2 PB6/ADC; CVDT3 PB7/ADC; CVDT4 PB0/ADC; CVDT5 PB1/ADC; CVDT6 PB2/ADC; CVDT7 PB3/ADC
  parameters: CVD_AN_MAX=7 (Highest AN input on the device used for CVD. The channels must be a subset or equal to the shared ADC input channels. Max of 63), CVD_AN_MIN=0 (Highest AN input on the device used for CVD. The channels must be a subset or equal to the shared ADC input channels.), CVD_TX_NUM=8 (Number of TX outputs on the device. Max of 64), CVD_FIFO_DEPTH=8 (Number of words in the UPB FIFO. Max is 1KThe depth of the UPB FIFO is limited to "powers of 2".Allowable values are: 8, 16, 32, 64, 128, 256, 512, 1K), ADCBITS=12 (Number of bits in the ADC data. Max is 16-bit.), NUM_RX=8 (Number of RX Indexes. Valid settings are multiples of 4, and must be equal to or greater than 1+CVD_AN_MAX-CVD_AN_MIN), NUM_TX=8 (Number of TX Indexes. Valid settings are multiples of 4), UPB_ADDRL=2400 (Start address of UPB registers), NUM_ADC=1
CoreDebug at 0xE000EDF0
DAC_CTRL at 0x44003C00
  pins: DACOUT PA3/DAC
DGI_SPI at 0x44003E00
  pins: DGI_SCK PA10/SPI; DGI_SDO PA9/SPI; DGI_SSN PA4/SPI
  parameters: PB_ADDRL=0x3E00, PB_ADDRH=0x3FFF
DMAC at 0x41004000
  parameters: INSTANCE_ID=34, TRIG_NUM=53, DMA_EVIN_NUM=8, DMA_CH_NUM=16, DMA_EVOUT_NUM=4, DMA_FIFO_SIZE=16
DMT at 0x44000E00
  parameters: UPB_ADDRL=0 (See Table 3-20), HOLDREG_PRESENT=0 (Used for 16 bit devices only)
DSCON at 0x42011000
DSU at 0x41000000
  parameters: INSTANCE_ID=32, PERM_ADDR_START1=0x4400_0600 (Permissible address range start), PERM_ADDR_END1=0x4400_07FF (Permissible address range end), PERM_ADDR_START2=0x4400_2C00 (Second permissible address range start), PERM_ADDR_END2=0x4400_3BFF (Second permissible address range end), FLASH_ADDR_START=0x0080_0000 (Flash address start), FLASH_ADDR_END=0x0107_FFFF (Flash address end), DMAC_ID_DCC0=2, DMAC_ID_DCC1=3
DWT at 0xE0001000
EIC at 0x40000800
  pins: EXTINT0 PA03/1 set 1 or PA07/2 set 1 or PA11/3 set 1 or PB00/4 set 1 or PB04/5 set 1 or PB08/6 set 1 or PB12/7 set 1 or PA02/8 set 1 or PA06/9 set 1 or PA10/10 set 1 or PA14/11 set 1 or PB03/12 set 1 or PB07/13 set 1 or PB11/14 set 1 or PA09/15 set 1; EXTINT1 PA04/1 set 2 or PA08/2 set 2 or PA12/3 set 2 or PB01/4 set 2 or PB05/5 set 2 or PB09/6 set 2 or PB13/7 set 2 or PA03/8 set 2 or PA07/9 set 2 or PA11/10 set 2 or PB00/11 set 2 or PB04/12 set 2 or PB08/13 set 2 or PB12/14 set 2 or PA00/15 set 2; EXTINT2 PA05/1 set 3 or PA09/2 set 3 or PA13/3 set 3 or PB02/4 set 3 or PB06/5 set 3 or PB10/6 set 3 or PA00/7 set 3 or PA04/8 set 3 or PA08/9 set 3 or PA12/10 set 3 or PB01/11 set 3 or PB05/12 set 3 or PB09/13 set 3 or PB13/14 set 3 or PA01/15 set 3; EXTINT3 PA06/1 set 4 or PA10/2 set 4 or PA14/3 set 4 or PB03/4 set 4 or PB07/5 set 4 or PB11/6 set 4 or PA01/7 set 4 or PA05/8 set 4 or PA09/9 set 4 or PA13/10 set 4 or PB02/11 set 4 or PB06/12 set 4 or PB10/13 set 4 or PA08/14 set 4 or PA02/15 set 4; NMI PA06/1 set 4 or PA10/2 set 4 or PA14/3 set 4 or PB03/4 set 4 or PB07/5 set 4 or PB11/6 set 4 or PA01/7 set 4 or PA05/8 set 4 or PA09/9 set 4 or PA13/10 set 4 or PB02/11 set 4 or PB06/12 set 4 or PB10/13 set 4 or PA08/14 set 4 or PA02/15 set 4
  parameters: INSTANCE_ID=2, CHIP_EIC_PADDR_MSB=9, CHIP_EIC_EXTINT_NUM=4, CHIP_EIC_NMISENSE_DEFAULT_VALUE=0, CHIP_EIC_NMI_FORCE_DETECTION=0, CHIP_EIC_NUMBER_OF_CONFIG_REGS=1 ((CHIP_EIC_EXTINT_NUM+7)/8), CHIP_EIC_NUMBER_OF_DPRESCALER_REGS=1 ((CHIP_EIC_EXTINT_NUM+7)/8), CHIP_EIC_NUMBER_OF_INTERRUPTS=4 (CHIP_EIC_EXTINT_NUM), GCLK_ID=0
ETM at 0xE0041000
EVSYS at 0x41006000
  parameters: INSTANCE_ID=35, CHIP_EVSYS_PADDR_MSB=12, CHIP_EVSYS_EXTEVT_NUM=0, CHIP_EVSYS_ASYNCHRONOUS_CHANNELS=0xFFFFF000, CHIP_EVSYS_CHANNELS=32, CHIP_EVSYS_GENERATORS=81, CHIP_EVSYS_SYNCH_NUM=12, CHIP_EVSYS_USERS=57, CHIP_EVSYS_CHANNELS_BITS=5, CHIP_EVSYS_GENERATORS_BITS=7, CHIP_EVSYS_SYNCH_NUM_BITS=4, CHIP_EVSYS_USERS_BITS=6, GCLK_ID_{n}={n+8} (n=0..11)
FPU at 0xE000EF30
FREQM at 0x40000400
  parameters: INSTANCE_ID=1, GCLK_ID_MSR=2, GCLK_ID_REF=1
FUSES at FUSES_DEVICECFG 0x00805E80
GPIOA at 0x44002A00 (GPIO)
  pins: IOCA{n} PA{n}/CHANGE_NOTIFICATION (n=0..10); IOCA13 PA13/CHANGE_NOTIFICATION; IOCA14 PA14/CHANGE_NOTIFICATION; RA{n} PA{n}/PORT_I_O (n=0..10); RA13 PA13/PORT_I_O; RA14 PA14/PORT_I_O
GPIOB at 0x44002B00 (GPIO)
  pins: IOCB{n} PB{n}/CHANGE_NOTIFICATION (n=0..13); RB{n} PB{n}/PORT_I_O (n=0..13)
HMATRIX2TOP at 0x42002400
  parameters: INSTANCE_ID=73
ITM at 0xE0000000
MPU at 0xE000ED90
NVIC at 0xE000E100
  parameters: NUM_IRQ=40 (Number of interrupt requests), __NVIC_PRIO_BITS=3 (Number of NVIC interrupt priority bits)
NVM at 0x44000600
  parameters: PFM_ADDR_BASE=0x0100_0000 (Physical Start address of Program Flash Memory in KSEG0/KSEG1 (system address). Address must be aligned to the PFM size. Refer Table 3-23), BOOT_ADDR_BASE=0x0080_0000 (Physical Start address of boot flash memory (system address). Address must be aligned to the NVR size.), BOOT_ADDR_END=0x0080_5FFF (Physical End address of boot flash memory (system address)), OTP_ADDR_BASE=0x0080_6000 (Physical Start address of OTP page flash memory (system address)), NVR_ADDR_END=0x0080_7FFF (Physical End address of secure boot flash memory (system address)), TEST_ADDR_BASE=0x0084_7000 (Physical Base address of Test page flash memory (systemaddress).), TEST_ADDR_END=0x0084_7FFF (Physical End address of test flash memory (system address)), PFM_SYS_ADDR_MSB=18 (The MS bit of the system address needed to address all flash memory. Used by Flash BIST. MSB of 19 = 2^20 = 1MB), FIXED_BOOT_SEL_BIT=18 (The highest bit position that allows address decode to differentiate between fixed and aliased NVR address space. When set, this bit will select fixed NVR space.), NVR_PANEL_SEL_BIT=17 (The highest bit position that allows address decode to differentiate between NVR address space in Panel 1 and Panel 2 (if supported).Note: The value for NVR_PANEL_SEL_BIT will typically be FIXED_BOOT_SEL_BIT-1), F1RR_ADDR=0x0084_7FFF (System physical address of Panel 1's first Redundancy Record.Typically TEST_ADDR_END), F2RR_ADDR=0x0004_7FDF (System physical address of Panel 2's first RedundancyRecord.Typically F1RR_ADDR-(32*RR_NUM_WORDS)), TCFG_ADDR=0x0084_7FBF (System physical address of first TCFG data.Typically F2RR_ADDR-(32*RR_NUM_WORDS)), SEQNUM_ADDR=0x0084_5FFF (System physical address of Panel 1's Sequence Number.Typically BOOT_ADDR_END.), SIGN_ADDR=0x0084_5FDF (System physical address of SIGNTypically SEQNUM_ADDR-32.), CP_ADDR=0x0084_5FBF (System physical address CPTypically SIGN_ADDR-32.), BCFG_ADDR=0x0084_5F9F (System physical address of first BCFG data.Typically CP_ADDR-32.), BCFG_PAGE=5 (NVR page contain BCFG data. The page must be consistent with the BCFG_ADDR[] parameter.), TCFG_PAGE=7 (NVR page contain TCFG data. The page must be consistent with the TCFG_ADDR[] parameter.), NVMOTP_PAGE=6 (NVR page contain OTP data. The page must be consistentwith the OTP_ADDR_BASE[] parameter.), ALT_CFG_SEL_BIT=8 (Bit number to toggle in Main BCFG or TCFG address to generate the equivalent address within the Alternate BCFG or TCFG space.Used in the event of an (unrecoverable) ECC DED error while reading the Main BCFG or TCFG data set.), BCFG_NUM_WORDS=2 (Number of Boot configuration words to be read from Flash), TCFG_NUM_WORDS=2 (Number of Test configuration words to be read from Flash), RR_NUM_WORDS=1 (Number of Flash reads to load Redundancy Record wordsfrom Flash. Does not include Flash IP CFG.Note: This value must always be greater than or equal 1), SIGN_BIT_LOCATION=127 (The signature value is stored in it own flash word at SIGN_ADDR[] location. This is to support flash panels with ECC or restrictions on multi-programming per word/bit. The sign bit position must be set to PFM_DATA_MSB.), CP_BIT_LOCATION=124 (The Code Protect value is stored in it own flash word at CP_ADDR[] location. This is to support flash panels with ECC or restrictions on multi-programming per word/bit.The sign bit position must be set to PFM_DATA_MSB-3.), JTAGEN_BIT_LOCATION=98 (Location of the sign bit in the boot config word. This bit must never be programmed to 0 during a checkerboard program. PFM_DATA_MSB-29Config words are 128-bit regardless of the flash word size.), PFM_NUM_PANELS=1 (Number of Flash panels supported in deviceValid entries are 1 or 2.), PFM_ECC_PRESENT=1 (0: ECC not supported , 1: ECC supported), PFM_DATA_MSB=127 (Flash wrapper read data bus width-1), PFM_PNL_DATA_MSB=139 (Flash panel read data bus width-1), PFM_PNL_ADDR_MSB=21 (Flash panel read address bus width-1 (Unused)), ROW_ADDR_MSB=9 (Flash row word counter MSB (9=256 words per row)), PAGE_ADDR_MSB=11 (Flash Page Size MSB (using byte addressing) (11=4KB page)), NVR_NUM_PAGES=8 (Number of Pages in the NVR regionThe following values must be supported:8, 24), NVR_TEST_PAGES=1 (Number of Pages in the Panel 1 NVR for Test.), PFM_JTAG_MSB=34 (JTAG checkerboard pattern data width-1The following values must be supported:34 for 128-bit data + ECC panels), VALIDS_PER_WORD=1 (Number of 128-bit writes to CFG per configuration reads fromflash. If the CFG block does not implement all CFG registersas defined then those VALIDS should not be connected.Note: This value must always be either 1 or 2.), RR_NUM_RECORDS=2 (Number of Redundancy Records per Panel. Redundancy Records are 16-bit values. Panels usually have 1 Redundant Page per 512KB.Note: Valid values are 1,2,4,8,16,32.), PFM_ERASE_RETRY_PRESENT=1 (0: Erase/Retry Feature not Present1: Erase/Retry Feature Present), PFM_SRHT_PRESENT=0 (Slow Read High Temp0: SRHT Feature not Present1: SRHT Feature Present), FLASH_SIZE=524288, PAGES=128, PAGES_PR_REGION=8
PAC at 0x40000000
  parameters: INSTANCE_ID=0, CHIP_PAC_PADDR_MSB=9, CHIP_PAC_HMATRIX1_IMPLEMENTED=0, CHIP_PAC_HPB_NUM=3, CHIP_PAC_HMATRIX0_SLAVE_SIZE=13, CHIP_PAC_HMATRIX1_SLAVE_SIZE=0
PCHE at 0x44012400
  parameters: UPB_ADDRL=0x2400, NUM_INTS=1 (ECC present), PFM_ECC_PRESENT=1 (ECC present), DCHE_PRIORITY=0 (dCache has equal priority with iCache and aCache), CHE_TAG_MASK=0xFD00_000F, PFM_RDATA_MSB=255 (bit flash data and 16-byte cache lines), NUM_CL_I=4, NUM_CL_D=2, NUM_CL_A=2, FLOP_BASED_CACHE_ARRAY_I=1 (Subject to Change / Design Legwork is needed), FLOP_BASED_CACHE_ARRAY_D=1 (Subject to Change / Design Legwork is needed), FLOP_BASED_CACHE_ARRAY_A=1 (Subject to Change / Design Legwork is needed)
PFW at 0x44000800
  parameters: BOOT_ADDR_BASE=0x0000_0000 (Physical Start address of boot flash memory (system address). Address must be aligned to the NVR size.), FIXED_BOOT_SEL_BIT=18 (The highest bit position that allows address decode to differentiate between fixed and aliased NVR address space. When set, this bit will select fixed NVR space.), NVR_PANEL_SEL_BIT=16 (The highest bit position that allows address decode to differentiate between NVR address space in Panel 1 and Panel 2 (if supported). Note: the value for NVR_PANEL_SEL_BIT will typically be FIXED_BOOT_SEL_BIT-1This parameter is not applicable for PIC32CXBZ3 as there is only a single panel), PFM_PNL_ADDR_MSB=18 (The MSb of the PFM Panel Byte Address.For example, an 18 indicates that each PFM panel is 512KBbecause 2(18+1)=512K.), PAGE_ADDR_MSB=11 (The MSb of the Address bit that defines the page size), FLASH_SIZE_ON_DEVICE=6 (Flash size implemented on the device:In a dual panel system, half this value is the size of each panel.0000 = 8KB0001 = 16KB0010 = 32KB0011 = 64KB0100 = 128KB0101 = 256KB'\\0110 = 512KB0111 = 1MB1000 = 2MB1001 = 4MB1010 = 8MB1011 = 16MB1100 - 1111 = RSVD - use 16MBNote: This values does not include the size of the NVR region.), PFM_NUM_PANELS=1 (Number of Flash panels supported in device), RR_NUM_RECORDS=2 (Number of Redundancy Records per Panel. Redundancy Records are 16-bit values. Panels usually have 1 Redundant Page per 512KB.Note: Valid values are 1,2,4,8,16,32.), NVR_NUM_PAGES=8 (Number of Pages in the NVR regionThe following values must be supported: 8, 24), PFM_PNL_DATA_MSB=139 (The MSb of the data including ECCThe following values are supported.139,271 if PFM_ECC_PRESENT==1127,255 if PFM_ECC_PRESENT==0), PFM_DATA_MSB=127 (The MSb of the PFM Data (post ECC if implement).The following values are supported.127,255), PFM_ECC_PRESENT=1 (0: ECC not supported1: ECC supported), PFM_CRC_PRESENT=1 (0: CRC not supported1: CRC supported), FRC_PERIOD_MIN=95 (Minimum FRC period (ns) - pre-calibration Power up timing must be met using an uncalibrated FRCNote: This number must be adjusted for the accuracy of the FRC.), FRC_PERIOD_NOM=119 (Nominal FRC period (ns) - post-calibration DPD, Read Mode, etc timing uses a calibrated FRC.Note: This number must be adjusted for the accuracy of the FRC.), PFM_TDPDH_NS=5000 (DPD recovery (Tdpdh) delay spec (ns)), PFM_TDPDS_NS=100 (DPD Setup (Tdpds) delay spec (ns)), PFM_TMS_NS=5000 (Read Mode Setup (Tcrs or Tms) delay spec (ns)), PFM_TMH_NS=15 (Read Mode Hold (Tcrh or Tmh) delay spec (ns)), PFM_TRT_NS=1000 (PORb Release Time (Trt) delay spec (ns):defined from rst_reset_por_n=1 to PORb=1), PFM_TRHR_NS=7000 (POR recovery (Trhr) delay spec (ns)), PFM_TONWAIT_NS=6000 (Power-up to any operation (ns): aka tONWAITUsed with tCFG as follows:Actual Delay Required = tONWAIT - tCFG), PFM_TCFG_NS=1000 (LKCFG hold (Tcfg) spec (ns): aka tCFGPORb High to LKCFG high), NUM_INTS=1 (Number of interrupts generated by this macro.), UPB_ADDRL=8000 (This parameter is the lowest peripheral bus address the peripheral module owns (i.e., the base address)), UPB_DEFAULT_SPACING=0x0004
PMU at 0x44013E00
  pins: INT0 PB9/EDGE_INTERRUPT; PMU_RDY_OVERRIDE PMU_RDY_OVERRIDE/RF__DIGITAL; PMU_TEST_CS PA9/RF__DIGITAL; PMU_TEST_SCK PA7/RF__DIGITAL; PMU_TEST_SCKO PB8/RF__DIGITAL; PMU_TEST_SDI PA8/RF__DIGITAL; PMU_TEST_SDO PA10/RF__DIGITAL; pmu_bk_lx PMU_BK_LX1/RF__ANALOG or PMU_BK_LX2/RF__ANALOG; pmu_mldo_buck_vsense PMU_MLDO_BUCK_VSENSE/RF__ANALOG; pmu_mldo_out PMU_MLDO_OUT2/RF__ANALOG or PMU_MLDO_OUT1/RF__ANALOG; pmu_sub PMU_SUB/RF__ANALOG
  parameters: SPI_ADDR_WIDTH=8, SPI_DATA_WIDTH=16, SPI_DRIVING=0 (Falling Edge (Rising Edge / Falling Edge)), SPI_SAMPLING=0 (Falling Edge (Rising Edge / Falling Edge)), NO_OF_BUCK_SQEQ_REGS=3 (Register values to be taken from Analog Design team), RST_CYCLES=8 (Duration of SPI Soft Reset in terms of number of SPI Clock Cycles), SPI_CTRL_STARTUP_VAL=4 (spi_cs_n_mv, spi_clk_mv, spi_dout_mv), LDO_STARTUP_VAL=1 (Definition and usage refer to Section 4.4), MLDO_OPER_VAL=3 (buck_en_mv, mldo_en_mv, buck_mode_mv), BUCK_OPER_VAL=5 ({buck_en_mv, mldo_en_mv, buck_mode_mv}), SW_VAL=7 ({buck_en_mv, mldo_en_mv, buck_mode_mv}), WCM_SIZE=8, WCM_TRANSITION_TIME=4 (nsbased on feedback from ARM and Design team), WCM_RET1N_TIME=4 (ns based on feedback from ARM and Design team), BUCK_SEQ_RETRY_NUM=10, NUM_LDO=1 (Number of LDOs (4 on Rio)), WLDO_NUM=3 (NA if > NUM_LDOS), SHARED_LDO_MODE=1 (WCM memory Core does not use separate LDO in run and in retention mode), VBC_INDIRECT_MODE=1 (New)
PPS at 0x44001000
  pins: RPA{n} PA{n} (n=0..10); RPA13 PA13; RPA14 PA14; RPB{n} PB{n} (n=0..13)
  parameters: PB_ADDRL=0x1000, PB_ADDRH=0x13FF
QSPI at 0x42000000
  pins: CS PB13/SQI; DATA0 PA0/SQI; DATA1 PB12/SQI; DATA2 PB11/SQI; DATA3 PA2/SQI; SCK PA1/SQI
  parameters: INSTANCE_ID=64, DMAC_ID_RX=51, DMAC_ID_TX=52
RAMECC at 0x41008000
  parameters: INSTANCE_ID=36
RCON at 0x44000A00
ROT at 0x44002C00
  parameters: ROM_SIZE=64, NUM_FUSE_BLKS=3 (CAL bits and die info a part of the NVR region), CAL_NUM=0, SYMMETRIC_SECURE_BOOT=0 (Secure boot using ECCDSA authentication)
RTC at 0x42010000
  pins: EVENT PB13/RTCC; IN0 PA3/RTCC; IN1 PA2/RTCC; IN2 PA1/RTCC; IN3 PA0/RTCC; IN0_ALT PA9/RTCC; OUT PA4/RTCC; OUT_ALT PA10/RTCC
  parameters: CHIP_RTC_PADDR_MSB=9, CHIP_RTC_NUM_OF_ALARMS=2, CHIP_RTC_NUM_OF_BKREGS=1, CHIP_RTC_NUM_OF_COMP16=4, CHIP_RTC_NUM_OF_TAMPERS=4, DMAC_ID_TIMESTAMP=1
SERCOM0 at 0x40000C00 (SERCOM)
  pins: PAD0 PA5/MSSP_SPI_I2C; PAD1 PA6/MSSP_SPI_I2C; PAD2 PB9/MSSP_SPI_I2C; PAD3 PA4/MSSP_SPI_I2C
  parameters: INSTANCE_ID=3, DMAC_ID_RX=4, DMAC_ID_TX=5, GCLK_ID_SLOW=3, GCLK_ID_CORE=3
SERCOM1 at 0x40001000 (SERCOM)
  pins: PAD0 PA7/MSSP_SPI_I2C; PAD1 PA8/MSSP_SPI_I2C; PAD2 PA9/MSSP_SPI_I2C; PAD3 PA10/MSSP_SPI_I2C
  parameters: INSTANCE_ID=4, DMAC_ID_RX=6, DMAC_ID_TX=7, GCLK_ID_SLOW=3, GCLK_ID_CORE=3
SERCOM2 at 0x42000400 (SERCOM)
  pins: I2C_SERCOM_PAD0 PA13/I2C; I2C_SERCOM_PAD1 PA14/I2C
  parameters: SPI=0, USART=0, INSTANCE_ID=65, CHIP_SERCOM_PADDR_MSB=31, CHIP_SERCOM_CLK_REDUCTION=1, CHIP_SERCOM_DMA=1, CHIP_SERCOM_FIFO_DEPTH_POWER=1, CHIP_SERCOM_RETENTION_SUPPORT=0, CHIP_SERCOM_SPI=0, CHIP_SERCOM_SPI_HW_SS_CTRL=0, CHIP_SERCOM_SPI_ICSPACE_EXT=0, CHIP_SERCOM_SPI_OZMO=0, CHIP_SERCOM_SPI_WAKE_ON_SSL=0, CHIP_SERCOM_TTBIT_EXTENSION=1, CHIP_SERCOM_TWIM=1, CHIP_SERCOM_TWIS=1, CHIP_SERCOM_TWIS_AUTO_ACK=1, CHIP_SERCOM_TWIS_GROUP_CMD=1, CHIP_SERCOM_TWIS_SDASETUP_CNT_SIZE=8, CHIP_SERCOM_TWIS_SDASETUP_SIZE=4, CHIP_SERCOM_TWIS_SUDAT=1, CHIP_SERCOM_TWI_FASTMP=1, CHIP_SERCOM_TWI_HSMODE=1, CHIP_SERCOM_TWI_SCLSM_MODE=1, CHIP_SERCOM_TWI_SMB_TIMEOUTS=1, CHIP_SERCOM_TWI_TENBIT_ADR=1, CHIP_SERCOM_USART=0, CHIP_SERCOM_USART_AUTOBAUD=0, CHIP_SERCOM_USART_COLDET=0, CHIP_SERCOM_USART_FLOW_CTRL=0, CHIP_SERCOM_USART_FRAC_BAUD=0, CHIP_SERCOM_USART_IRDA=0, CHIP_SERCOM_USART_ISO7816=0, CHIP_SERCOM_USART_LIN_MASTER=0, CHIP_SERCOM_USART_RS485=0, CHIP_SERCOM_USART_SAMPA_EXT=0, CHIP_SERCOM_USART_SAMPR_EXT=0, CHIP_SERCOM_DLY_COMPENSATION=1, CHIP_SERCOM_SE_CNT=1, DMAC_ID_RX=8, DMAC_ID_TX=9, GCLK_ID_SLOW=4, GCLK_ID_CORE=4
SILEX at 0x43000000
SysTick at 0xE000E010
SystemControl at 0xE000E000
TC0 at 0x40001400 (TC)
  parameters: INSTANCE_ID=5, DMAC_ID_OVF=27, DMAC_ID_MC0=28, DMAC_ID_MC1=29, MASTER_SLAVE_MODE=1, GCLK_ID=24
TC1 at 0x40001800 (TC)
  parameters: INSTANCE_ID=6, DMAC_ID_OVF=30, DMAC_ID_MC0=31, DMAC_ID_MC1=32, MASTER_SLAVE_MODE=2, GCLK_ID=25
TC2 at 0x40001C00 (TC)
  parameters: INSTANCE_ID=7, DMAC_ID_OVF=33, DMAC_ID_MC0=34, DMAC_ID_MC1=35, MASTER_SLAVE_MODE=1, GCLK_ID=26
TC3 at 0x40002000 (TC)
  parameters: INSTANCE_ID=8, DMAC_ID_OVF=36, DMAC_ID_MC0=37, DMAC_ID_MC1=38, MASTER_SLAVE_MODE=2, GCLK_ID=26
TC4 at 0x40002400 (TC)
  parameters: INSTANCE_ID=9, DMAC_ID_OVF=39, DMAC_ID_MC0=40, DMAC_ID_MC1=41, MASTER_SLAVE_MODE=1, GCLK_ID=27
TC5 at 0x40002800 (TC)
  parameters: INSTANCE_ID=10, DMAC_ID_OVF=42, DMAC_ID_MC0=43, DMAC_ID_MC1=44, MASTER_SLAVE_MODE=2, GCLK_ID=27
TC6 at 0x40002C00 (TC)
  parameters: INSTANCE_ID=11, DMAC_ID_OVF=45, DMAC_ID_MC0=46, DMAC_ID_MC1=47, MASTER_SLAVE_MODE=1, GCLK_ID=28
TC7 at 0x40003000 (TC)
  parameters: INSTANCE_ID=12, DMAC_ID_OVF=48, DMAC_ID_MC0=49, DMAC_ID_MC1=50, MASTER_SLAVE_MODE=2, GCLK_ID=28
TCC0 at 0x40003400 (TCC)
  parameters: INSTANCE_ID=13, SIZE=24, MASTER_SLAVE_MODE=1, CC_NUM=6, OW_NUM=6, DITHERING=1, OTMX=1, DTI=1, SWAP=1, PG=1, DMAC_ID_OVF=10, DMAC_ID_MC{n}={n+11} (n=0..5), GCLK_ID=21
TCC1 at 0x40003800 (TCC)
  parameters: INSTANCE_ID=14, SIZE=24, MASTER_SLAVE_MODE=2, CC_NUM=6, OW_NUM=6, DITHERING=1, OTMX=1, DTI=1, SWAP=1, PG=1, DMAC_ID_OVF=17, DMAC_ID_MC{n}={n+18} (n=0..5), GCLK_ID=5
TCC2 at 0x40003C00 (TCC)
  parameters: INSTANCE_ID=15, SIZE=16, MASTER_SLAVE_MODE=0, CC_NUM=2, OW_NUM=2, DITHERING=1, OTMX=1, DTI=1, SWAP=1, PG=1, DMAC_ID_OVF=24, DMAC_ID_MC0=25, DMAC_ID_MC1=26, GCLK_ID=5
TPI at 0xE0040000
WDT at 0x44000500
  parameters: UPB_ADDRL=320 (See Table 3-20), MAX_RUN_PS=20, MAX_SLEEP_PS=20, WINDOW_WDT=1 (enabled)
ZIGBEE at 0x41010000

## Interrupts
-15 Reset — Reset Vector, invoked on Power up and warm reset
-14 NonMaskableInt — Non maskable Interrupt, cannot be stopped or preempted
-13 HardFault — Hard Fault, all classes of Fault
-12 MemoryManagement — Memory Management, MPU mismatch, including Access Violation and No Match
-11 BusFault — Bus Fault, Pre-Fetch-, Memory Access Fault, other address/memory related Fault
-10 UsageFault — Usage Fault, i.e. Undef Instruction, Illegal State Transition
-5 SVCall — System Service Call via SVC instruction
-4 DebugMonitor
-2 PendSV — Pendable request for system service
-1 SysTick — System Tick Timer
0 RTC — Real Time Counter
1 EIC — External Interrupt Controller
2 FREQM — Frequency Meter
3 NVM — Non-Volatile Memory
4 CHANGE_NOTICE_A (GPIOA) — PORT_A_INPUT_CHANGE_INTERRUPT
5 CHANGE_NOTICE_B (GPIOB) — PORT_B_INPUT_CHANGE_INTERRUPT
6 DMAC_0_3 (DMAC) — DMA Channel 0..3
7 DMAC_4_15 (DMAC) — DMA Channel 4..15
8 EVSYS_0_3 (EVSYS) — Event System Channel 0..3
9 EVSYS_4_11 (EVSYS) — Event System Channel 4..11
10 PAC — Peripheral Access Controller
11 RAMECC — RAM Error Correction Code
12 SERCOM0 — Serial Communication Interface 0
13 SERCOM1 — Serial Communication Interface 1
14 TCC0 — Timer/Counter for Control Applications 0
15 TCC1 — Timer/Counter for Control Applications 1
16 TCC2 — Timer/Counter for Control Applications 2
{n+17} TC{n} (n=0..7) — Timer/Counter {n}
25 ADCHS_IRQ (ADCHS) — Analog-to-Digital Converter
26 AC — Analog Comparators
27 SILEX_0 (SILEX) — Crypto 0
28 SILEX_1 (SILEX) — Crypto 1
29 QSPI — Quad SPI interface
30 ZB_INT0 (ZIGBEE) — ZIGBEE
31 BT_INT0 (BLE) — Bluetooth 0
32 BT_INT1 (BLE) — Bluetooth 1
33 ARBITER (ARB) — Radio Arbiter
34 ADCHS_FAULT (ADCHS) — ADC Fault Interrupt
35 ADCHS_FCC (ADCHS) — ADC FCC Interrupt
36 ADCHS_BGVR_RDY (ADCHS) — ADC BGVR Ready
37 CLKI_WAKEUP_NMI (BLE) — WSS WAKEUP
38 CVD — CVD Interrpt
39 DGI_SPI — DGI_SPI interrupt
40 SERCOM2 — Serial Communication Interface 2
42 BT_LC (BLE) — Bluetooth LC

## Event generators
{n+1} RTC_PER_{n} (n=0..7), {n+9} RTC_CMP_{n} (n=0..3), 13 RTC_TAMPER, 14 RTC_OVF, {n+15} EIC_EXTINT_{n} (n=0..3), {n+19} DMAC_CH_{n} (n=0..3), 23 PAC_ACCERR, {9n+24} TCC{n}_OVF (n=0..2), {9n+25} TCC{n}_TRG (n=0..2), {9n+26} TCC{n}_CNT (n=0..2), {n+27} TCC0_MCX_{n} (n=0..5), {n+36} TCC1_MCX_{n} (n=0..5), 45 TCC2_MCX_0, 46 TCC2_MCX_1, {3n+47} TC{n}_OVF (n=0..7), {3n+48} TC{n}_MCX_0 (n=0..7), {3n+49} TC{n}_MCX_1 (n=0..7), {n+71} ADCHS_EVENT_{n} (n=0..2), 74 AC_COMP_0, 75 AC_COMP_1, 76 AC_WIN, 77 CCL_LUTOUT_0, 78 CCL_LUTOUT_1, 79 ZIGBEE_TX_TS_ACTIVE, 80 ZIGBEE_RX_TS_ACTIVE

## Event users
0 RTC_TAMPER, {n+1} DMAC_CH_{n} (n=0..7), 9 CM4_TRACE_START, 10 CM4_TRACE_STOP, 11 CM4_TRACE_TRIG, {8n+12} TCC{n}_EV_0 (n=0..2), {8n+13} TCC{n}_EV_1 (n=0..2), {n+14} TCC0_MC_{n} (n=0..5), {n+22} TCC1_MC_{n} (n=0..5), 30 TCC2_MC_0, 31 TCC2_MC_1, {n+32} TC{n}_EVU (n=0..7), {n+40} ADCHS_TRIG_{n} (n=0..11), 52 AC_SOC_0, 53 AC_SOC_1, 54 CCL_LUTIN_0, 55 CCL_LUTIN_1, 56 CVD_TRIGGER

## Properties
SIGNATURES: DSU_DID=0x00009E03

## Pinouts (pin number, pad)
QFN48: 1 VPMU_VDD, 2 PA0, 3 PA1, 4 PA2, 5 PA5, 6 VDD, 7 PA6, 8 PA7, 9 PA8, 10 PA9, 11 PA10, 12 PB12, 13 PB13, 14 PB9, 15 PB8, 16 PA4, 17 PA13, 18 PA14, 19 NMCLR, 20 VDDCORE, 21 CLDO_IN, 22 XO_N, 23 XO_P, 24 VDD_PLL, 25 CLDO_OUT, 26 RFLDO_OUT, 27 BUCK_CLDO, 28 BUCK_PA, 29 RF_IO, 31 PB0, 32 PB1, 33 PB2, 34 PB3, 35 PB4, 36 AVDD, 37 PB5, 38 PB6, 39 PB7, 40 PA3, 41 VDD, 42 PB10, 43 PB11, 44 PA11, 45 PA12, 46 PMU_MLDO, 47 VPMU_VDD, 48 PMU_BK

## Notices in the file
Copyright (c) 2021 Microchip Technology Inc.
SPDX-License-Identifier: Apache-2.0
Licensed under the Apache License, Version 2.0 (the "License");
you may not use this file except in compliance with the License.
You may obtain a copy of the License at
http://www.apache.org/licenses/LICENSE-2.0
Unless required by applicable law or agreed to in writing, software
distributed under the License is distributed on an "AS IS" BASIS,
WITHOUT WARRANTIES OR CONDITIONS OF ANY KIND, either express or implied.
See the License for the specific language governing permissions and
limitations under the License.
