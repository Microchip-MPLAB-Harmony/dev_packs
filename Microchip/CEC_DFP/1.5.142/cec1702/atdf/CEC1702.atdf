# CEC1702 device description
Architecture: CORTEX-M4; Family: CEC1702; Series: CEC1702Q
Parameters: __CM4_REV=0x0100 (CM4 Core Revision), __MPU_PRESENT=1 (MPU present or not), __NVIC_PRIO_BITS=3 (Number of Bits used for Priority Levels), __Vendor_SysTickConfig=0 (Set to 1 if different SysTick Config is used), __VTOR_PRESENT=1 (Vector Table Offset Register present or not), __FPU_PRESENT=1, __ARCH_ARM=1, __ARCH_ARM_CORTEX_M=1, LITTLE_ENDIAN=1
Registers are 32-bit, read-write, reset 0x0 unless marked. A register's access mark holds for its fields unless they carry their own. Offsets are from the block's base; lines under a group give offsets from that group; [hi:lo] are bit positions; {n}, {i} and the like mark numbered series; 'fields as' and 'values as' point back to an identical list; <NAME> marks a mode.

## Ordering variants
CEC1702Q-C0-SX: WFBGA84, up to 48 MHz, 0 to +70 C, 3.135 to 3.465 V
CEC1702Q-C0-7U: WFBGA64, up to 48 MHz, 0 to +70 C, 3.135 to 3.465 V

## Memory
base space: start 0 size 0x100000000, little endian
  0x000B0000 CODE_SRAM size 0x68000 ram, rw, executable
  0x00118000 DATA_SRAM size 0x10000 ram, rw
  0x20000000 DATA_SRAM_ALIAS size 0x10000 ram, rw
  0x40000000 EC_DEVICE_REGISTERS size 0x10000 io, rw
  0x40080000 GPIO_REGISTERS size 0x10000 io, rw
  0x400F0000 HOST_DEVICE_REGISTERS size 0x10000 io, rw
  0x40100000 CRYPTO_RAM size 0x6000 ram, rw
  0xE000E000 SCS size 0x00001000 io, rw
  0x50000000 EXTERNAL_FLASH size 0x8000000 flash, rw, executable, external
eeprom space: start 0 size 0x800

## Peripheral instances (address, pins/pin function, parameters)
PCR at 0x40080100
DMA_MAIN at 0x40002400
DMA_CHAN00 at 0x40002440
DMA_CHAN01 at 0x40002480
DMA_CHAN02 at 0x400024C0
DMA_CHAN{n:02} at {0x40002440+0x40*n} (DMA_CHAN02) (n=3..13)
ECIA at 0x4000E000
GCR at 0x400FFF00
UART0 at 0x400F2400 (UART)
UART1 at 0x400F2800 (UART)
GPIO at 0x40081000
WDT at 0x40000000
TIMER16_{n} at {0x40000C00+0x20*n} (TIMER16) (n=0..2)
TIMER16_3 at 0x40000C80 (TIMER16)
TIMER32_0 at 0x40000C80 (TIMER32)
TIMER32_1 at 0x40000CA0 (TIMER32)
CNT_TMR{n} at {0x40000D00+0x20*n} (CNT_TMR) (n=0..3)
CCT at 0x40001000
HTM0 at 0x40009800 (HTM)
HTM1 at 0x40009820 (HTM)
RTOS at 0x40007400
RTC at 0x400F5000
WEEK at 0x4000AC80
TACH0 at 0x40006000 (TACH)
TACH1 at 0x40006010 (TACH)
PWM{n} at {0x40005800+0x10*n} (PWM) (n=0..5)
PWM10 at 0x400058A0 (PWM)
ADC at 0x40007C00
FAN0 at 0x4000A000 (FAN)
FAN1 at 0x4000A080 (FAN)
LED0 at 0x4000B800 (LED)
LED1 at 0x4000B900 (LED)
RC_ID0 at 0x40001400 (RC_ID)
RC_ID1 at 0x40001480 (RC_ID)
KMS at 0x40009C00
SMB{n} at {0x40004000+0x400*n} (SMB) (n=0..3)
GP_SPI0 at 0x40009400 (GP_SPI)
QMSPI at 0x40005400
TFDP at 0x40008C00
VCI at 0x4000AE00
VBAT_RAM at 0x4000A800
VBAT at 0x4000A400
EC_REG_BANK at 0x4000FC04
EFUSE at 0x40082000
MPU at 0xE000ED90
NVIC at 0xE000E100
  parameters: NUM_IRQ=32 (Number of interrupt requests), __NVIC_PRIO_BITS=3 (Number of NVIC interrupt priority bits), __FPU_PRESENT=1
SysTick at 0xE000E010
SystemControl at 0xE000E000

## Interrupts
-15 Reset — Reset Vector, invoked on Power up and warm reset
-14 NonMaskableInt — Non Maskable Interrupt
-13 HardFault — Hard Fault Interrupt
-12 MemoryManagement — Memory Management Interrupt
-11 BusFault — Bus Fault Interrupt
-10 UsageFault — Usage Fault Interrupt
-5 SVCall — SV Call Interrupt
-4 DebugMonitor — Debug Monitor Interrupt
-2 PendSV — Pend SV Interrupt
-1 SysTick — System Tick Interrupt
0 GIRQ08 (GPIO)
1 GIRQ09 (GPIO)
2 GIRQ10 (GPIO)
3 GIRQ11 (GPIO)
4 GIRQ12 (GPIO)
17 GIRQ26 (GPIO)
20 SMB0
21 SMB1
22 SMB2
23 SMB3
{n+24} DMA_CH{n:02} (DMA_CHAN{n:02}) (n=0..13)
40 UART0
41 UART1
71 TACH0
72 TACH1
74 RPM2PWM_0_FAIL (FAN0)
75 RPM2PWM_0_STALL (FAN0)
76 RPM2PWM_1_FAIL (FAN1)
77 RPM2PWM_1_STALL (FAN1)
78 SNGL (ADC)
79 RPT (ADC)
80 RC_ID0
81 RC_ID1
83 LED0
84 LED1
91 QMSPI
92 TX0 (GP_SPI0)
93 RX0 (GP_SPI0)
111 TIMER (RTOS)
112 HTM0
113 HTM1
114 ALARM_INT (WEEK)
115 WKSUB (WEEK)
116 WKSEC (WEEK)
117 WKSUBSEC (WEEK)
118 SYSPWR (WEEK)
119 RTC
120 RTC_ALARM (RTC)
121 OVRD_IN (VCI)
122 IN0 (VCI)
123 IN1 (VCI)
124 IN2 (VCI)
125 IN3 (VCI)
126 IN4 (VCI)
127 IN5 (VCI)
128 IN6 (VCI)
135 KMS
136 TIMER16_0
137 TIMER16_1
138 TIMER16_2
139 TIMER16_3
140 TIMER32_0
141 TIMER32_1
142 CNT_TMR0
143 CNT_TMR1
144 CNT_TMR2
145 CNT_TMR3
146 CAPTURE_TIMER (CCT)
147 CAPTURE_0 (CCT)
148 CAPTURE_1 (CCT)
149 CAPTURE_2 (CCT)
150 CAPTURE_3 (CCT)
151 CAPTURE_4 (CCT)
152 CAPTURE_5 (CCT)
153 COMPARE_0 (CCT)
154 COMPARE_1 (CCT)
