# PIC32MK1024MCM064 register map
Vendor: Microchip
Architecture 32xxxx. Special function registers and configuration words.
Registers are 32-bit, read-write, reset 0x0 unless marked. A register's access mark holds for its fields unless they carry their own. Addresses are absolute, and some are shared; only a register's first bit layout is shown; lines under a group give offsets from that group; [hi:lo] are bit positions; {n}, {i} and the like mark numbered series; 'fields as' and 'values as' point back to an identical list; <NAME> marks a mode.

## Further device data
pins=1: RA7/PMD5/PWM4L/PWM10H/RPA7/TCK; 2: RB14/PMD6/VBUSON/PWM1H/RPB14; 3: RB15/PMD7/PWM1L/PWM7H/RPB15; 4: RG6/PMA5/RPG6/AN19; 5: RG7/PMA4/RPG7/AN18; 6: RG8/PMA3/RPG8/AN17; 7: MCLR; 8: RG9/PMA2/RPG9/AN16; 9: VSS; 10: VDD; 11: RA12/RPA12/AN10; 12: RA11/USBOEN/RPA11/AN9; 13: RA0/RPA0/C4IN3-/C2IN4-/ANO/OA2OUT; 14: RA1/RPA1/C2IN1+/AN1/OA2IN+; 15: RB0/CTED2/RPB0/C2IN1-/AN2/OA2IN-/Vref-/PGED3; 16: RB1/PMA6/CTED1/RPB1/C4IN2-/C1IN4-/AN3/Vref+/OA1OUT/PGEC3; 17: RB2/RPB2/C2IN3-/C1IN3-/C1IN1+/AN4/OA1IN+/PGEC1; 18: RB3/RPB3/RTCC/C1IN1-/CTCMP/AN5/OA1IN-/PGED1; 19: AVDD; 20: AVSS; 21: RC0/RPC0/C4IN4-/C4IN1+/C3IN4-/AN6/OA3OUT; 22: RC1/PMA7/RPC1/C4IN1-/C3IN1-/AN7/OA3IN-; 23: RC2/PMA13/FLT3/RPC2/C3IN3-/C3IN1+/AN8/OA3IN+; 24: RC11/PMA12/FLT4/C1IN2-/AN11; 25: VSS; 26: VDD; 27: RE12/PMA11/FLT5/C5IN2-/C2IN2-/AN12; 28: RE13/PMA10/FLT6/C3IN2-/AN13; 29: RE14/PMA1/FLT7/RPE14/AN14; 30: RE15/PMA0/FLT8/RPE15/AN15; 31: RA8/PMA9/RPA8/AN26/DAC3/TDI; 32: RB4/PMA8/RPB4/FLT15; 33: RA4/T1G/T1CK/RPA4/C5IN3-/C5IN1+/AN24/DAC1/OA5IN+; 34: VBUS; 35: VUSB3V3; 36: D-; 37: D+; 38: VDD; 39: RC12/RPC12/AN49/CLKI/OSCI; 40: RC15/RPC15/CLKO/OSCO; 41: VSS; 42: RD8; 43: RB5/USBID/RPB5/PGED2; 44: RB6/PMA15/SCK2/RPB6/PGEC2; 45: RC10/PSPCS/PMA14/RPC10/AN48/DAC2; 46: RB7/INT0/SCK1/RPB7/C5IN4-/AN25/OA5OUT; 47: RC13/RPC13/SOSCI; 48: RB8/RPB8/SOSCO; 49: RB9/RPB9/C5IN1-/AN27/OA5IN-/TMS; 50: RC6/PWM6H/RPC6/TRCLK; 51: RC7/PWM6L/PWM12H/RPC7/TRD0; 52: RC8/PSPWR/PMPWR/PWM5H/RPC8/TRD1; 53: RD5/PSPRD/PMPRD/PWM12H/RPD5/TRD2; 54: RD6/PWM12L/RPD6/TRD3; 55: RC9/PWM5L/PWM11H/RPC9; 56: VSS; 57: VDD; 58: RF0/PWM11H/RPF0; 59: RF1/PWM11L/RPF1; 60: RB10/PMD0/PWM3H/RPB10; 61: RB11/PMD1/PWM3L/PWM9H/RPB11; 62: RB12/PMD2/PWM2H/RPB12; 63: RB13/PMD3/CTPLS/PWM2L/PWM8H/RPB13; 64: RA10/PMD4/PWM4H/TDO, interrupts=0 CORE_TIMER — Core Timer Interrupt; 1 CORE_SOFTWARE_0 — Core Software Interrupt 0; 2 CORE_SOFTWARE_1 — Core Software Interrupt 1; 3 EXTERNAL_0 — External Interrupt 0; 4 TIMER_1 — Timer1; 5 INPUT_CAPTURE_1_ERROR — Input Capture 1 Error; 6 INPUT_CAPTURE_1 — Input Capture 1; 7 OUTPUT_COMPARE_1 — Output Compare 1; 8 EXTERNAL_1 — External Interrupt 1; 9 TIMER_2 — Timer2; 10 INPUT_CAPTURE_2_ERROR — Input Capture 2 Error; 11 INPUT_CAPTURE_2 — Input Capture 2; 12 OUTPUT_COMPARE_2 — Output Compare 2; 13 EXTERNAL_2 — External Interrupt 2; 14 TIMER_3 — Timer3; 15 INPUT_CAPTURE_3_ERROR — Input Capture 3 Error; 16 INPUT_CAPTURE_3 — Input Capture 3; 17 OUTPUT_COMPARE_3 — Output Compare 3; 18 EXTERNAL_3 — External Interrupt 3; 19 TIMER_4 — Timer4; 20 INPUT_CAPTURE_4_ERROR — Input Capture 4 Error; 21 INPUT_CAPTURE_4 — Input Capture 4; 22 OUTPUT_COMPARE_4 — Output Compare 4; 23 EXTERNAL_4 — External Interrupt 4; 24 TIMER_5 — Timer5; 25 INPUT_CAPTURE_5_ERROR — Input Capture 5 Error; 26 INPUT_CAPTURE_5 — Input Capture 5; 27 OUTPUT_COMPARE_5 — Output Compare 5; 30 RTCC — Real Time Clock; 31 FLASH_CONTROL — Flash Control Event; 32 COMPARATOR_1 — Comparator 1 Interrupt; 33 COMPARATOR_2 — Comparator 2 Interrupt; 34 USB_1 — USB1 Interrupts; 35 SPI1_FAULT — SPI1 Fault; 36 SPI1_RX — SPI1 Receive Done; 37 SPI1_TX — SPI1 Transfer Done; 38 UART1_FAULT — UART1 Fault; 39 UART1_RX — UART1 Receive Done; 40 UART1_TX — UART1 Transfer Done; 41 I2C1_BUS — I2C1 Bus Collision Event; 42 I2C1_SLAVE — I2C1 Slave Event; 43 I2C1_MASTER — I2C1 Master Event; 44 CHANGE_NOTICE_A — PORTA Input Change Interrupt; 45 CHANGE_NOTICE_B — PORTB Input Change Interrupt; 46 CHANGE_NOTICE_C — PORTC Input Change Interrupt; 47 CHANGE_NOTICE_D — PORTD Input Change Interrupt; 48 CHANGE_NOTICE_E — PORTE Input Change Interrupt; 49 CHANGE_NOTICE_F — PORTF Input Change Interrupt; 50 CHANGE_NOTICE_G — PORTG Input Change Interrupt; 51 PMP — Parallel Master Port; 52 PMP_ERROR — Parallel Master Port Error; 53 SPI2_FAULT — SPI2 Fault; 54 SPI2_RX — SPI2 Receive Done; 55 SPI2_TX — SPI2 Transfer Done; 56 UART2_FAULT — UART2 Fault; 57 UART2_RX — UART2 Receive Done; 58 UART2_TX — UART2 Transfer Done; 59 I2C2_BUS — I2C2 Bus Collision Event; 60 I2C2_SLAVE — I2C2 Slave Event; 61 I2C2_MASTER — I2C2 Master Event; 62 UART3_FAULT — UART3 Fault; 63 UART3_RX — UART3 Receive Done; 64 UART3_TX — UART3 Transfer Done; 65 UART4_FAULT — UART4 Fault; 66 UART4_RX — UART4 Receive Done; 67 UART4_TX — UART4 Transfer Done; 68 UART5_FAULT — UART5 Fault; 69 UART5_RX — UART5 Receive Done; 70 UART5_TX — UART5 Transfer Done; 71 CTMU — CTMU Interrupt; 72 DMA0 — DMA Channel 0; 73 DMA1 — DMA Channel 1; 74 DMA2 — DMA Channel 2; 75 DMA3 — DMA Channel 3; 76 TIMER_6 — Timer6; 77 INPUT_CAPTURE_6_ERROR — Input Capture 6 Error; 78 INPUT_CAPTURE_6 — Input Capture 6; 79 OUTPUT_COMPARE_6 — Output Compare 6; 80 TIMER_7 — Timer7; 81 INPUT_CAPTURE_7_ERROR — Input Capture 7 Error; 82 INPUT_CAPTURE_7 — Input Capture 7; 83 OUTPUT_COMPARE_7 — Output Compare 7; 84 TIMER_8 — Timer8; 85 INPUT_CAPTURE_8_ERROR — Input Capture 8 Error; 86 INPUT_CAPTURE_8 — Input Capture 8; 87 OUTPUT_COMPARE_8 — Output Compare 8; 88 TIMER_9 — Timer9; 89 INPUT_CAPTURE_9_ERROR — Input Capture 9 Error; 90 INPUT_CAPTURE_9 — Input Capture 9; 91 OUTPUT_COMPARE_9 — Output Compare 9; 92 ADC — ADC Global Interrupt; 94 ADC_DC1 — ADC Digital Comparator 1; 95 ADC_DC2 — ADC Digital Comparator 2; 96 ADC_DF1 — ADC Digital Filter 1; 97 ADC_DF2 — ADC Digital Filter 2; 98 ADC_DF3 — ADC Digital Filter 3; 99 ADC_DF4 — ADC Digital Filter 4; 100 ADC_FAULT — ADC Fault; 101 ADC_EOS — ADC End of Scan; 102 ADC_ARDY — ADC Ready; 103 ADC_URDY — ADC Update Ready After Suspend; 104 ADC_DMA — ADC First Class Channels DMA; 105 ADC_EARLY — ADC Early Group Interrupt; 106 ADC_DATA0 — ADC Data 0; 107 ADC_DATA1 — ADC Data 1; 108 ADC_DATA2 — ADC Data 2; 109 ADC_DATA3 — ADC Data 3; 110 ADC_DATA4 — ADC Data 4; 111 ADC_DATA5 — ADC Data 5; 112 ADC_DATA6 — ADC Data 6; 113 ADC_DATA7 — ADC Data 7; 114 ADC_DATA8 — ADC Data 8; 115 ADC_DATA9 — ADC Data 9; 116 ADC_DATA10 — ADC Data 10; 117 ADC_DATA11 — ADC Data 11; 118 ADC_DATA12 — ADC Data 12; 119 ADC_DATA13 — ADC Data 13; 120 ADC_DATA14 — ADC Data 14; 121 ADC_DATA15 — ADC Data 15; 122 ADC_DATA16 — ADC Data 16; 123 ADC_DATA17 — ADC Data 17; 124 ADC_DATA18 — ADC Data 18; 125 ADC_DATA19 — ADC Data 19; 130 ADC_DATA24 — ADC Data 24; 131 ADC_DATA25 — ADC Data 25; 132 ADC_DATA26 — ADC Data 26; 133 ADC_DATA27 — ADC Data 27; 154 ADC_DATA48 — ADC Data 48; 155 ADC_DATA49 — ADC Data 49; 156 ADC_DATA50 — ADC Data 50; 157 ADC_DATA51 — ADC Data 51; 158 ADC_DATA52 — ADC Data 52; 159 ADC_DATA53 — ADC Data 53; 160 COMPARATOR_3 — Comparator 3 Interrupt; 161 COMPARATOR_4 — Comparator 4 Interrupt; 162 COMPARATOR_5 — Comparator 5 Interrupt; 164 UART6_FAULT — UART6 Fault; 165 UART6_RX — UART6 Receive Done; 166 UART6_TX — UART6 Transfer Done; 167 CAN1 — CAN1 Global Interrupt; 168 CAN2 — CAN2 Global Interrupt; 169 QEI1 — QEI 1 Interrupt; 170 QEI2 — QEI 2 Interrupt; 171 PWM_PRI — PWM Primary Event; 172 PWM_SEC — PWM Secondary Event; 173 PWM1 — PWM 1 Interrupt; 174 PWM2 — PWM 2 Interrupt; 175 PWM3 — PWM 3 Interrupt; 176 PWM4 — PWM 4 Interrupt; 177 PWM5 — PWM 5 Interrupt; 178 PWM6 — PWM 6 Interrupt; 179 I2C3_BUS — I2C3 Bus Collision Event; 180 I2C3_SLAVE — I2C3 Slave Event; 181 I2C3_MASTER — I2C3 Master Event; 182 DMA4 — DMA Channel 4; 183 DMA5 — DMA Channel 5; 184 DMA6 — DMA Channel 6; 185 DMA7 — DMA Channel 7; 186 DATA_EE — Data EEPROM Global Interrupt; 187 CAN3 — CAN3 Global Interrupt; 188 CAN4 — CAN4 Global Interrupt; 189 QEI3 — QEI 3 Interrupt; 190 QEI4 — QEI 4 Interrupt; 191 QEI5 — QEI 5 Interrupt; 192 QEI6 — QEI 6 Interrupt; 194 I2C4_BUS — I2C4 Bus Collision Event; 195 I2C4_SLAVE — I2C4 Slave Event; 196 I2C4_MASTER — I2C4 Master Event; 197 INPUT_CAPTURE_10_ERROR — Input Capture 10 Error; 198 INPUT_CAPTURE_10 — Input Capture 10; 199 OUTPUT_COMPARE_10 — Output Compare 10; 200 INPUT_CAPTURE_11_ERROR — Input Capture 11 Error; 201 INPUT_CAPTURE_11 — Input Capture 11; 202 OUTPUT_COMPARE_11 — Output Compare 11; 203 INPUT_CAPTURE_12_ERROR — Input Capture 12 Error; 204 INPUT_CAPTURE_12 — Input Capture 12; 205 OUTPUT_COMPARE_12 — Output Compare 12; 206 INPUT_CAPTURE_13_ERROR — Input Capture 13 Error; 207 INPUT_CAPTURE_13 — Input Capture 13; 208 OUTPUT_COMPARE_13 — Output Compare 13; 209 INPUT_CAPTURE_14_ERROR — Input Capture 14 Error; 210 INPUT_CAPTURE_14 — Input Capture 14; 211 OUTPUT_COMPARE_14 — Output Compare 14; 212 INPUT_CAPTURE_15_ERROR — Input Capture 15 Error; 213 INPUT_CAPTURE_15 — Input Capture 15; 214 OUTPUT_COMPARE_15 — Output Compare 15; 215 INPUT_CAPTURE_16_ERROR — Input Capture 16 Error; 216 INPUT_CAPTURE_16 — Input Capture 16; 217 OUTPUT_COMPARE_16 — Output Compare 16; 218 SPI3_FAULT — SPI3 Fault; 219 SPI3_RX — SPI3 Receive Done; 220 SPI3_TX — SPI3 Transfer Done; 221 SPI4_FAULT — SPI4 Fault; 222 SPI4_RX — SPI4 Receive Done; 223 SPI4_TX — SPI4 Transfer Done; 224 SPI5_FAULT — SPI5 Fault; 225 SPI5_RX — SPI5 Receive Done; 226 SPI5_TX — SPI5 Transfer Done; 227 SPI6_FAULT — SPI6 Fault; 228 SPI6_RX — SPI6 Receive Done; 229 SPI6_TX — SPI6 Transfer Done; 230 SYSTEM_BUS_PROTECTION — System Bus Protection Violation; 238 PWM7 — PWM 7 Interrupt; 239 PWM8 — PWM 8 Interrupt; 240 PWM9 — PWM 9 Interrupt; 241 PWM10 — PWM 10 Interrupt; 242 PWM11 — PWM 11 Interrupt; 243 PWM12 — PWM 12 Interrupt; 245 ADC_DC3 — ADC Digital Comparator 3; 246 ADC_DC4 — ADC Digital Comparator 4; 247 PCACHE — P - Cache Event Interrupt; 254 CORE_PERF_COUNT — MPU Core Performance Counter Event; 255 CORE_FAST_DEBUG_CHAN — Core Fast Debug Channel
