# CEC1712H_B2_SX device description
Architecture: CORTEX-M4; Family: CEC1712H_B2_SX; Series: CEC1712H_B2_SX
Parameters: __MPU_PRESENT=0 (MPU present or not), __CM4_REV=0x0100 (CM4 Core Revision), __NVIC_PRIO_BITS=3 (Number of Bits used for Priority Levels), __Vendor_SysTickConfig=0 (Set to 1 if different SysTick Config is used), __VTOR_PRESENT=1 (Vector Table Offset Regisrer present or not), __ARCH_ARM=1, __ARCH_ARM_CORTEX_M=1, LITTLE_ENDIAN=1, EXTERNAL_APPLICATION_FLASH=1, __REVID=1
Programming and debug interfaces: SWD
Registers are 32-bit, read-write, reset 0x0 unless marked. A register's access mark holds for its fields unless they carry their own. Offsets are from the block's base; lines under a group give offsets from that group; [hi:lo] are bit positions; {n}, {i} and the like mark numbered series; 'fields as' and 'values as' point back to an identical list; <NAME> marks a mode.

## Ordering variants
CEC1712H-B2-I/SX: WFBGA84, up to 48 MHz, -40 to +85 C, 3.135 to 3.63 V

## Memory
base space: start 0 size 0x100000000, little endian
  0x000E0000 CODE_SRAM size 0x38000 ram, rw, executable
  0x00118000 DATA_SRAM size 0x8000 ram, rw
  0x20000000 DATA_SRAM_ALIAS size 0x8000 ram, rw
  0x40000000 EC_DEVICE_REGISTERS size 0x80000 io, rw
  0x40080000 GPIO_REGISTERS size 0x10000 io, rw
  0x400F0000 HOST_DEVICE_REGISTERS size 0x100000 io, rw
  0x40100000 CRYPTO_RAM size 0x6000 ram, ro
  0xE000E000 SCS size 0x00001000 io, rw
  0x50000000 EXTERNAL_FLASH size 0x8000000 flash, rw, executable, external

## Peripheral instances (address, pins/pin function, parameters)
PCR at 0x40080100
  pins: nRESET_IN nRESET_IN/A; VCC_PWRGD GPIO057/B; CLK32kHz_IN GPIO165/B; XTAL1 XTAL1/A; XTAL2 XTAL2/A; PWROK GPIO106/B
DMA_MAIN at 0x40002400
DMA_CHAN00 at 0x40002440
DMA_CHAN01 at 0x40002480
DMA_CHAN02 at 0x400024C0
DMA_CHAN{n:02} at {0x40002440+0x40*n} (DMA_CHAN02) (n=3..11)
ECIA at 0x4000E000
GCR at 0x400FFF00
UART0 at 0x400F2400 (UART)
  pins: UART0_TX GPIO104/B; UART0_RX GPIO105/B; UART0_CTS_n GPIO143/C; UART0_RTS_n GPIO144/C
UART1 at 0x400F2800 (UART)
  pins: UART1_TX GPIO170/B; UART1_RX GPIO171/B
UART2 at 0x400F2C00 (UART)
  pins: UART2_TX GPIO146/D; UART2_RX GPIO145/D
GPIO at 0x40081000
  pins: GPIO000 GPIO000/B; GPIO002 GPIO002/A; GPIO003 GPIO003/A; GPIO004 GPIO004/A; GPIO012 GPIO012/A; GPIO013 GPIO013/A; GPIO015 GPIO015/A; GPIO016 GPIO016/A; GPIO020 GPIO020/A; GPIO021 GPIO021/A; GPIO026 GPIO026/A; GPIO027 GPIO027/A; GPIO030 GPIO030/A; GPIO032 GPIO032/A; GPIO034 GPIO034/A; GPIO045 GPIO045/A; GPIO046 GPIO046/A; GPIO047 GPIO047/A; GPIO050 GPIO050/A; GPIO051 GPIO051/A; GPIO053 GPIO053/A; GPIO055 GPIO055/A; GPIO056 GPIO056/A; GPIO057 GPIO057/A; GPIO063 GPIO063/A; GPIO065 GPIO065/A; GPIO070 GPIO070/A; GPIO071 GPIO071/A; GPIO104 GPIO104/A; GPIO105 GPIO105/A; GPIO106 GPIO106/A; GPIO107 GPIO107/A; GPIO112 GPIO112/A; GPIO113 GPIO113/A; GPIO{n} GPIO{n}/A (n=120..127); GPIO130 GPIO130/A; GPIO131 GPIO131/A; GPIO132 GPIO132/A; GPIO140 GPIO140/A; GPIO143 GPIO143/A; GPIO144 GPIO144/A; GPIO145 GPIO145/A; GPIO146 GPIO146/A; GPIO147 GPIO147/A; GPIO150 GPIO150/A; GPIO156 GPIO156/A; GPIO157 GPIO157/A; GPIO163 GPIO163/B; GPIO165 GPIO165/A; GPIO170 GPIO170/A; GPIO171 GPIO171/A; GPIO200 GPIO200/A; GPIO201 GPIO201/A; GPIO202 GPIO202/A; GPIO203 GPIO203/A; GPIO204 GPIO204/A; GPIO223 GPIO223/A; GPIO224 GPIO224/A; GPIO227 GPIO227/A; GPIO250 GPIO250/B; GPIO253 GPIO253/A
WDT at 0x40000400
TIMER16_0 at 0x40000C00 (TIMER16)
TIMER16_1 at 0x40000C20 (TIMER16)
TIMER32_0 at 0x40000C80 (TIMER32)
TIMER32_1 at 0x40000CA0 (TIMER32)
CCT at 0x40001000
  pins: ICT0_TACH0 GPIO050/B; ICT1_TACH1 GPIO051/B; ICT5 GPIO140/C or GPIO065/D; ICT3 GPIO016/D; ICT8 GPIO063/D; ICT10 GPIO015/C; ICT11 GPIO046/D; ICT14 GPIO045/D; ICT13 GPIO047/D; ICT9 GPIO113/C; ICT12 GPIO124/D
HTM0 at 0x40009800 (HTM)
HTM1 at 0x40009820 (HTM)
RTOS at 0x40007400
RTC at 0x400F5000
WEEK at 0x4000AC80
TACH0 at 0x40006000 (TACH)
  pins: ICT0_TACH0 GPIO050/B
TACH1 at 0x40006010 (TACH)
  pins: ICT1_TACH1 GPIO051/B
PWM0 at 0x40005800 (PWM)
  pins: PWM0 GPIO053/B
PWM2 at 0x40005820 (PWM)
  pins: PWM2 GPIO055/B or GPIO045/B
PWM3 at 0x40005830 (PWM)
  pins: PWM3 GPIO056/B or GPIO047/C
PWM5 at 0x40005850 (PWM)
  pins: PWM5 GPIO002/B
PWM6 at 0x40005860 (PWM)
  pins: PWM6 GPIO063/C
PWM7 at 0x40005870 (PWM)
  pins: PWM7 GPIO015/B
ADC at 0x40007C00
  pins: VREF_ADC VREF_ADC/A; ADC00 GPIO200/B; ADC01 GPIO201/B; ADC02 GPIO202/B; ADC03 GPIO203/B; ADC04 GPIO204/B
LED0 at 0x4000B800 (LED)
  pins: LED0 GPIO156/B
LED1 at 0x4000B900 (LED)
  pins: LED1 GPIO157/B
SMB{n} at {0x40004000+0x400*n} (SMB) (n=0..4)
  pins: SDA0 GPIO003/B; SCL0 GPIO004/B; SDA1 GPIO130/B; SCL1 GPIO131/B; SDA4 GPIO143/B; SCL4 GPIO144/B; SDA6 GPIO132/B; SCL6 GPIO140/B; SDA7 GPIO012/B; SCL7 GPIO013/B; SDA9 GPIO145/B; SCL9 GPIO146/B; SDA10 GPIO030/C; SCL10 GPIO107/D; SDA12 GPIO026/D; SCL12 GPIO027/D; SDA14 GPIO070/C; SCL14 GPIO071/C; SDA15 GPIO147/B; SCL15 GPIO150/B
I2C{n} at {0x40005100+0x100*n} (I2C) (n=0..2)
  pins: SDA0 GPIO003/B; SCL0 GPIO004/B; SDA1 GPIO130/B; SCL1 GPIO131/B; SDA4 GPIO143/B; SCL4 GPIO144/B; SDA6 GPIO132/B; SCL6 GPIO140/B; SDA7 GPIO012/B; SCL7 GPIO013/B; SDA9 GPIO145/B; SCL9 GPIO146/B; SDA10 GPIO030/C; SCL10 GPIO107/D; SDA12 GPIO026/D; SCL12 GPIO027/D; SDA14 GPIO070/C; SCL14 GPIO071/C; SDA15 GPIO147/B; SCL15 GPIO150/B
QMSPI at 0x40070000
  pins: SHD_CLK0 GPIO056/C; SHD_CS1_n0 GPIO002/C; SHD_CS0_n0 GPIO055/C; SHD_IO00 GPIO223/B; SHD_IO10 GPIO224/C; SHD_IO20 GPIO227/B; SHD_IO30 GPIO016/C; PVT_IO00 GPIO121/B; PVT_IO10 GPIO122/B; PVT_IO20 GPIO123/B; PVT_CS_n0 GPIO124/B; PVT_CLK0 GPIO125/B; PVT_IO30 GPIO126/B
TFDP at 0x40008C00
  pins: TFDP_CLK0 GPIO104/C; TFDP_DATA0 GPIO105/C
VCI at 0x4000AE00
  pins: SYSPWR_PRES_VCI_IN3_n GPIO000/A; BGPO0 GPIO253/B; VCI_IN0_n GPIO163/A; VCI_OUT GPIO250/A
VBAT_RAM at 0x4000A800
VBAT at 0x4000A400
EC_REG_BANK at 0x4000FC00
OTP at 0x40082000
NVIC at 0xE000E100
  parameters: NUM_IRQ=32 (Number of interrupt requests), __NVIC_PRIO_BITS=3 (Number of NVIC interrupt priority bits)
SysTick at 0xE000E010
SystemControl at 0xE000E000
PKE_ERR
PKE_END
RNG
AES
HASH

## Interrupts
-15 Reset — Reset Vector, invoked on Power up and warm reset
-14 NonMaskableInt — Non maskable Interrupt, cannot be stopped or preempted
-13 HardFault — Hard Fault, all classes of Fault
-11 BusFault — Bus Fault, Pre-Fetch-, Memory Access Fault, other address/memory related Fault
-10 UsageFault — Usage Fault, i.e. Undef Instruction, Illegal State Transition
-5 SVCall — System Service Call via SVC instruction
-4 DebugMonitor
-2 PendSV — Pendable request for system service
-1 SysTick — System Tick Timer
0 GIRQ08 (GPIO)
1 GIRQ09 (GPIO)
2 GIRQ10 (GPIO)
3 GIRQ11 (GPIO)
4 GIRQ12 (GPIO)
5 GIRQ13 (SMB0)
6 GIRQ14 (DMA_CHAN00)
7 GIRQ15 (UART0)
8 GIRQ16 (PKE_ERR)
10 GIRQ18 (QMSPI)
12 GIRQ20 (OTP)
13 GIRQ21 (WDT)
14 GIRQ23 (TIMER16_0)
17 GIRQ26 (GPIO)
20 I2CSMB0 (SMB0)
21 I2CSMB1 (SMB1)
22 I2CSMB2 (SMB2)
23 I2CSMB3 (SMB3)
{n+24} DMA_CH{n:02} (DMA_CHAN{n:02}) (n=0..11)
40 UART0
41 UART1
44 UART2
65 PKE_ERR
66 PKE_END
67 RNG
68 AES
69 HASH
71 TACH0
72 TACH1
78 ADC_SNGL (ADC)
79 ADC_RPT (ADC)
83 LED0
84 LED1
91 QMSPI
111 TMR (RTOS)
112 HTMR0 (HTM0)
113 HTMR1 (HTM1)
114 WK (WEEK)
115 WKSUB (WEEK)
116 WKSEC (WEEK)
117 WKSUBSEC (WEEK)
118 SYSPWR (WEEK)
119 RTC
120 RTC_ALARM (RTC)
122 VCI_IN0 (VCI)
123 VCI_IN1 (VCI)
129 PS2_0A_WAKE (PS2_0)
136 TIMER16_0
137 TIMER16_1
140 TIMER32_0
141 TIMER32_1
146 CCT
147 CCT_CAP0 (CCT)
148 CCT_CAP1 (CCT)
149 CCT_CAP2 (CCT)
150 CCT_CAP3 (CCT)
151 CCT_CAP4 (CCT)
152 CCT_CAP5 (CCT)
153 CCT_CMP0 (CCT)
154 CCT_CMP1 (CCT)
158 I2CSMB4 (SMB4)
168 I2C0
169 I2C1
170 I2C2
171 WDT

## Pinouts (pin number, pad)
CEC1712H_B2_SX: D2 nRESET_IN, F3 GPIO057, E2 GPIO106, B2 GPIO051, A3 GPIO050, F2 GPIO200, G2 GPIO201, H2 GPIO202, G1 GPIO203, H1 GPIO204, D1 GPIO065, J8 GPIO070, K8 GPIO071, J6 GPIO063, K3 GPIO224, K2 GPIO016, K4 GPIO227, K5 GPIO223, K7 GPIO055, K6 GPIO056, K1 GPIO012, J2 GPIO013, J5 GPIO130, J9 GPIO131, J3 GPIO020, J4 GPIO021, J7 GPIO002, H6 GPIO015, H5 GPIO032, A9 GPIO132, B7 GPIO140, K9 GPIO026, K10 GPIO053, J10 GPIO027, G7 GPIO030, H9 GPIO107, H10 GPIO120, G9 GPIO112, G10 GPIO113, G4 GPIO034, F9 GPIO170, F8 GPIO171, E8 JTAG_RST_n, D9 GPIO104, E9 GPIO105, C9 GPIO046, B8 GPIO047, D10 GPIO121, B10 GPIO122, E10 GPIO123, F10 GPIO126, C10 GPIO124, A10 GPIO125, C6 GPIO127, D7 GPIO156, B9 GPIO157, C5 GPIO045, A6 GPIO165, C2 GPIO145, B6 GPIO146, A7 GPIO147, B3 GPIO150, E7 GPIO143, D6 GPIO144, A8 GPIO004, B5 GPIO003, A5 GPIO000, B4 GPIO163, B1 GPIO253, A1 GPIO250, A4 XTAL1, A2 XTAL2, D4 VSS_ANALOG, C1 VTR_PLL, D5 VBAT, E4 VSS, E1 VTR_REG, E3 VREF_ADC, F7 VSS, G6 VTR1, F4 VTR_ANALOG, F1 VR_CAP, G5 VTR2, J1 VSS_ADC
