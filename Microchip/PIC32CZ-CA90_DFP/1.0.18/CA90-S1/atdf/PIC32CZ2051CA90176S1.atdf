# PIC32CZ2051CA90176S1 device description
Architecture: CORTEX-M0PLUS; Family: PIC32CZ; Series: PIC32CZCA90
Parameters: LITTLE_ENDIAN=1, NUM_IRQ=3, __CM0P_REV=0x0001, __MPU_PRESENT=0, __NVIC_PRIO_BITS=2, __VTOR_PRESENT=1, __Vendor_SysTickConfig=0, POWER_DOMAIN=pd_core, __ARCH_ARM=1, __ARCH_ARM_CORTEX_M=1
Programming and debug interfaces: SWD
Registers are 32-bit, read-write, reset 0x0 unless marked. A register's access mark holds for its fields unless they carry their own. Offsets are from the block's base; lines under a group give offsets from that group; [hi:lo] are bit positions; {n}, {i} and the like mark numbered series; 'fields as' and 'values as' point back to an identical list; <NAME> marks a mode.

## Memory
base space: start 0 size 0x100000000, little endian
  0x0A00C000 FCR_CFM_HSMCFG0 size 0x1000 flash, rw, page 4096
  0x0A00D000 FCR_CFM_HSMCFG1 size 0x1000 flash, rw, page 4096
  0x0A00E000 FCR_CFM_HSMCFG2 size 0x1000 flash, rw, page 4096
  0x0A00F000 FCR_CFM_HSMCFG3 size 0x1000 flash, rw, page 4096
  0x10000000 RAM size 0x20000 ram, rw, executable
  0x20000000 ROM size 0x8000 rom, ro, executable
  0x50000000 APBA size 0x3000000 io, rw
  0x53800000 BATTREGS size 0x20 ram, rw, executable
  0x54000000 APBB size 0xC000000 io, rw
  0x60000000 AUX_INTF size 0x10000000 ram, rw, executable, external
  0xE0000000 PPB size 0x20000000 io, rw

## Peripheral instances (address, pins/pin function, parameters)
AI at 0x57000100 (AUXINTF)
CSM at 0x57000000
EXTDMA at 0x52000800
INTCTRL at 0x52000400
MAILBOX at 0x50000000
MCRAMC at 0x57000300
  parameters: AHB_CLOCK_ENABLE=1 (MCRAMC CLOCK GATER), AHB_ECC=1 (ECC LOGIC), AHB_PORTS_NB=1 (NUMBER OF AHB PORTS), AHB_READ_PREBUFFERING=1, AHB_REQUEST_ISOLATION_REGISTER=1 (AHB REQUEST TIMING PATHS ISOLATION), ARBITRATION_TYPE=2 (ARBITRATION SCHEME, FIXED_PRIORITY = 0, HIGHLIGHT = 1, HOPSCOTCH = 2), BIT_STROBE_RAM=0 (Set this parameter to TRUE if the ram_wem_bundle outputs are connected to ram bit-strobe write masks), CHANNELS_NB=1 (NUMBER OF RAM CHANNELS), ECC_SYNDROM_REGISTER=1 (ECC TIMING PATH BALANCING), HADDR_READ_ISOLATION_REGISTER=0 (Set to IMPLEMENTED to add 1 wait-state max (0 min) per memory new line read access for each of the AHB timing path isolations), HRDATA_ISOLATION_REGISTER=1 (AHB REQUEST TIMING PATHS ISOLATION), MCRAMC_CLK_GATER=1 (MCRAMC CLOCK GATER), MCRAMC_PADDR_SIZE=8 (APB USER INTERFACE), MEMORY_AUTO_CORRECTION=1 (Perform an automatic write-back of the corrected ram word after read), MEMORY_ENABLE_POLARITY=0 (POSITIVE if Memory is selected when ram_me is 1'b1), MW_CLOCK_ENABLE=0 (MCRAMC CLOCK GATER), MW_DATA_SIZE=32 (MW DATA BUS SIZE), MW_PORT_SLICES_NB=0 (NUMBER OF PORT SLICES FOR THE WAITED SRAM INTERFACE), M0_CLOCK_ENABLE=0 (MCRAMC CLOCK GATER), M0_DATA_SIZE=32 (M0 DATA BUS SIZE), M0_HYBRID_READ_WRITE_ACCESS=0 (M0 HYBRID SIMULTANEOUS READ + WRITE ACCESS), M0_PORT_SLICES_NB=0 (NUMBER OF PORT SLICES FOR THE 0 WS SRAM INTERFACE), RAM_ADD_SIZE=14 (NUMBER OF ADDRESS BITS FOR ONE CHANNEL RAM CELL), RAM_AHB_ADDRESS_OFFSET=0x00000 (RAM BLOCK AHB ADDRESS OFFSET), STORE_BYTE_STROBE=0 (AHB byte strobes can be stored and read back through the M0 interface), ULTRA=1 (ULTRA USER INTERFACE), WRITE_ENABLE_POLARITY=0 (POSITIVE if Memory is written when ram_we is 1'b1), WRITE_ENABLE_USED=0 (TRUE if the Memory makes use of a global per channel ram_we write enable), WRITE_MASK_POLARITY=0 (POSITIVE if Memory is written when ram_wem is 1'b1)
NVIC at 0xE000E100
  parameters: NUM_IRQ=3 (Number of interrupt requests), __NVIC_PRIO_BITS=2 (Number of NVIC interrupt priority bits)
PKRAM at 0x57000200
RTC at 0x59000000
SYSREGS at 0x52001C00
SysTick at 0xE000E010
SystemControl at 0xE000E000
  parameters: __VTOR_PRESENT=1 (Vector Table Offset Register present)
TAMPER at 0x59000400
TIMERS at 0x52001800
WDT at 0x52000C00

## Interrupts
-15 Reset — Reset Vector, invoked on Power up and warm reset
-14 NonMaskableInt — Non maskable Interrupt, cannot be stopped or preempted
-13 HardFault — Hard Fault, all classes of Fault
-5 SVCall — System Service Call via SVC instruction
-2 PendSV — Pendable request for system service
-1 SysTick — System Tick Timer
0 CSM_COMMANDCANCEL (CSM)
1 INTCTRL
2 CSM_FCW (CSM)

## Notices in the file
Copyright (c) 2021 Microchip Technology Inc.
SPDX-License-Identifier: Apache-2.0
Licensed under the Apache License, Version 2.0 (the "License");
you may not use this file except in compliance with the License.
You may obtain a copy of the License at
http://www.apache.org/licenses/LICENSE-2.0
Unless required by applicable law or agreed to in writing, software
distributed under the License is distributed on an "AS IS" BASIS,
WITHOUT WARRANTIES OR CONDITIONS OF ANY KIND, either express or implied.
See the License for the specific language governing permissions and
limitations under the License.
