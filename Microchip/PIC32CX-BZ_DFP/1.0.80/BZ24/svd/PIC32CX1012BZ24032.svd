# PIC32CX1012BZ24032 register map
Vendor: Microchip Technology; Series: BZ24; File version: 0
CPU: CM4 r0p1, little endian, MPU, FPU, 3 interrupt priority bits
Registers are 32-bit, read-write, reset 0x0 unless marked. A register's access mark holds for its fields unless they carry their own. Offsets are from the block's base; [hi:lo] are bit positions; {n}, {i} and the like mark numbered series; 'fields as' and 'values as' point back to an identical list.

## PPS
Base 0x44001000; register names take the prefix PPS_
0x00 EXTINT0R
  [3:0] EXTINT0
    15=RPA9; 1=RPA3; 2=RPA7; 5=RPB4; 6=RPB8; 9=RPA6; 10=RPA10; 13=RPB7; 0=OFF
0x04 EXTINT1R
  [3:0] EXTINT1
    1=RPA4; 2=RPA8; 5=RPB5; 6=RPB9; 8=RPA3; 9=RPA7; 12=RPB4; 13=RPB8; 0=OFF
0x08 EXTINT2R
  [3:0] EXTINT2
    1=RPA5; 2=RPA9; 5=RPB6; 8=RPA4; 9=RPA8; 12=RPB5; 13=RPB9; 0=OFF
0x0C EXTINT3R
  [3:0] EXTINT3
    1=RPA6; 2=RPA10; 5=RPB7; 8=RPA5; 9=RPA9; 12=RPB6; 14=RPA8; 0=OFF
0x3C NMIR
  [3:0] NMI
    values as EXTINT3R.EXTINT3
0x40 SCOM0P0R
  [3:0] SCOM0P0 — SERCOM0/PAD0
    values as EXTINT1R.EXTINT1
0x44 SCOM0P1R
  [3:0] SCOM0P1 — SERCOM0/PAD1
    values as EXTINT2R.EXTINT2
0x48 SCOM0P2R
  [3:0] SCOM0P2 — SERCOM0/PAD2
    values as EXTINT3R.EXTINT3
0x4C SCOM0P3R
  [3:0] SCOM0P3 — SERCOM0/PAD3
    values as EXTINT0R.EXTINT0
0x50 SCOM1P0R
  [3:0] SCOM1P0 — SERCOM1/PAD0
    values as EXTINT2R.EXTINT2
0x54 SCOM1P1R
  [3:0] SCOM1P1 — SERCOM1/PAD1
    values as EXTINT3R.EXTINT3
0x58 SCOM1P2R
  [3:0] SCOM1P2 — SERCOM1/PAD2
    values as EXTINT0R.EXTINT0
0x5C SCOM1P3R
  [3:0] SCOM1P3 — SERCOM1/PAD3
    values as EXTINT1R.EXTINT1
0x80 QSCKR
  [3:0] QSCK — QSPI/SCK
    values as EXTINT0R.EXTINT0
0x84 QD0R
  [3:0] QD0 — QSPI/DATA0
    values as EXTINT3R.EXTINT3
0x88 QD1R
  [3:0] QD1 — QSPI/DATA1
    values as EXTINT0R.EXTINT0
0x8C QD2R
  [3:0] QD2 — QSPI/DATA2
    values as EXTINT1R.EXTINT1
0x90 QD3R
  [3:0] QD3 — QSPI/DATA3
    values as EXTINT2R.EXTINT2
0x94 REFIR
  [3:0] REFI
    values as EXTINT0R.EXTINT0
0x98 CCLIN0R
  [3:0] CCLIN0
    values as EXTINT0R.EXTINT0
0x9C CCLIN1R
  [3:0] CCLIN1
    values as EXTINT1R.EXTINT1
0xA0 CCLIN2R
  [3:0] CCLIN2
    values as EXTINT2R.EXTINT2
0xA4 CCLIN3R
  [3:0] CCLIN3
    values as EXTINT0R.EXTINT0
0xA8 CCLIN4R
  [3:0] CCLIN4
    values as EXTINT1R.EXTINT1
0xAC CCLIN5R
  [3:0] CCLIN5
    values as EXTINT2R.EXTINT2
0xB0 TC0WO0G1R
  [3:0] TC0WO0 — TC0/WO0G1
    values as EXTINT0R.EXTINT0
0xB4 TC0WO0G2R
  [3:0] TC0WO0 — TC0/WO0G2
    values as EXTINT1R.EXTINT1
0xB8 TC0WO1G3R
  [3:0] TC0WO1 — TC0/WO1G3
    values as EXTINT2R.EXTINT2
0xBC TC0WO1G4R
  [3:0] TC0WO1 — TC0/WO1G4
    values as EXTINT3R.EXTINT3
0xC0 TC1WO0G1R
  [3:0] TC1WO0 — TC1/WO0G1
    values as EXTINT0R.EXTINT0
0xC4 TC1WO1G2R
  [3:0] TC1WO1 — TC1/WO1G2
    values as EXTINT1R.EXTINT1
0xC8 TC2WO0G1R
  [3:0] TC2WO0 — TC2/WO0G1
    values as EXTINT0R.EXTINT0
0xCC TC2WO0G3R
  [3:0] TC2WO0 — TC2/WO0G3
    values as EXTINT2R.EXTINT2
0xD0 TC2WO1G2R
  [3:0] TC2WO1 — TC2/WO1G2
    values as EXTINT1R.EXTINT1
0xD4 TC2WO1G4R
  [3:0] TC2WO1 — TC2/WO1G4
    values as EXTINT3R.EXTINT3
0xD8 TC3WO0G1R
  [3:0] TC3WO0 — TC3/WO0G1
    values as EXTINT0R.EXTINT0
0xDC TC3WO0G3R
  [3:0] TC3WO0 — TC3/WO0G3
    values as EXTINT2R.EXTINT2
0xE0 TC3WO1G2R
  [3:0] TC3WO1 — TC3/WO1G2
    values as EXTINT1R.EXTINT1
0xE4 TC3WO1G4R
  [3:0] TC3WO1 — TC3/WO1G4
    values as EXTINT3R.EXTINT3
0x218 RPA3G1R
  [4:0] RPA3G1R — RPA3/G1
    0=OFF; 1=SCOM0P3 (SERCOM0/PAD3); 2=SCOM0P2 (SERCOM0/PAD2); 3=SCOM0P1 (SERCOM0/PAD1); 4=SCOM1P0 (SERCOM1/PAD0); 5=SCOM1P2 (SERCOM1/PAD2); 6=SCOM1P1 (SERCOM1/PAD1); 11=TCC0WO0; 12=TCC0WO4; 13=TCC0WO2; 14=TCC1WO0; 15=TCC1WO4; 16=TCC1WO2; 17=TCC2WO0; 18=TC0WO1; 19=REFO1; 20=TC1WO0; 21=TC2WO0; 22=TC3WO0; 23=QSCK; 24=QCS; 25=QD3; 26=QD2; 27=QD1; 28=CCLOUT0; 29=TSTBUS0; 30=TSTBUS4; 31=TSTBUS8
0x21C RPA3G2R
  [4:0] RPA3G2R — RPA3/G2
    0=OFF; 1=SCOM0P0 (SERCOM0/PAD0); 2=SCOM0P3 (SERCOM0/PAD3); 3=SCOM0P2 (SERCOM0/PAD2); 4=SCOM1P1 (SERCOM1/PAD1); 5=SCOM1P3 (SERCOM1/PAD3); 6=SCOM1P2 (SERCOM1/PAD2); 11=TCC0WO1; 12=TCC0WO5; 13=TCC0WO3; 14=TCC1WO1; 15=TCC1WO5; 16=TCC1WO3; 17=TCC2WO1; 18=TC0WO1; 19=REFO2; 20=TC1WO1; 21=TC2WO1; 22=TC3WO1; 23=QSCK; 24=QCS; 25=QD0; 26=QD3; 27=QD2; 28=CCLOUT1; 29=TSTBUS1; 30=TSTBUS5; 31=TSTBUS9
0x220 RPA3G3R
  [4:0] RPA3G3R — RPA3/G3
    0=OFF; 1=SCOM0P1 (SERCOM0/PAD1); 2=SCOM0P0 (SERCOM0/PAD0); 3=SCOM0P3 (SERCOM0/PAD3); 4=SCOM1P2 (SERCOM1/PAD2); 5=SCOM1P0 (SERCOM1/PAD0); 6=SCOM1P3 (SERCOM1/PAD3); 11=TCC0WO2; 12=TCC0WO0; 13=TCC0WO4; 14=TCC1WO2; 15=TCC1WO0; 16=TCC1WO4; 17=TCC2WO0; 18=TC0WO0; 19=REFO3; 20=TC1WO0; 21=TC2WO0; 22=TC3WO0; 23=QSCK; 24=QCS; 25=QD1; 26=QD0; 27=QD3; 28=CCLOUT0; 29=TSTBUS2; 30=TSTBUS6; 31=TSTBUS10
0x224 RPA4G2R
  [4:0] RPA4G2R — RPA4/G2
    values as RPA3G2R.RPA3G2R
0x228 RPA4G3R
  [4:0] RPA4G3R — RPA4/G3
    values as RPA3G3R.RPA3G3R
{0x1FC+0xC*i} RPA{i}G4R (i=4..6)
  [4:0] RPA{i}G4R — RPA{i}/G4
    0=OFF; 1=SCOM0P2 (SERCOM0/PAD2); 2=SCOM0P1 (SERCOM0/PAD1); 3=SCOM0P0 (SERCOM0/PAD0); 4=SCOM1P3 (SERCOM1/PAD3); 5=SCOM1P1 (SERCOM1/PAD1); 6=SCOM1P0 (SERCOM1/PAD0); 11=TCC0WO3; 12=TCC0WO1; 13=TCC0WO5; 14=TCC1WO3; 15=TCC1WO1; 16=TCC1WO5; 17=TCC2WO1; 18=TC0WO0; 19=REFO4; 20=TC1WO1; 21=TC2WO1; 22=TC3WO1; 23=QSCK; 24=QCS; 25=QD2; 26=QD1; 27=QD0; 28=CCLOUT1; 29=TSTBUS3; 30=TSTBUS7; 31=TSTBUS11
{0x1F4+0xC*i} RPA{i}G1R (i=5..7)
  [4:0] RPA{i}G1R — RPA{i}/G1
    values as RPA3G1R.RPA3G1R
0x234 RPA5G3R
  [4:0] RPA5G3R — RPA5/G3
    values as RPA3G3R.RPA3G3R
0x240 RPA6G2R
  [4:0] RPA6G2R — RPA6/G2
    values as RPA3G2R.RPA3G2R
0x24C RPA7G2R
  [4:0] RPA7G2R — RPA7/G2
    values as RPA3G2R.RPA3G2R
0x250 RPA8G2R
  [4:0] RPA8G2R — RPA8/G2
    values as RPA3G2R.RPA3G2R
0x254 RPA8G3R
  [4:0] RPA8G3R — RPA8/G3
    values as RPA3G3R.RPA3G3R
0x258 RPA8G4R
  [4:0] RPA8G4R — RPA8/G4
    values as RPA4G4R.RPA{i}G4R
0x25C RPA9G1R
  [4:0] RPA9G1R — RPA9/G1
    values as RPA3G1R.RPA3G1R
0x260 RPA9G3R
  [4:0] RPA9G3R — RPA9/G3
    values as RPA3G3R.RPA3G3R
0x264 RPA9G4R
  [4:0] RPA9G4R — RPA9/G4
    values as RPA4G4R.RPA{i}G4R
0x268 RPA10G1R
  [4:0] RPA10G1R — RPA10/G1
    values as RPA3G1R.RPA3G1R
0x26C RPA10G4R
  [4:0] RPA10G4R — RPA10/G4
    values as RPA4G4R.RPA{i}G4R
0x2AC RPB4G1R
  [4:0] RPB4G1R — RPB4/G1
    values as RPA3G1R.RPA3G1R
0x2B0 RPB4G2R
  [4:0] RPB4G2R — RPB4G2
    values as RPA3G2R.RPA3G2R
0x2B4 RPB5G2R
  [4:0] RPB5G2R — RPB5/G2
    values as RPA3G2R.RPA3G2R
0x2B8 RPB5G3R
  [4:0] RPB5G3R — RPB5/G3
    values as RPA3G3R.RPA3G3R
0x2BC RPB6G3R
  [4:0] RPB6G3R — RPB6/G3
    values as RPA3G3R.RPA3G3R
0x2C0 RPB6G4R
  [4:0] RPB6G4R — RPB6/G4
    values as RPA4G4R.RPA{i}G4R
0x2C4 RPB7G1R
  [4:0] RPB7G1R — RPB7/G1
    values as RPA3G1R.RPA3G1R
0x2C8 RPB7G4R
  [4:0] RPB7G4R — RPB7/G4
    values as RPA4G4R.RPA{i}G4R
0x2CC RPB8G1R
  [4:0] RPB8G1R — RPB8/G1
    values as RPA3G1R.RPA3G1R
0x2D0 RPB8G2R
  [4:0] RPB8G2R — RPB8/G2
    values as RPA3G2R.RPA3G2R
0x2D4 RPB9G2R
  [4:0] RPB9G2R — RPB9/G2
    values as RPA3G2R.RPA3G2R
0x2D8 RPB9G3R
  [4:0] RPB9G3R — RPB9/G3
    values as RPA3G3R.RPA3G3R
