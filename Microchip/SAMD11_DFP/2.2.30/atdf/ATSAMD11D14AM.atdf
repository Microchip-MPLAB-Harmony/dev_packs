# ATSAMD11D14AM device description
Architecture: CORTEX-M0PLUS; Family: SAMD; Series: SAMD11
Parameters: NUM_IRQ=19 (Number of Interrupt Requests), __CM0PLUS_REV=0x0001 (Cortex-M0+ Core Revision), __MPU_PRESENT=0 (MPU present or not), __NVIC_PRIO_BITS=2 (Number of Bits used for Priority Levels), __VTOR_PRESENT=1 (Vector Table Offset Register present or not), __Vendor_SysTickConfig=0 (Set to 1 if different SysTick Config is used), __ARCH_ARM=1, __ARCH_ARM_CORTEX_M=1, __DEVICE_IS_SAM=1
Programming and debug interfaces: SWD
Registers are 32-bit, read-write, reset 0x0 unless marked. A register's access mark holds for its fields unless they carry their own. Offsets are from the block's base; lines under a group give offsets from that group; [hi:lo] are bit positions; {n}, {i} and the like mark numbered series; 'fields as' and 'values as' point back to an identical list; <NAME> marks a mode.

## Ordering variants
ATSAMD11D14A-MU: QFN24, pinout SAMD1xE, up to 48 MHz, -40 to 85 C, 1.62 to 3.63 V

## Memory
base space: start 0 size 0x100000000, little endian
  0x00000000 FLASH size 0x4000 flash, rw, executable, page 64
  0x00800000 CAL size 0x8 fuses, ro
  0x00802000 LOCKBIT size 0x4 fuses, ro
  0x00806000 OTP1 size 0x8 fuses, ro
  0x00806008 OTP2 size 0x8 fuses, ro
  0x00806020 OTP4 size 0xE0 fuses, rw, page 64
  0x00806030 TEMP_LOG size 0x8 fuses, ro
  0x00804000 USER_PAGE size 0x100 user_page, rw, page 64
  0x20000000 HMCRAMC0 size 0x1000 ram, rw, executable
  0x40000000 HPB0 size 0x10000 io, rw
  0x41000000 HPB1 size 0x10000 io, rw
  0x42000000 HPB2 size 0x10000 io, rw
  0xE0000000 PPB size 0x100000 io, rw
  0xE000E000 SCS size 0x00001000 io, rw
  0x40000000 PERIPHERALS size 0x20000000 io, rw
fuses space: start 0x00000000 size 0x20000000, little endian

## Peripheral instances (address, pins/pin function, parameters)
AC at 0x42002400
  pins: AIN0 PA04/B; AIN1 PA05/B; AIN2 PA06/B; AIN3 PA07/B; CMP0 PA14/G or PA10/G; CMP1 PA15/G or PA11/G
  parameters: CMP_NUM=2 (Number of comparators), GCLK_ID_ANA=21 (Index of Generic Clock for analog), GCLK_ID_DIG=20 (Index of Generic Clock for digital), NUM_CMP=2, PAIRS=1 (Number of pairs of comparators), INSTANCE_ID=73
ADC at 0x42002000
  pins: AIN0 PA02/B; AIN1 PA03/B; AIN2 PA04/B; AIN3 PA05/B; AIN4 PA06/B; AIN5 PA07/B; AIN6 PA14/B; AIN7 PA15/B; AIN8 PA10/B; AIN9 PA11/B; VREFP PA04/B
  parameters: DMAC_ID_RESRDY=18 (Index of DMA RESRDY trigger), EXTCHANNEL_MSB=9 (Number of external channels), GCLK_ID=19 (Index of Generic Clock), RESULT_BITS=16 (Size of RESULT.RESULT bitfield), RESULT_MSB=15 (Size of Result), INSTANCE_ID=72
DAC at 0x42002800
  pins: VOUT PA02/B; VREFP PA03/B
  parameters: DMAC_ID_EMPTY=19 (Index of DMAC EMPTY trigger), GCLK_ID=22 (Index of Generic Clock), INSTANCE_ID=74
DMAC at 0x41004800
  parameters: CH_BITS=3 (Number of bits to select channel), CH_NUM=6 (Number of channels), EVIN_NUM=4 (Number of input events), EVOUT_NUM=4 (Number of output events), LVL_BITS=2 (Number of bit to select level priority), LVL_NUM=4 (Enable priority level number), TRIG_BITS=5 (Number of bits to select trigger source), TRIG_NUM=20 (Number of peripheral triggers), INSTANCE_ID=36
DSU at 0x41002000
  parameters: INSTANCE_ID=33
EIC at 0x40001800
  pins: EXTINT0 PA16/A; EXTINT1 PA15/A or PA17/A; EXTINT2 PA02/A or PA10/A or PA30/A; EXTINT3 PA03/A or PA11/A or PA31/A; EXTINT4 PA04/A or PA24/A; EXTINT5 PA05/A or PA25/A; EXTINT6 PA06/A or PA08/A or PA22/A; EXTINT7 PA07/A or PA09/A or PA23/A or PA27/A; NMI PA14/A
  parameters: CONFIG_NUM=1 (Number of CONFIG registers), EXTINT_NUM=8 (Number of External Interrupts), GCLK_ID=5 (Index of Generic Clock), INSTANCE_ID=6
EVSYS at 0x42000400
  parameters: CHANNELS=6 (Number of Channels), CHANNELS_BITS=3 (Number of bits to select Channel), CHANNELS_MSB=5 (Number of Channels - 1), EXTEVT_NUM=0 (Number of External Event Generators), GCLK_ID_{n}={n+7} (Index of Generic Clock {n}) (n=0..5), GENERATORS=44 (Total Number of Event Generators), GENERATORS_BITS=6 (Number of bits to select Event Generator), USERS=18 (Total Number of Event Users), USERS_BITS=5 (Number of bits to select Event User), INSTANCE_ID=65
GCLK at 0x40000C00
  pins: IO0 PA08/H or PA24/H or PA25/H or PA27/H or PA30/H or PA31/H; IO1 PA09/H or PA22/H; IO2 PA16/H or PA23/H; IO3 PA17/H; IO4 PA14/H or PA10/H; IO5 PA15/H or PA11/H
  parameters: GENDIV_BITS=16, GEN_NUM=6 (Number of Generic Clock Generators), GEN_NUM_MSB=5 (Number of Generic Clock Generators - 1), GEN_SOURCE_NUM_MSB=8 (Number of Generic Clock Sources - 1), NUM=24 (Number of Generic Clock Users), SOURCE_DFLL48M=7, SOURCE_DPLL96M=8, SOURCE_GCLKGEN1=2, SOURCE_GCLKIN=1, SOURCE_NUM=9 (Number of Generic Clock Sources), SOURCE_OSCULP32K=3, SOURCE_OSC8M=6, SOURCE_OSC32K=4, SOURCE_XOSC=0, SOURCE_XOSC32K=5, INSTANCE_ID=3
SBMATRIX at 0x41007000 (HMATRIXB)
  parameters: MASTER_NUM=3, MASTER_CM0PLUS=0, MASTER_DSU=1, MASTER_DMAC=2, SLAVE_NUM=7, SLAVE_FLASH=0, SLAVE_HPB0=1, SLAVE_HPB1=2, SLAVE_HPB2=3, SLAVE_HMCRAMC0=4, SLAVE_HMCRAMC0_ALT0=5, SLAVE_HMCRAMC0_ALT1=6, INSTANCE_ID=39
MTB at 0x41006000
  parameters: INSTANCE_ID=38
NVMCTRL at 0x41004000
  pins: MARGIN VMARGIN
  parameters: FACTORY_WORD_IMPLEMENTED_MASK=0xC0000007FFFFFFFF, PMSB=3, PSZ_BITS=6, ROW_PAGES=4, USER_PAGE_OFFSET=0x00800000, USER_WORD_IMPLEMENTED_MASK=0xC01FFFFFFFFFFFFF, FLASH_SIZE=16384, PAGE_SIZE=64, PAGES=256, PAGES_PR_REGION=16, PSM_0_FRMFW_FWS_1_MAX_FREQ=12000000, PSM_0_FRMLP_FWS_0_MAX_FREQ=18000000, PSM_0_FRMLP_FWS_1_MAX_FREQ=36000000, PSM_0_FRMHS_FWS_0_MAX_FREQ=25000000, PSM_0_FRMHS_FWS_1_MAX_FREQ=50000000, PSM_1_FRMFW_FWS_1_MAX_FREQ=12000000, PSM_1_FRMLP_FWS_0_MAX_FREQ=8000000, PSM_1_FRMLP_FWS_1_MAX_FREQ=12000000, INSTANCE_ID=34
FUSES at OTP4_FUSES 0x00806020 in fuses, TEMP_LOG_FUSES 0x00806030 in fuses, USER_FUSES 0x00804000 in fuses
PAC0 at 0x40000000 (PAC)
  parameters: WPROT_DEFAULT_VAL=0x00000000 (PAC protection mask at reset), INSTANCE_ID=0
PAC1 at 0x41000000 (PAC)
  parameters: WPROT_DEFAULT_VAL=0x00000002 (PAC protection mask at reset), INSTANCE_ID=32
PAC2 at 0x42000000 (PAC)
  parameters: WPROT_DEFAULT_VAL=0x00001000 (PAC protection mask at reset), INSTANCE_ID=64
PM at 0x40000400
  pins: RESET_N PA28/RESET
  parameters: CTRL_MCSEL_DFLL48M=3, CTRL_MCSEL_GCLK=0, CTRL_MCSEL_OSC8M=1, CTRL_MCSEL_XOSC=2, PM_CLK_APB_NUM=2, INSTANCE_ID=1
  clocks: AHB HPB0 bit 0, HPB1 bit 1, HPB2 bit 2, DSU bit 3, NVMCTRL bit 4, DMAC bit 5, USB bit 6
PORT at 0x41004400, PORT_IOBUS 0x60000000
  pins: P{n} PA{n:02} (n=2..11); P14 PA14; P15 PA15; P16 PA16; P17 PA17; P22 PA22; P23 PA23; P24 PA24; P25 PA25; P27 PA27; P28 PA28; P30 PA30; P31 PA31
  parameters: BITS=32 (Number of PORT pins), DRVSTR=1 (DRVSTR supported), GROUPS=1 (Number of 32-bit PORT groups), ODRAIN=0 (ODRAIN supported), SLEWLIM=0 (SLEWLIM supported), INSTANCE_ID=35
PTC at 0x42002C00
  pins: X0 PA14/B; X1 PA15/B; X2 PA10/B; X3 PA11/B; X4 PA16/B; X5 PA17/B; X6 PA22/B; X7 PA23/B; X8 PA24/B; X9 PA25/B; X10 PA27/B; Y0 PA02/B; Y1 PA03/B; Y2 PA04/B; Y3 PA05/B; Y4 PA06/B; Y5 PA07/B; Y6 PA14/B; Y7 PA15/B; Y8 PA10/B; Y9 PA11/B; Y10 PA16/B; Y11 PA17/B; Y12 PA22/B; Y13 PA23/B; Y14 PA24/B; Y15 PA25/B
  parameters: GCLK_ID=23 (Index of Generic Clock), INSTANCE_ID=75
RTC at 0x40001400
  parameters: ALARM_NUM=1 (Number of Alarms), COMP16_NUM=2 (Number of 16-bit Comparators), COMP32_NUM=1 (Number of 32-bit Comparators), GCLK_ID=4 (Index of Generic Clock), NUM_OF_ALARMS=1 (Number of Alarms (obsolete)), NUM_OF_COMP16=2 (Number of 16-bit Comparators (obsolete)), NUM_OF_COMP32=1 (Number of 32-bit Comparators (obsolete)), INSTANCE_ID=5
SERCOM0 at 0x42000800 (SERCOM)
  pins: PAD0 PA04/D or PA14/C or PA06/C; PAD1 PA05/D or PA15/C or PA07/C; PAD2 PA06/D or PA08/D or PA04/C or PA10/C; PAD3 PA07/D or PA09/D or PA05/C or PA11/C
  parameters: DMAC_ID_RX=1 (Index of DMA RX trigger), DMAC_ID_TX=2 (Index of DMA TX trigger), GCLK_ID_CORE=14 (Index of Generic Clock for Core), GCLK_ID_SLOW=13 (Index of Generic Clock for SMbus Timeout), INT_MSB=6, INSTANCE_ID=66
SERCOM1 at 0x42000C00 (SERCOM)
  pins: PAD0 PA22/C or PA30/C; PAD1 PA23/C or PA31/C; PAD2 PA30/D or PA16/C or PA24/C or PA08/C; PAD3 PA31/D or PA17/C or PA25/C or PA09/C
  parameters: DMAC_ID_RX=3 (Index of DMA RX trigger), DMAC_ID_TX=4 (Index of DMA TX trigger), GCLK_ID_CORE=15 (Index of Generic Clock for Core), GCLK_ID_SLOW=13 (Index of Generic Clock for SMbus Timeout), INT_MSB=6, INSTANCE_ID=67
SERCOM2 at 0x42001000 (SERCOM)
  pins: PAD0 PA14/D or PA22/D; PAD1 PA15/D or PA23/D; PAD2 PA10/D or PA16/D or PA24/D; PAD3 PA11/D or PA17/D or PA25/D
  parameters: DMAC_ID_RX=5 (Index of DMA RX trigger), DMAC_ID_TX=6 (Index of DMA TX trigger), GCLK_ID_CORE=16 (Index of Generic Clock for Core), GCLK_ID_SLOW=13 (Index of Generic Clock for SMbus Timeout), INT_MSB=6, INSTANCE_ID=68
SYSCTRL at 0x40000800
  pins: CAPLESS_EXTREF PA04/VREG; CAPLESS_VDDCORE PA02/VREG; ULPVREG_BODDETI PA06/VREG; ULPVREG_BODDETII PA23/VREG; ULPVREG_BODIEN PA03/VREG; ULPVREG_BODIIEN PA05/VREG; ULPVREG_ENABLE PA17/VREG; ULPVREG_FORCELDO PA08/VREG; ULPVREG_INC_BIAS PA11/VREG; ULPVREG_LDOEN PA07/VREG; ULPVREG_OSCEN PA22/VREG; ULPVREG_REFRESH PA10/VREG; ULPVREG_REFSEL PA16/VREG; ULPVREG_REQBIAS PA09/VREG; VREG_ENABLE PA24/VREG; XIN PA08/XIN; XIN32 PA08/XIN32; XOSC_CLK PA15/XOSC; XOSC_EN PA14/XOSC; XOUT32 PA09/XOUT32
  parameters: BGAP_CALIB_MSB=11, BOD12_CALIB_MSB=4, BOD33_CALIB_MSB=5, DFLL48M_COARSE_MSB=5, DFLL48M_FINE_MSB=9, GCLK_ID_DFLL48=0 (Index of Generic Clock for DFLL48), GCLK_ID_FDPLL=1 (Index of Generic Clock for DPLL), GCLK_ID_FDPLL32K=2 (Index of Generic Clock for DPLL 32K), OSC32K_COARSE_CALIB_MSB=6, POR33_ENTEST_MSB=1, SYSTEM_CLOCK=1000000 (Initial system clock frequency), ULPVREF_DIVLEV_MSB=3, ULPVREG_FORCEGAIN_MSB=1, ULPVREG_RAMREFSEL_MSB=2, VREF_CONTROL_MSB=48, VREF_STATUS_MSB=7, VREG_LEVEL_MSB=2, BOD12_VERSION=0x111, BOD33_VERSION=0x111, DFLL48M_VERSION=0x300, FDPLL_VERSION=0x110, OSCULP32K_VERSION=0x111, OSC8M_VERSION=0x120, OSC32K_VERSION=0x110, VREF_VERSION=0x201, VREG_VERSION=0x201, XOSC_VERSION=0x112, XOSC32K_VERSION=0x111, INSTANCE_ID=2
TC1 at 0x42001800 (TC)
  pins: WO0 PA04/E or PA14/E or PA16/E or PA22/E; WO1 PA05/E or PA15/E or PA17/E or PA23/E
  parameters: CC8_NUM=2 (Number of 8-bit Counters), CC16_NUM=2 (Number of 16-bit Counters), CC32_NUM=2 (Number of 32-bit Counters), DITHERING_EXT=0 (Dithering feature implemented), DMAC_ID_OVF=12 (Indexes of DMA Overflow trigger), DMAC_ID_MC0=13 (Indexes of DMA Match/Compare 0 trigger), DMAC_ID_MC1=14 (Indexes of DMA Match/Compare 1 trigger), GCLK_ID=18 (Index of Generic Clock), MASTER=1, OW_NUM=2 (Number of Output Waveforms), PERIOD_EXT=0 (Period feature implemented), SHADOW_EXT=0 (Shadow feature implemented), INSTANCE_ID=70
TC2 at 0x42001C00 (TC)
  pins: WO0 PA06/E or PA10/E or PA30/E; WO1 PA07/E or PA11/E or PA31/E
  parameters: CC8_NUM=2 (Number of 8-bit Counters), CC16_NUM=2 (Number of 16-bit Counters), CC32_NUM=2 (Number of 32-bit Counters), DITHERING_EXT=0 (Dithering feature implemented), DMAC_ID_OVF=15 (Indexes of DMA Overflow trigger), DMAC_ID_MC0=16 (Indexes of DMA Match/Compare 0 trigger), DMAC_ID_MC1=17 (Indexes of DMA Match/Compare 1 trigger), GCLK_ID=18 (Index of Generic Clock), MASTER=0, OW_NUM=2 (Number of Output Waveforms), PERIOD_EXT=0 (Period feature implemented), SHADOW_EXT=0 (Shadow feature implemented), INSTANCE_ID=71
TCC0 at 0x42001400 (TCC)
  pins: WO0 PA04/F or PA14/F; WO1 PA05/F or PA15/F; WO2 PA06/F or PA10/F or PA30/F or PA08/E or PA24/E; WO3 PA07/F or PA11/F or PA31/F or PA09/E or PA25/E; WO4 PA22/F or PA24/F or PA08/F; WO5 PA23/F or PA25/F or PA09/F; WO6 PA16/F; WO7 PA17/F
  parameters: CC_NUM=4 (Number of Compare/Capture units), DITHERING=1 (Dithering feature implemented), DMAC_ID_OVF=7 (DMA overflow/underflow/retrigger trigger), DMAC_ID_MC0=8 (DMA Match/Compare 0 trigger), DMAC_ID_MC1=9 (DMA Match/Compare 1 trigger), DMAC_ID_MC2=10 (DMA Match/Compare 2 trigger), DMAC_ID_MC3=11 (DMA Match/Compare 3 trigger), DTI=1 (Dead-Time-Insertion feature implemented), EXT=31 ((@_DITHERING*16+@_PG*8+@_SWAP*4+@_DTI*2+@_OTMX*1)), GCLK_ID=17 (Index of Generic Clock), MASTER=0, OTMX=1 (Output Matrix feature implemented), OW_NUM=8 (Number of Output Waveforms), PG=1 (Pattern Generation feature implemented), SIZE=24, SWAP=1 (DTI outputs swap feature implemented), INSTANCE_ID=69
USB at 0x41005000
  pins: DM PA24/G; DP PA25/G; SOF_1KHZ PA23/G
  parameters: EPT_NBR=8 (Number of USB end points (obsolete)), EPT_NUM=8 (Number of USB end points), GCLK_ID=6 (Index of Generic Clock), PIPE_NUM=8 (Number of USB pipes), INSTANCE_ID=37
WDT at 0x40001000
  parameters: GCLK_ID=3 (Index of Generic Clock), INSTANCE_ID=4
NVIC at 0xE000E100
  parameters: NUM_IRQ=19 (Number of interrupt requests), __NVIC_PRIO_BITS=2 (Number of NVIC interrupt priority bits)
SysTick at 0xE000E010
SystemControl at 0xE000E000
  parameters: __VTOR_PRESENT=1 (Vector Table Offset Register present)

## Interrupts
-15 Reset — Reset Vector, invoked on Power up and warm reset
-14 NonMaskableInt — Non maskable Interrupt, cannot be stopped or preempted
-13 HardFault — Hard Fault, all classes of Fault
-5 SVCall — System Service Call via SVC instruction
-2 PendSV — Pendable request for system service
-1 SysTick — System Tick Timer
0 PM — Power Manager
1 SYSCTRL — System Controller
2 WDT — Watchdog Timer
3 RTC — Real Time Counter
4 EIC — External Interrupt Controller
5 NVMCTRL — Non-Volatile Memory Controller
6 DMAC — Direct Memory Controller
7 USB — Universal Serial Bus
8 EVSYS — Event Systems
9 SERCOM0 — Serial Communication Interface 0
10 SERCOM1 — Serial Communication Interface 1
11 SERCOM2 — Serial Communication Interface 2
12 TCC0 — Timer/Counter for Control Applications 0
13 TC1 — Timer/Counter 1
14 TC2 — Timer/Counter 2
15 ADC — Analog-to-Digital Converter
16 AC — Analog Comparators
17 DAC — Digital-to-Analog Converter
18 PTC — Peripheral Touch Controller

## Event generators
1 RTC_CMP_0, 2 RTC_CMP_1, 3 RTC_OVF, {n+4} RTC_PER_{n} (n=0..7), {n+12} EIC_EXTINT_{n} (n=0..7), {n+20} DMAC_CH_{n} (n=0..3), 24 TCC0_OVF, 25 TCC0_TRG, 26 TCC0_CNT, {n+27} TCC0_MC_{n} (n=0..3), 31 TC1_OVF, 32 TC1_MC_0, 33 TC1_MC_1, 34 TC2_OVF, 35 TC2_MC_0, 36 TC2_MC_1, 37 ADC_RESRDY, 38 ADC_WINMON, 39 AC_COMP_0, 40 AC_COMP_1, 41 AC_WIN_0, 42 DAC_EMPTY

## Event users
{n} DMAC_CH_{n} (n=0..3), 4 TCC0_EV_0, 5 TCC0_EV_1, {n+6} TCC0_MC_{n} (n=0..3), 10 TC1_EVU, 11 TC2_EVU, 12 ADC_START, 13 ADC_SYNC, 14 AC_SOC_0, 15 AC_SOC_1, 16 DAC_START

## Properties
SIGNATURES: DSU_DID=0x10030100

## Pinouts (pin number, pad)
SAMD1xE: 1 PA02, 2 PA03, 3 PA04, 4 PA05, 5 PA06, 6 PA07, 7 PA08, 8 PA09, 9 PA10, 10 PA11, 11 PA14, 12 PA15, 13 PA16, 14 PA17, 15 PA22, 16 PA23, 17 PA27, 18 PA28, 19 PA30, 20 PA31, 21 PA24, 22 PA25, 23 GNDIO, 24 VDDIO

## Notices in the file
Copyright (c) 2018 Microchip Technology Inc.
SPDX-License-Identifier: Apache-2.0
Licensed under the Apache License, Version 2.0 (the "License");
you may not use this file except in compliance with the License.
You may obtain a copy of the License at
http://www.apache.org/licenses/LICENSE-2.0
Unless required by applicable law or agreed to in writing, software
distributed under the License is distributed on an "AS IS" BASIS,
WITHOUT WARRANTIES OR CONDITIONS OF ANY KIND, either express or implied.
See the License for the specific language governing permissions and
limitations under the License.
