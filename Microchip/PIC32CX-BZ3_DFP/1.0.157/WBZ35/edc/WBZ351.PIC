# WBZ351 register map
Vendor: Microchip
Architecture arm32bit. Special function registers and configuration words.
Registers are 32-bit, read-write, reset 0x0 unless marked. A register's access mark holds for its fields unless they carry their own. Addresses are absolute, and some are shared; only a register's first bit layout is shown; lines under a group give offsets from that group; [hi:lo] are bit positions; {n}, {i} and the like mark numbered series; 'fields as' and 'values as' point back to an identical list; <NAME> marks a mode.

## Further device data
pins=1: GND; 2: GND; 3: NMCLR; 4: PB0/AIN4/CVD4/CVDR4/CVDT4/IOCB0/AIN2/RB0/RPB0/COEXCTRL2; 5: PB3/AIN7/CVD7/CVDR7/CVDT7/IOCB3/AIN1/RB3/RPB3; 6: PB5/AIN1/CVD1/CVDR1/CVDT1/IOCB5/RB5/RPB5/TP5/FECTRL4; 7: AVDD; 8: GND; 9: PA11/IN1/IN4/EXTINT1/IN0/IN3/EXTINT0; 10: PA12/IN2/IN5/EXTINT2/IN1/IN4/EXTINT1; 11: GND; 12: PB6/AIN2/CVD2/CVDR2/CVDT2/IOCB6/RB6/RPB6/FECTRL5; 13: PB7/AIN3/CVD3/CVDR3/CVDT3/IOCB7/RB7/RPB7; 14: PB8/IOCB8/RB8/RPB8/TP2/TP6/PMU_TEST_SCKO; 15: PB9/IOCB9/INT0/PAD2/RB9/RPB9/FEM_PD_EXT_PA/TP3/ADCSVSOUT; 16: PA4/IOCA4/PAD3/RA4/RPA4/OUT/DGI_SSN; 17: PB13/IN2/IN5/EXTINT2/OUT0/OUT0/IN1/IN4/EXTINT1/IOCB13/RB13/RPB13/EVENT/CS; 18: PA1/IOCA1/RA1/RPA1/IN2/SCK; 19: GND; 20: PB11/IN0/IN3/EXTINT0/OUT1/EXTINT3/NMI/IOCB11/RB11/RPB11/DATA2; 21: PA2/IOCA2/RA2/RPA2/IN1/DATA3; 22: PA0/IOCA0/RA0/RPA0/IN3/DATA0; 23: PB12/IN1/IN4/EXTINT1/OUT0/IN0/IN3/EXTINT0/IOCB12/RB12/RPB12/DATA1; 24: PA5/IOCA5/CMP0/CMPTRDY/PAD0/RA5/RPA5; 25: PA6/IOCA6/CMP1/CMPTEN/AC_CMP1_ALT/PAD1/RA6/RPA6/TA4D_ALT; 26: GND; 27: VDD; 28: VDD; 29: PA8/IOCA8/PAD1/RA8/RPA8/FECTRL0/PMU_TEST_SDI/ADCSVTRG; 30: PA9/IOCA9/PAD2/RA9/RPA9/FECTRL1/PMU_TEST_CS/RTC_IN0_ALT/IN0_ALT/ADCSVFRM/DGI_SDO; 31: PA7/IOCA7/PAD0/RA7/RPA7/PMU_TEST_SCK/ADCSVCLKI; 32: PA10/IN0/IN3/EXTINT0/EXTINT3/NMI/OUT1/IOCA10/PAD3/RA10/RPA10/FECTRL2/PMU_TEST_SDO/RTC_OUT_ALT/OUT_ALT/ADCSVSARCLK/DGI_SCK/MBISTCLK; 33: PA13/EXTINT3/NMI/OUT0/OUT1/IN2/IN5/EXTINT2/IOCA13/CMP1/CMPTOUT/I2C_SERCOM_PAD0/RA13/RPA13/COEXCTRL0; 34: PA14/IN0/IN3/EXTINT0/OUT1/EXTINT3/NMI/IOCA14/I2C_SERCOM_PAD1/RA14/RPA14/COEXCTRL1; 35: PB10/EXTINT3/NMI/OUT0/OUT1/IN2/IN5/EXTINT2/IOCB10/RB10/RPB10; 36: PA3/ANN0/IOCA3/DACOUT/RA3/RPA3/IN0; 37: PB2/AIN6/CVD6/CVDR6/CVDT6/IOCB2/AIN0/RB2/RPB2; 38: PB1/AIN5/CVD5/CVDR5/CVDT5/IOCB1/AIN3/RB1/RPB1; 39: PB4/AIN0/CVD0/CVDR0/CVDT0/IOCB4/RB4/RPB4/TP4/FECTRL3, interrupts=-15 Reset — Reset Vector, invoked on Power up and warm reset; -14 NonMaskableInt — Non maskable Interrupt, cannot be stopped or preempted; -13 HardFault — Hard Fault, all classes of Fault; -12 MemoryManagement — Memory Management, MPU mismatch, including Access Violation and No Match; -11 BusFault — Bus Fault, Pre-Fetch-, Memory Access Fault, other address/memory related Fault; -10 UsageFault — Usage Fault, i.e. Undef Instruction, Illegal State Transition; -5 SVCall — System Service Call via SVC instruction; -4 DebugMonitor — Debug Monitor; -2 PendSV — Pendable request for system service; -1 SysTick — System Tick Timer; 0 RTC — Real Time Counter; 1 EIC — External Interrupt Controller; 2 FREQM — Frequency Meter; 3 NVM — Non-Volatile Memory; 4 CHANGE_NOTICE_A — PORT_A_INPUT_CHANGE_INTERRUPT; 5 CHANGE_NOTICE_B — PORT_B_INPUT_CHANGE_INTERRUPT; 6 DMAC_0_3 — DMA Channel 0..3; 7 DMAC_4_15 — DMA Channel 4..15; 8 EVSYS_0_3 — Event System Channel 0..3; 9 EVSYS_4_11 — Event System Channel 4..11; 10 PAC — Peripheral Access Controller; 11 RAMECC — RAM Error Correction Code; 12 SERCOM0 — Serial Communication Interface 0; 13 SERCOM1 — Serial Communication Interface 1; 14 TCC0 — Timer/Counter for Control Applications 0; 15 TCC1 — Timer/Counter for Control Applications 1; 16 TCC2 — Timer/Counter for Control Applications 2; 17 TC0 — Timer/Counter 0; 18 TC1 — Timer/Counter 1; 19 TC2 — Timer/Counter 2; 20 TC3 — Timer/Counter 3; 21 TC4 — Timer/Counter 4; 22 TC5 — Timer/Counter 5; 23 TC6 — Timer/Counter 6; 24 TC7 — Timer/Counter 7; 25 ADCHS_IRQ — Analog-to-Digital Converter; 26 AC — Analog Comparators; 27 SILEX_0 — Crypto 0; 28 SILEX_1 — Crypto 1; 29 QSPI — Quad SPI interface; 30 ZB_INT0 — ZIGBEE; 31 BT_INT0 — Bluetooth 0; 32 BT_INT1 — Bluetooth 1; 33 ARBITER — Radio Arbiter; 34 ADCHS_FAULT — ADC Fault Interrupt; 35 ADCHS_FCC — ADC FCC Interrupt; 36 ADCHS_BGVR_RDY — ADC BGVR Ready; 37 CLKI_WAKEUP_NMI — WSS WAKEUP; 38 CVD — CVD Interrpt; 39 DGI_SPI — DGI_SPI interrupt; 40 SERCOM2 — Serial Communication Interface 2; 42 BT_LC — Bluetooth LC
