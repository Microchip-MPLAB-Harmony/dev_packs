# ATSAME51J20A device description
Architecture: CORTEX-M4; Family: SAME; Series: SAME51
Parameters: GCLK_ID_TRACE=47 (Index of Trace Generic Clock), NUM_IRQ=137 (Number of interrupt request lines), __CM4_REV=0x0001 (Cortex-M4 Core Revision), __DEBUG_LVL=3 (Debug Level), __FPU_PRESENT=1 (FPU present or not), __MPU_PRESENT=1 (MPU present or not), __NVIC_PRIO_BITS=3 (Number of Bits used for Priority Levels), __TRACE_LVL=2 (Trace Level), __VTOR_PRESENT=1 (Vector Table Offset Register present or not), __Vendor_SysTickConfig=0 (Set to 1 if different SysTick Config is used), __ARCH_ARM=1, __ARCH_ARM_CORTEX_M=1, __DEVICE_IS_SAM=1
Programming and debug interfaces: SWD
Registers are 32-bit, read-write, reset 0x0 unless marked. A register's access mark holds for its fields unless they carry their own. Offsets are from the block's base; lines under a group give offsets from that group; [hi:lo] are bit positions; {n}, {i} and the like mark numbered series; 'fields as' and 'values as' point back to an identical list; <NAME> marks a mode.

## Ordering variants
ATSAME51J20A-MU: QFN64, pinout SAMD51J, up to 120 MHz, -40 to 85 C, 1.71 to 3.63 V
ATSAME51J20A-MF, ATSAME51J20A-MZ: QFN64, pinout SAMD51J, up to 100 MHz, -40 to 125 C, 1.71 to 3.63 V
ATSAME51J20A-AU: TQFP64, pinout SAMD51J, up to 120 MHz, -40 to 85 C, 1.71 to 3.63 V
ATSAME51J20A-AF, ATSAME51J20A-AZ: TQFP64, pinout SAMD51J, up to 100 MHz, -40 to 125 C, 1.71 to 3.63 V

## Memory
base space: start 0 size 0x100000000, little endian
  0x00000000 FLASH size 0x100000 flash, rw, executable, page 512
  0x00800080 SW0 size 0x10 fuses, ro
  0x00800100 TEMP_LOG size 0x200 fuses, rw, page 512
  0x00804000 USER_PAGE size 0x200 user_page, rw, page 512
  0x03000000 CMCC size 0x1000000 io, rw
  0x3000000 CMCC_DATARAM size 0x1000 io, rw
  0x3001000 CMCC_TAGRAM size 0x400 io, rw
  0x3002000 CMCC_VALIDRAM size 0x40 io, rw
  0x04000000 QSPI size 0x1000000 other, rw, executable, external
  0x20000000 HSRAM size 0x40000 ram, rw, executable
  0x20000000 HSRAM_ETB size 0x8000 ram, rw, executable
  0x20000000 HSRAM_RET1 size 0x8000 ram, rw, executable
  0x40000000 HPB0 size 0x4400 io, rw
  0x41000000 HPB1 size 0x22000 io, rw
  0x42000000 HPB2 size 0x3C00 io, rw
  0x43000000 HPB3 size 0x3000 io, rw
  0x44000000 SEEPROM size 0x20000 io, rw
  0x45000000 SDHC0 size 0xC00 io, rw
  0x47000000 BKUPRAM size 0x2000 ram, rw, executable
  0xE0000000 PPB size 0x100000 io, rw
  0xE000E000 SCS size 0x00001000 io, rw
fuses space: start 0x00000000 size 0x20000000, little endian

## Peripheral instances (address, pins/pin function, parameters)
AC at 0x42002000
  pins: AIN0 PA04/B; AIN1 PA05/B; AIN2 PA06/B; AIN3 PA07/B; CMP0 PA12/M set 1 or PA18/M set 2; CMP1 PA13/M set 1 or PA19/M set 2
  parameters: COMPCTRL_MUXNEG_OPAMP=7 (OPAMP selection for MUXNEG), GCLK_ID=32 (Index of Generic Clock), IMPLEMENTS_VDBLR=0 (VDoubler implemented ?), NUM_CMP=2 (Number of comparators), PAIRS=1 (Number of pairs of comparators), SPEED_LEVELS=2 (Number of speed values), INSTANCE_ID=72 (Instance index for AC)
ADC0 at 0x43001C00 (ADC)
  pins: AIN0 PA02/B; AIN1 PA03/B; AIN2 PB08/B; AIN3 PB09/B; AIN{n} PA{n:02}/B (n=4..11); AIN12 PB00/B; AIN13 PB01/B; AIN14 PB02/B; AIN15 PB03/B; X0 PA03/B; Y0 PA03/B; X1 PB08/B; Y1 PB08/B; X2 PB09/B; Y2 PB09/B; X3 PA04/B; Y3 PA04/B; X4 PA06/B; Y4 PA06/B; X5 PA07/B; Y5 PA07/B; X6 PA08/B; Y6 PA08/B; X7 PA09/B; Y7 PA09/B; X8 PA10/B; Y8 PA10/B; X9 PA11/B; Y9 PA11/B; X{n} PA{n+6}/B (n=10..17); Y{n} PA{n+6}/B (n=10..17); X18 PA27/B; Y18 PA27/B; X19 PA30/B; Y19 PA30/B; X20 PB02/B; Y20 PB02/B; X21 PB03/B; Y21 PB03/B; X22 PB04/B; Y22 PB04/B; X23 PB05/B; Y23 PB05/B; X24 PB06/B; Y24 PB06/B; X25 PB07/B; Y25 PB07/B; X26 PB12/B; Y26 PB12/B; X27 PB13/B; Y27 PB13/B; X28 PB14/B; Y28 PB14/B; X29 PB15/B; Y29 PB15/B; X30 PB00/B; Y30 PB00/B; X31 PB01/B; Y31 PB01/B; VREFA PA03/B; VREFB PA04/B; VREFC PA06/B
  parameters: BANDGAP=27 (MUXPOS value to select BANDGAP), CTAT=29 (MUXPOS value to select CTAT), DMAC_ID_RESRDY=68 (index of DMA RESRDY trigger), DMAC_ID_SEQ=69 (Index of DMA SEQ trigger), EXTCHANNEL_MSB=15 (Number of external channels), GCLK_ID=40 (index of Generic Clock), MASTER_SLAVE_MODE=1 (ADC Master/Slave Mode), OPAMP2=0 (MUXPOS value to select OPAMP2), OPAMP01=0 (MUXPOS value to select OPAMP01), PTAT=28 (MUXPOS value to select PTAT), TOUCH_IMPLEMENTED=1 (TOUCH implemented or not), TOUCH_LINES_NUM=32 (Number of touch lines), INSTANCE_ID=103 (Instance index for ADC0)
ADC1 at 0x43002000 (ADC)
  pins: AIN0 PB08/B; AIN1 PB09/B; AIN2 PA08/B; AIN3 PA09/B; AIN6 PB04/B; AIN7 PB05/B; AIN8 PB06/B; AIN9 PB07/B
  parameters: BANDGAP=27 (MUXPOS value to select BANDGAP), CTAT=29 (MUXPOS value to select CTAT), DMAC_ID_RESRDY=70 (Index of DMA RESRDY trigger), DMAC_ID_SEQ=71 (Index of DMA SEQ trigger), EXTCHANNEL_MSB=15 (Number of external channels), GCLK_ID=41 (Index of Generic Clock), MASTER_SLAVE_MODE=2 (ADC Master/Slave Mode), OPAMP2=0 (MUXPOS value to select OPAMP2), OPAMP01=0 (MUXPOS value to select OPAMP01), PTAT=28 (MUXPOS value to select PTAT), TOUCH_IMPLEMENTED=0 (TOUCH implemented or not), TOUCH_LINES_NUM=1 (Number of touch lines), INSTANCE_ID=104 (Instance index for ADC1)
AES at 0x42002400
  parameters: DMAC_ID_RD=82 (DMA DATA Read trigger), DMAC_ID_WR=81 (DMA DATA Write trigger), FOUR_BYTE_OPERATION=1 (Byte Operation), GCM=1, KEYLEN=2 (Key Length), INSTANCE_ID=73
CAN0 at 0x42000000 (CAN)
  pins: RX PA23/I or PA25/I; TX PA22/I or PA24/I
  parameters: DMAC_ID_DEBUG=20 (DMA CAN Debug Req), GCLK_ID=27 (Index of Generic Clock), MSG_RAM_ADDR=0x20000000, QOS_RESET_VAL=1 (QOS reset value), INSTANCE_ID=64
CAN1 at 0x42000400 (CAN)
  pins: RX PB13/H or PB15/H; TX PB12/H or PB14/H
  parameters: DMAC_ID_DEBUG=21 (DMA CAN Debug Req), GCLK_ID=28 (Index of Generic Clock), MSG_RAM_ADDR=0x20000000, QOS_RESET_VAL=1 (QOS reset value), INSTANCE_ID=65
CCL at 0x42003800
  pins: IN0 PA04/N or PA16/N or PB22/N; IN1 PA05/N or PA17/N or PB00/N; IN2 PA06/N or PA18/N or PB01/N; IN3 PA08/N or PA30/N; IN4 PA09/N; IN5 PA10/N; IN6 PA22/N or PB06/N; IN7 PA23/N or PB07/N; IN8 PA24/N or PB08/N; IN9 PB14/N; IN10 PB15/N; IN11 PB10/N or PB16/N; OUT0 PA07/N or PA19/N or PB02/N or PB23/N; OUT1 PA11/N or PA31/N or PB11/N; OUT2 PA25/N or PB09/N; OUT3 PB17/N
  parameters: GCLK_ID=33 (GCLK index for CCL), LUT_NUM=4 (Number of LUT in a CCL), SEQ_NUM=2 (Number of SEQ in a CCL), INSTANCE_ID=78 (Instance index for CCL)
CMCC at 0x41006000
  parameters: INSTANCE_ID=35 (Instance index for CMCC)
DAC at 0x43002400
  pins: VOUT0 PA02/B; VOUT1 PA05/B
  parameters: CHANNEL_SIZE=2 (Number of DACs), DATA_SIZE=12 (Number of bits in data), DMAC_ID_EMPTY0=72 (Index of DMA DAC Channel 0 Empty request), DMAC_ID_EMPTY1=73 (Index of DMA DAC Channel 1 Empty request), DMAC_ID_RESRDY0=74 (Index of DMA DAC Channel 0 Result Ready request), DMAC_ID_RESRDY1=75 (Index of DMA DAC Channel 1 Result Ready request), GCLK_ID=42 (Index of Generic Clock), STEP=7 (Number of steps to reach full scale), INSTANCE_ID=105 (Instance index for DAC)
DMAC at 0x4100A000
  parameters: BURST=1 (0: no burst support; 1: burst support), CH_BITS=5 (Number of bits to select channel), CH_NUM=32 (Number of channels), EVIN_NUM=8 (Number of input events), EVOUT_NUM=4 (Number of output events), FIFO_SIZE=16 (FIFO size for burst mode.), LVL_BITS=2 (Number of bits to select level priority), LVL_NUM=4 (Enable priority level number), QOSCTRL_D_RESETVALUE=2 (QOS dmac ahb interface reset value), QOSCTRL_F_RESETVALUE=2 (QOS dmac fetch interface reset value), QOSCTRL_WRB_RESETVALUE=2 (QOS dmac write back interface reset value), TRIG_BITS=7 (Number of bits to select trigger source), TRIG_NUM=85 (Number of peripheral triggers), CHANNEL{n}_INT_SRC={n+31} (DMA Channel {n} Interrupt) (n=0..4), CHANNEL{n}_INT_SRC=35 (DMA Channel {n} Interrupt) (n=5..31), INSTANCE_ID=37 (Instance index for DMAC)
DSU at 0x41002000
  parameters: DMAC_ID_DCC0=2 (DMAC ID for DCC0 register), DMAC_ID_DCC1=3 (DMAC ID for DCC1 register), INSTANCE_ID=33 (Instance index for DSU)
EIC at 0x40002800
  pins: EXTINT0 PA00/A or PA16/A or PB00/A or PB16/A; EXTINT1 PA01/A or PA17/A or PB01/A or PB17/A; EXTINT2 PA02/A or PA18/A or PB02/A; EXTINT3 PA03/A or PA19/A or PB03/A; EXTINT4 PA04/A or PA20/A or PB04/A; EXTINT5 PA05/A or PA21/A or PB05/A; EXTINT6 PA06/A or PA22/A or PB06/A or PB22/A; EXTINT7 PA07/A or PA23/A or PB07/A or PB23/A; EXTINT8 PA24/A or PB08/A; EXTINT9 PA09/A or PA25/A or PB09/A; EXTINT10 PA10/A or PB10/A; EXTINT11 PA11/A or PA27/A or PB11/A; EXTINT12 PA12/A or PB12/A; EXTINT13 PA13/A or PB13/A; EXTINT14 PA30/A or PB14/A or PB30/A or PA14/A; EXTINT15 PA15/A or PA31/A or PB15/A or PB31/A; NMI PA08/A
  parameters: EXTINT_NUM=16 (Number of external interrupts), GCLK_ID=4 (Generic Clock index), NUMBER_OF_CONFIG_REGS=2 (Number of CONFIG registers), NUMBER_OF_DPRESCALER_REGS=2 (Number of DPRESCALER pin groups), NUMBER_OF_INTERRUPTS=16 (Number of external interrupts (obsolete)), INSTANCE_ID=10 (Instance index for EIC)
EVSYS at 0x4100E000
  parameters: ASYNCHRONOUS_CHANNELS=0xFFFFF000 (Mask of Only Asynchronous Channels), CHANNELS=32 (Total Number of Channels), CHANNELS_BITS=5 (Number of bits to select Channel), EXTEVT_NUM=0 (Number of External Event Generators), GCLK_ID_{n}={n+11} (Index of Generic Clock {n}) (n=0..11), GENERATORS=119 (Total Number of Event Generators), GENERATORS_BITS=7 (Number of bits to select Event Generator), SYNCH_NUM=12 (Number of Synchronous Channels), SYNCH_NUM_BITS=4 (Number of bits to select Synchronous Channels), USERS=67 (Total Number of Event Users), USERS_BITS=7 (Number of bits to select Event User), INSTANCE_ID=39 (Instance index for EVSYS)
FREQM at 0x40002C00
  parameters: GCLK_ID_MSR=5 (Index of measure generic clock), GCLK_ID_REF=6 (Index of reference generic clock), INSTANCE_ID=11 (Instance index for FREQM)
GCLK at 0x40001C00
  pins: IO0 PA30/M or PB14/M or PA14/M or PB22/M; IO1 PB15/M or PA15/M or PB23/M or PA27/M; IO2 PA16/M or PB16/M; IO3 PA17/M or PB17/M; IO4 PA10/M or PB10/M; IO5 PA11/M or PB11/M; IO6 PB12/M; IO7 PB13/M
  parameters: GENCTRL0_RESETVALUE=106 (Default specific reset value for generator 0), GENDIV_BITS=16, GEN_BITS=4, GEN_NUM=12 (Number of Generic Clock Generators), GEN_NUM_MSB=11 (Number of Generic Clock Generators - 1), GEN_SOURCE_NUM_MSB=8 (Number of Generic Clock Sources - 1), IO_NUM=8 (Number of Generic Clock I/Os), NUM=48 (Number of Generic Clock Users), SOURCE_BITS=4, SOURCE_NUM=9 (Number of Generic Clock Sources), INSTANCE_ID=7 (Instance index for GCLK)
HMATRIX at 0x4100C000 (HMATRIXB)
  parameters: MASTER_NUM=8, MASTER_CM4_S=0, MASTER_CMCC=1, MASTER_PICOP_MEM=2, MASTER_PICOP_IO=3, MASTER_DMAC_DTWR=4, MASTER_DMAC_DTRD=5, MASTER_ICM=6, MASTER_DSU=7, SLAVE_NUM=14, SLAVE_FLASH=0, SLAVE_FLASH_ALT=1, SLAVE_SEEPROM=2, SLAVE_RAMCM4S=3, SLAVE_RAMPPPDSU=4, SLAVE_RAMDMAWR=5, SLAVE_RAMDMACICM=6, SLAVE_HPB0=7, SLAVE_HPB1=8, SLAVE_HPB2=9, SLAVE_HPB3=10, SLAVE_SDHC0=12, SLAVE_QSPI=14, SLAVE_BKUPRAM=15, INSTANCE_ID=38
ICM at 0x42002C00
  parameters: INSTANCE_ID=75
I2S at 0x43002800
  pins: FS0 PA09/J set 1 or PA20/J set 2; FS1 PA23/J set 2 or PB11/J set 1; MCK0 PA08/J set 1 or PB17/J set 2; MCK1 PB13/J set 1; SCK0 PA10/J set 1 or PB16/J set 2; SCK1 PB12/J set 1; SDI PA22/J set 2 or PB10/J set 1; SDO PA11/J set 1 or PA21/J set 2
  parameters: CLK_NUM=2 (Number of clock units), GCLK_ID_0=43 (Index of Generic Clock 0), GCLK_ID_1=44 (Index of Generic Clock 1), DMAC_ID_RX_0=76 (Index of DMA RX Trigger 0), DMAC_ID_RX_1=77 (Index of DMA RX Trigger 1), DMAC_ID_TX_0=78 (Index of DMA TX Trigger 0), DMAC_ID_TX_1=79 (Index of DMA TX Trigger 1), MAX_SLOTS=8 (Max number of data slots in frame), MAX_WL_BITS=32 (Max number of bits in data samples), SER_NUM=2 (Number of serializers), INSTANCE_ID=106 (Instance index for I2S)
MCLK at 0x40000800
  parameters: SYSTEM_CLOCK=48000000 (System Clock Frequency at Reset), INSTANCE_ID=2 (Instance index for MCLK)
  clocks: AHB HPB0 bit 0, HPB1 bit 1, HPB2 bit 2, HPB3 bit 3, DSU bit 4, HMATRIX bit 5, NVMCTRL bit 6, HSRAM bit 7, CMCC bit 8, DMAC bit 9, USB bit 10, BKUPRAM bit 11, PAC bit 12, QSPI bit 13, SDHC0 bit 15, CAN0 bit 17, CAN1 bit 18, ICM bit 19, PUKCC bit 20, QSPI_2X bit 21, NVMCTRL_SMEEPROM bit 22, NVMCTRL_CACHE bit 23
NVMCTRL at 0x41004000
  parameters: BLOCK_SIZE=8192 (Size Of Block (Bytes, Smallest Granularity for Erase Operation)), FLASH_SIZE=1048576, PAGES=2048, PAGES_PR_REGION=128, PSM_0_FRMFW_FWS_1_MAX_FREQ=12000000, PSM_0_FRMLP_FWS_0_MAX_FREQ=18000000, PSM_0_FRMLP_FWS_1_MAX_FREQ=36000000, PSM_0_FRMHS_FWS_0_MAX_FREQ=25000000, PSM_0_FRMHS_FWS_1_MAX_FREQ=50000000, PSM_1_FRMFW_FWS_1_MAX_FREQ=12000000, PSM_1_FRMLP_FWS_0_MAX_FREQ=8000000, PSM_1_FRMLP_FWS_1_MAX_FREQ=12000000, INSTANCE_ID=34 (Instance index for NVMCTRL)
FUSES at SW0_FUSES 0x00800080 in fuses, TEMP_LOG_FUSES 0x00800100 in fuses, USER_FUSES 0x00804000 in fuses
OSCCTRL at 0x40001000
  pins: XIN0 PA14/XIN0; XIN1 PB22/XIN1; XOUT0 PA15/XOUT0; XOUT1 PB23/XOUT1
  parameters: DFLLS_NUM=1 (Number of DFLLs), DFLL_IMPLEMENTED=1, DFLL48M_BIASTESTPT_IMPLEMENTED=0 (DFLL48M bias test mode implemented), DFLL48M_CDACSTEPSIZE_SIZE=2 (Size COARSE DAC STEP), DFLL48M_COARSE_RESET_VALUE=32 (DFLL48M Frequency Coarse Reset Value (Before Calibration)), DFLL48M_COARSE_SIZE=6 (Size COARSE CALIBRATION), DFLL48M_ENABLE_RESET_VALUE=1 (Run oscillator at reset), DFLL48M_FDACSTEPSIZE_SIZE=2 (Size FINE DAC STEP), DFLL48M_FINE_RESET_VALUE=128 (DFLL48M Frequency Fine Reset Value (Before Calibration)), DFLL48M_FINE_SIZE=8 (Size FINE CALIBRATION), DFLL48M_ONDEMAND_RESET_VALUE=1 (Run oscillator always or only when requested), DFLL48M_RUNSTDBY_RESET_VALUE=0 (Run oscillator even if standby mode), DFLL48M_TCAL_SIZE=4 (Size TEMP CALIBRATION), DFLL48M_TCBIAS_SIZE=2 (Size TC BIAS CALIBRATION), DFLL48M_TESTPTSEL_SIZE=3 (Size TEST POINT SELECTOR), DFLL48M_WAITLOCK_ACTIVE=1 (Enable Wait Lock Feature), DPLLS_NUM=2 (Number of DPLLs), DPLL0_IMPLEMENTED=1, DPLL0_I12ND_I12NDFRAC_PAD_CONTROL=0 (NOT_IMPLEMENTED: The ND and NDFRAC pad tests are not used, use registers instead), DPLL0_OCC_IMPLEMENTED=1, DPLL1_IMPLEMENTED=1, DPLL1_I12ND_I12NDFRAC_PAD_CONTROL=0 (NOT_IMPLEMENTED: The ND and NDFRAC pad tests are not used, use registers instead), DPLL1_OCC_IMPLEMENTED=0, GCLK_ID_DFLL48=0 (Index of Generic Clock for DFLL48), GCLK_ID_FDPLL0=1 (Index of Generic Clock for DPLL0), GCLK_ID_FDPLL1=2 (Index of Generic Clock for DPLL1), GCLK_ID_FDPLL032K=3 (Index of Generic Clock for DPLL0 32K), GCLK_ID_FDPLL132K=3 (Index of Generic Clock for DPLL1 32K), OSC16M_IMPLEMENTED=0, OSC48M_IMPLEMENTED=0, OSC48M_NUM=1, RCOSCS_NUM=1 (Number of RCOSCs (min 1)), XOSCS_NUM=2 (Number of XOSCs), XOSC0_CFD_CLK_SELECT_SIZE=4 (Clock fail prescaler size), XOSC0_CFD_IMPLEMENTED=1 (Clock fail detected for xosc implemented), XOSC0_IMPLEMENTED=1, XOSC0_ONDEMAND_RESET_VALUE=1 (Run oscillator always or only when requested), XOSC0_RUNSTDBY_RESET_VALUE=0 (Run oscillator even if standby mode), XOSC1_CFD_CLK_SELECT_SIZE=4 (Clock fail prescaler size), XOSC1_CFD_IMPLEMENTED=1 (Clock fail detected for xosc implemented), XOSC1_IMPLEMENTED=1, XOSC1_ONDEMAND_RESET_VALUE=1 (Run oscillator always or only when requested), XOSC1_RUNSTDBY_RESET_VALUE=0 (Run oscillator even if standby mode), DFLL48M_VERSION=0x100, FDPLL_VERSION=0x100, XOSC_VERSION=0x100, INSTANCE_ID=4 (Instance index for OSCCTRL)
OSC32KCTRL at 0x40001400
  pins: XIN32 PA00/XIN32; XOUT32 PA01/XOUT32
  parameters: OSC32K_COARSE_CALIB_MSB=0 (OSC32K coarse calibration size), INSTANCE_ID=5 (Instance index for OSC32KCTRL)
PAC at 0x40000000
  parameters: HPB_NUM=4 (Number of bridges AHB/APB), INSTANCE_ID=0 (Instance index for PAC)
PCC at 0x43002C00
  pins: CLK PA14/K; DATA{n} PA{n+16}/K (n=0..7); DATA8 PB14/K; DATA9 PB15/K; DEN1 PA12/K; DEN2 PA13/K
  parameters: DATA_SIZE=14, DMAC_ID_RX=80, INSTANCE_ID=107 (Instance index for PCC)
PDEC at 0x42001C00
  pins: QDI0 PB23/G set 4 or PA24/G set 3; QDI1 PA25/G set 3; QDI2 PB22/G set 3
  parameters: CC_NUM=2 (Number of Compare Channels units), GCLK_ID=31, INSTANCE_ID=71 (Instance index for PDEC)
PM at 0x40000400
  pins: RESET_N RESET_N
  parameters: PD_NUM=0 (Number of switchable Power Domains), INSTANCE_ID=1 (Instance index for PM)
PORT at 0x41008000
  pins: P{n} PA{n:02} (n=0..25); P27 PA27; P30 PA30; P31 PA31; P{n} PB{n-32:02} (n=32..49); P54 PB22; P55 PB23; P62 PB30; P63 PB31
  parameters: BITS=118, DRVSTR=1 (DRVSTR supported), EV_NUM=4, GROUPS=2, ODRAIN=0 (ODRAIN supported), SLEWLIM=0 (SLEWLIM supported), INSTANCE_ID=36 (Instance index for PORT)
PUKCC
  parameters: RAM_ADDR_SIZE=12, ROM_ADDR_SIZE=16, INSTANCE_ID=76 (Instance index for PUKCC)
QSPI at 0x42003400
  pins: CS PB11/H; DATA0 PA08/H; DATA1 PA09/H; DATA2 PA10/H; DATA3 PA11/H; SCK PB10/H
  parameters: DMAC_ID_RX=83, DMAC_ID_TX=84, HADDR_MSB=23, OCMS=1, INSTANCE_ID=77 (Instance index for QSPI)
RAMECC at 0x41020000
  parameters: RAMADDR_BITS=13 (Number of RAM address bits), RAMBANK_NUM=4 (Number of RAM banks), INSTANCE_ID=48 (Instance index for RAMECC)
RSTC at 0x40000C00
  parameters: BACKUP_IMPLEMENTED=1, HIB_IMPLEMENTED=1, NUMBER_OF_EXTWAKE=0 (number of external wakeup line), NVMRST_IMPLEMENTED=1, INSTANCE_ID=3 (Instance index for RSTC)
RTC at 0x40002400
  pins: IN0 PB00; IN1 PB02; IN2 PA02; OUT PB01
  parameters: DMAC_ID_TIMESTAMP=1 (DMA RTC timestamp trigger), GPR_NUM=4 (Number of General-Purpose Registers), NUM_OF_ALARMS=2 (Number of Alarms), NUM_OF_BKREGS=8 (Number of Backup Registers), NUM_OF_COMP16=4 (Number of 16-bit Comparators), NUM_OF_COMP32=2 (Number of 32-bit Comparators), NUM_OF_TAMPERS=5 (Number of Tamper Inputs), PER_NUM=8 (Number of Periodic Intervals), INSTANCE_ID=9 (Instance index for RTC)
SDHC0 at 0x45000000 (SDHC)
  pins: SDCD PA06/I or PA12/I or PB12/I; SDCK PB11/I; SDCMD PA08/I; SDDAT0 PA09/I; SDDAT1 PA10/I; SDDAT2 PA11/I; SDDAT3 PB10/I; SDWP PA07/I or PA13/I or PB13/I
  parameters: CARD_DATA_SIZE=4, GCLK_ID=45, GCLK_ID_SLOW=3, NB_OF_DEVICES=1, NB_REG_PVR=8, NB_REG_RR=4
SERCOM0 at 0x40003000 (SERCOM)
  pins: PAD0 PA04/D set 3 or PA08/C set 1; PAD1 PA05/D set 3 or PA09/C set 1; PAD2 PA06/D set 3 or PA10/C set 1; PAD3 PA07/D set 3 or PA11/C set 1
  parameters: CLK_REDUCTION=1 (Reduce clock options to pin 1 for SPI and USART), DLY_COMPENSATION=1 (Compensates for a fast DLY50 element. Assuming 20ns), DMA=1 (DMA support implemented?), DMAC_ID_RX=4 (Index of DMA RX trigger), DMAC_ID_TX=5 (Index of DMA TX trigger), FIFO_DEPTH_POWER=1 (2^FIFO_DEPTH_POWER gives rx FIFO depth.), GCLK_ID_CORE=7, GCLK_ID_SLOW=3, INT_MSB=6, PMSB=3, RETENTION_SUPPORT=0 (Retention supported?), SE_CNT=1 (SE counter included?), SPI=1 (SPI mode implemented?), SPI_HW_SS_CTRL=1 (Master _SS hardware control implemented?), SPI_ICSPACE_EXT=1 (SPI inter character space implemented?), SPI_OZMO=0 (OZMO features implemented?), SPI_WAKE_ON_SSL=1 (_SS low detect implemented?), SPI_TX_READY_INT_SRC=46 (SPI TX READY Interrupt), SPI_TX_COMPLETE_INT_SRC=47 (SPI TX COMPLETE Interrupt), SPI_RX_INT_SRC=48 (SPI RX Interrupt), SPI_ERROR_INT_SRC=49 (SPI ERROR Interrupt), TTBIT_EXTENSION=1 (32-bit extension implemented?), I2CM=1 (I2C Master mode implemented?), I2CS=1 (I2C Slave mode implemented?), I2CS_AUTO_ACK=1 (I2C slave automatic acknowledge implemented?), I2CS_GROUP_CMD=1 (I2C slave group command implemented?), I2CS_SDASETUP_CNT_SIZE=8 (I2CS sda setup count size), I2CS_SDASETUP_SIZE=4, I2CS_SUDAT=1 (I2C slave SDA setup implemented?), I2C_FASTMP=1 (I2C fast mode plus implemented?), I2C_HSMODE=1 (USART mode implemented?), I2C_SCLSM_MODE=1 (I2C SCL clock stretch mode implemented?), I2C_SMB_TIMEOUTS=1 (I2C SMBus timeouts implemented?), I2C_TENBIT_ADR=1 (I2C ten bit enabled?), I2C_0_INT_SRC=46 (I2C 0 Interrupt), I2C_1_INT_SRC=47 (I2C 1 Interrupt), I2C_2_INT_SRC=48 (I2C 2 Interrupt), I2C_3_INT_SRC=49 (I2C 3 Interrupt), USART=1 (USART mode implemented?), USART_AUTOBAUD=1 (USART autobaud implemented?), USART_COLDET=1 (USART collision detection implemented?), USART_FLOW_CTRL=1 (USART flow control implemented?), USART_FRAC_BAUD=1 (USART fractional BAUD implemented?), USART_IRDA=1 (USART IrDA implemented?), USART_ISO7816=1 (USART ISO7816 mode implemented?), USART_LIN_MASTER=1 (USART LIN Master mode implemented?), USART_RS485=1 (USART RS485 mode implemented?), USART_SAMPA_EXT=1 (USART sample adjust implemented?), USART_SAMPR_EXT=1 (USART oversampling adjustment implemented?), USART_TX_READY_INT_SRC=46 (USART TX READY Interrupt), USART_TX_COMPLETE_INT_SRC=47 (USART TX COMPLETE Interrupt), USART_RX_INT_SRC=48 (USART RX Interrupt), USART_ERROR_INT_SRC=49 (USART ERROR Interrupt), INSTANCE_ID=12 (Instance index for SERCOM0)
SERCOM1 at 0x40003400 (SERCOM)
  pins: PAD0 PA00/D set 4 or PA16/C set 1; PAD1 PA01/D set 4 or PA17/C set 1; PAD2 PA30/D set 4 or PA18/C set 1 or PB22/C set 3; PAD3 PA31/D set 4 or PA19/C set 1 or PB23/C set 3
  parameters: CLK_REDUCTION=1 (Reduce clock options to pin 1 for SPI and USART), DLY_COMPENSATION=1 (Compensates for a fast DLY50 element. Assuming 20ns), DMA=1 (DMA support implemented?), DMAC_ID_RX=6 (Index of DMA RX trigger), DMAC_ID_TX=7 (Index of DMA TX trigger), FIFO_DEPTH_POWER=1 (2^FIFO_DEPTH_POWER gives rx FIFO depth.), GCLK_ID_CORE=8, GCLK_ID_SLOW=3, INT_MSB=6, PMSB=3, RETENTION_SUPPORT=0 (Retention supported?), SE_CNT=1 (SE counter included?), SPI=1 (SPI mode implemented?), SPI_HW_SS_CTRL=1 (Master _SS hardware control implemented?), SPI_ICSPACE_EXT=1 (SPI inter character space implemented?), SPI_OZMO=0 (OZMO features implemented?), SPI_WAKE_ON_SSL=1 (_SS low detect implemented?), SPI_TX_READY_INT_SRC=50 (SPI TX READY Interrupt), SPI_TX_COMPLETE_INT_SRC=51 (SPI TX COMPLETE Interrupt), SPI_RX_INT_SRC=52 (SPI RX Interrupt), SPI_ERROR_INT_SRC=53 (SPI ERROR Interrupt), TTBIT_EXTENSION=1 (32-bit extension implemented?), I2CM=1 (I2C Master mode implemented?), I2CS=1 (I2C Slave mode implemented?), I2CS_AUTO_ACK=1 (I2C slave automatic acknowledge implemented?), I2CS_GROUP_CMD=1 (I2C slave group command implemented?), I2CS_SDASETUP_CNT_SIZE=8 (I2CS sda setup count size), I2CS_SDASETUP_SIZE=4, I2CS_SUDAT=1 (I2C slave SDA setup implemented?), I2C_FASTMP=1 (I2C fast mode plus implemented?), I2C_HSMODE=1 (USART mode implemented?), I2C_SCLSM_MODE=1 (I2C SCL clock stretch mode implemented?), I2C_SMB_TIMEOUTS=1 (I2C SMBus timeouts implemented?), I2C_TENBIT_ADR=1 (I2C ten bit enabled?), I2C_0_INT_SRC=50 (I2C 0 Interrupt), I2C_1_INT_SRC=51 (I2C 1 Interrupt), I2C_2_INT_SRC=52 (I2C 2 Interrupt), I2C_3_INT_SRC=53 (I2C 3 Interrupt), USART=1 (USART mode implemented?), USART_AUTOBAUD=1 (USART autobaud implemented?), USART_COLDET=1 (USART collision detection implemented?), USART_FLOW_CTRL=1 (USART flow control implemented?), USART_FRAC_BAUD=1 (USART fractional BAUD implemented?), USART_IRDA=1 (USART IrDA implemented?), USART_ISO7816=1 (USART ISO7816 mode implemented?), USART_LIN_MASTER=1 (USART LIN Master mode implemented?), USART_RS485=1 (USART RS485 mode implemented?), USART_SAMPA_EXT=1 (USART sample adjust implemented?), USART_SAMPR_EXT=1 (USART oversampling adjustment implemented?), USART_TX_READY_INT_SRC=50 (USART TX READY Interrupt), USART_TX_COMPLETE_INT_SRC=51 (USART TX COMPLETE Interrupt), USART_RX_INT_SRC=52 (USART RX Interrupt), USART_ERROR_INT_SRC=53 (USART ERROR Interrupt), INSTANCE_ID=13 (Instance index for SERCOM1)
SERCOM2 at 0x41012000 (SERCOM)
  pins: PAD0 PA09/D set 3 or PA12/C set 1; PAD1 PA08/D set 3 or PA13/C set 1; PAD2 PA10/D set 3 or PA14/C set 1; PAD3 PA11/D set 3 or PA15/C set 1
  parameters: CLK_REDUCTION=1 (Reduce clock options to pin 1 for SPI and USART), DLY_COMPENSATION=1 (Compensates for a fast DLY50 element. Assuming 20ns), DMA=1 (DMA support implemented?), DMAC_ID_RX=8 (Index of DMA RX trigger), DMAC_ID_TX=9 (Index of DMA TX trigger), FIFO_DEPTH_POWER=1 (2^FIFO_DEPTH_POWER gives rx FIFO depth.), GCLK_ID_CORE=23, GCLK_ID_SLOW=3, INT_MSB=6, PMSB=3, RETENTION_SUPPORT=0 (Retention supported?), SE_CNT=1 (SE counter included?), SPI=1 (SPI mode implemented?), SPI_HW_SS_CTRL=1 (Master _SS hardware control implemented?), SPI_ICSPACE_EXT=1 (SPI inter character space implemented?), SPI_OZMO=0 (OZMO features implemented?), SPI_WAKE_ON_SSL=1 (_SS low detect implemented?), SPI_TX_READY_INT_SRC=54 (SPI TX READY Interrupt), SPI_TX_COMPLETE_INT_SRC=55 (SPI TX COMPLETE Interrupt), SPI_RX_INT_SRC=56 (SPI RX Interrupt), SPI_ERROR_INT_SRC=57 (SPI ERROR Interrupt), TTBIT_EXTENSION=1 (32-bit extension implemented?), I2CM=1 (I2C Master mode implemented?), I2CS=1 (I2C Slave mode implemented?), I2CS_AUTO_ACK=1 (I2C slave automatic acknowledge implemented?), I2CS_GROUP_CMD=1 (I2C slave group command implemented?), I2CS_SDASETUP_CNT_SIZE=8 (I2CS sda setup count size), I2CS_SDASETUP_SIZE=4, I2CS_SUDAT=1 (I2C slave SDA setup implemented?), I2C_FASTMP=1 (I2C fast mode plus implemented?), I2C_HSMODE=1 (USART mode implemented?), I2C_SCLSM_MODE=1 (I2C SCL clock stretch mode implemented?), I2C_SMB_TIMEOUTS=1 (I2C SMBus timeouts implemented?), I2C_TENBIT_ADR=1 (I2C ten bit enabled?), I2C_0_INT_SRC=54 (I2C 0 Interrupt), I2C_1_INT_SRC=55 (I2C 1 Interrupt), I2C_2_INT_SRC=56 (I2C 2 Interrupt), I2C_3_INT_SRC=57 (I2C 3 Interrupt), USART=1 (USART mode implemented?), USART_AUTOBAUD=1 (USART autobaud implemented?), USART_COLDET=1 (USART collision detection implemented?), USART_FLOW_CTRL=1 (USART flow control implemented?), USART_FRAC_BAUD=1 (USART fractional BAUD implemented?), USART_IRDA=1 (USART IrDA implemented?), USART_ISO7816=1 (USART ISO7816 mode implemented?), USART_LIN_MASTER=1 (USART LIN Master mode implemented?), USART_RS485=1 (USART RS485 mode implemented?), USART_SAMPA_EXT=1 (USART sample adjust implemented?), USART_SAMPR_EXT=1 (USART oversampling adjustment implemented?), USART_TX_READY_INT_SRC=54 (USART TX READY Interrupt), USART_TX_COMPLETE_INT_SRC=55 (USART TX COMPLETE Interrupt), USART_RX_INT_SRC=56 (USART RX Interrupt), USART_ERROR_INT_SRC=57 (USART ERROR Interrupt), INSTANCE_ID=41 (Instance index for SERCOM2)
SERCOM3 at 0x41014000 (SERCOM)
  pins: PAD0 PA17/D set 3 or PA22/C set 1; PAD1 PA16/D set 3 or PA23/C set 1; PAD2 PA18/D set 3 or PA20/D set 2 or PA24/C set 1; PAD3 PA19/D set 3 or PA21/D set 2 or PA25/C set 1
  parameters: CLK_REDUCTION=1 (Reduce clock options to pin 1 for SPI and USART), DLY_COMPENSATION=1 (Compensates for a fast DLY50 element. Assuming 20ns), DMA=1 (DMA support implemented?), DMAC_ID_RX=10 (Index of DMA RX trigger), DMAC_ID_TX=11 (Index of DMA TX trigger), FIFO_DEPTH_POWER=1 (2^FIFO_DEPTH_POWER gives rx FIFO depth.), GCLK_ID_CORE=24, GCLK_ID_SLOW=3, INT_MSB=6, PMSB=3, RETENTION_SUPPORT=0 (Retention supported?), SE_CNT=1 (SE counter included?), SPI=1 (SPI mode implemented?), SPI_HW_SS_CTRL=1 (Master _SS hardware control implemented?), SPI_ICSPACE_EXT=1 (SPI inter character space implemented?), SPI_OZMO=0 (OZMO features implemented?), SPI_WAKE_ON_SSL=1 (_SS low detect implemented?), SPI_TX_READY_INT_SRC=58 (SPI TX READY Interrupt), SPI_TX_COMPLETE_INT_SRC=59 (SPI TX COMPLETE Interrupt), SPI_RX_INT_SRC=60 (SPI RX Interrupt), SPI_ERROR_INT_SRC=61 (SPI ERROR Interrupt), TTBIT_EXTENSION=1 (32-bit extension implemented?), I2CM=1 (I2C Master mode implemented?), I2CS=1 (I2C Slave mode implemented?), I2CS_AUTO_ACK=1 (I2C slave automatic acknowledge implemented?), I2CS_GROUP_CMD=1 (I2C slave group command implemented?), I2CS_SDASETUP_CNT_SIZE=8 (I2CS sda setup count size), I2CS_SDASETUP_SIZE=4, I2CS_SUDAT=1 (I2C slave SDA setup implemented?), I2C_FASTMP=1 (I2C fast mode plus implemented?), I2C_HSMODE=1 (USART mode implemented?), I2C_SCLSM_MODE=1 (I2C SCL clock stretch mode implemented?), I2C_SMB_TIMEOUTS=1 (I2C SMBus timeouts implemented?), I2C_TENBIT_ADR=1 (I2C ten bit enabled?), I2C_0_INT_SRC=58 (I2C 0 Interrupt), I2C_1_INT_SRC=59 (I2C 1 Interrupt), I2C_2_INT_SRC=60 (I2C 2 Interrupt), I2C_3_INT_SRC=61 (I2C 3 Interrupt), USART=1 (USART mode implemented?), USART_AUTOBAUD=1 (USART autobaud implemented?), USART_COLDET=1 (USART collision detection implemented?), USART_FLOW_CTRL=1 (USART flow control implemented?), USART_FRAC_BAUD=1 (USART fractional BAUD implemented?), USART_IRDA=1 (USART IrDA implemented?), USART_ISO7816=1 (USART ISO7816 mode implemented?), USART_LIN_MASTER=1 (USART LIN Master mode implemented?), USART_RS485=1 (USART RS485 mode implemented?), USART_SAMPA_EXT=1 (USART sample adjust implemented?), USART_SAMPR_EXT=1 (USART oversampling adjustment implemented?), USART_TX_READY_INT_SRC=58 (USART TX READY Interrupt), USART_TX_COMPLETE_INT_SRC=59 (USART TX COMPLETE Interrupt), USART_RX_INT_SRC=60 (USART RX Interrupt), USART_ERROR_INT_SRC=61 (USART ERROR Interrupt), INSTANCE_ID=42 (Instance index for SERCOM3)
SERCOM4 at 0x43000000 (SERCOM)
  pins: PAD0 PA13/D set 3 or PB08/D set 2 or PB12/C set 1; PAD1 PA12/D set 3 or PB09/D set 2 or PB13/C set 1; PAD2 PA14/D set 3 or PB10/D set 2 or PB14/C set 1; PAD3 PB11/D set 2 or PA15/D set 3 or PB15/C set 1
  parameters: CLK_REDUCTION=1 (Reduce clock options to pin 1 for SPI and USART), DLY_COMPENSATION=1 (Compensates for a fast DLY50 element. Assuming 20ns), DMA=1 (DMA support implemented?), DMAC_ID_RX=12 (Index of DMA RX trigger), DMAC_ID_TX=13 (Index of DMA TX trigger), FIFO_DEPTH_POWER=1 (2^FIFO_DEPTH_POWER gives rx FIFO depth.), GCLK_ID_CORE=34, GCLK_ID_SLOW=3, INT_MSB=6, PMSB=3, RETENTION_SUPPORT=0 (Retention supported?), SE_CNT=1 (SE counter included?), SPI=1 (SPI mode implemented?), SPI_HW_SS_CTRL=1 (Master _SS hardware control implemented?), SPI_ICSPACE_EXT=1 (SPI inter character space implemented?), SPI_OZMO=0 (OZMO features implemented?), SPI_WAKE_ON_SSL=1 (_SS low detect implemented?), SPI_TX_READY_INT_SRC=62 (SPI TX READY Interrupt), SPI_TX_COMPLETE_INT_SRC=63 (SPI TX COMPLETE Interrupt), SPI_RX_INT_SRC=64 (SPI RX Interrupt), SPI_ERROR_INT_SRC=65 (SPI ERROR Interrupt), TTBIT_EXTENSION=1 (32-bit extension implemented?), I2CM=1 (I2C Master mode implemented?), I2CS=1 (I2C Slave mode implemented?), I2CS_AUTO_ACK=1 (I2C slave automatic acknowledge implemented?), I2CS_GROUP_CMD=1 (I2C slave group command implemented?), I2CS_SDASETUP_CNT_SIZE=8 (I2CS sda setup count size), I2CS_SDASETUP_SIZE=4, I2CS_SUDAT=1 (I2C slave SDA setup implemented?), I2C_FASTMP=1 (I2C fast mode plus implemented?), I2C_HSMODE=1 (USART mode implemented?), I2C_SCLSM_MODE=1 (I2C SCL clock stretch mode implemented?), I2C_SMB_TIMEOUTS=1 (I2C SMBus timeouts implemented?), I2C_TENBIT_ADR=1 (I2C ten bit enabled?), I2C_0_INT_SRC=62 (I2C 0 Interrupt), I2C_1_INT_SRC=63 (I2C 1 Interrupt), I2C_2_INT_SRC=64 (I2C 2 Interrupt), I2C_3_INT_SRC=65 (I2C 3 Interrupt), USART=1 (USART mode implemented?), USART_AUTOBAUD=1 (USART autobaud implemented?), USART_COLDET=1 (USART collision detection implemented?), USART_FLOW_CTRL=1 (USART flow control implemented?), USART_FRAC_BAUD=1 (USART fractional BAUD implemented?), USART_IRDA=1 (USART IrDA implemented?), USART_ISO7816=1 (USART ISO7816 mode implemented?), USART_LIN_MASTER=1 (USART LIN Master mode implemented?), USART_RS485=1 (USART RS485 mode implemented?), USART_SAMPA_EXT=1 (USART sample adjust implemented?), USART_SAMPR_EXT=1 (USART oversampling adjustment implemented?), USART_TX_READY_INT_SRC=62 (USART TX READY Interrupt), USART_TX_COMPLETE_INT_SRC=63 (USART TX COMPLETE Interrupt), USART_RX_INT_SRC=64 (USART RX Interrupt), USART_ERROR_INT_SRC=65 (USART ERROR Interrupt), INSTANCE_ID=96 (Instance index for SERCOM4)
SERCOM5 at 0x43000400 (SERCOM)
  pins: PAD0 PA23/D set 2 3 4 or PB02/D set 6 or PB31/D set 5 or PB16/C set 1; PAD1 PA22/D set 2 3 4 or PB03/D set 6 or PB30/D set 5 or PB17/C set 1; PAD2 PA24/D set 3 or PB00/D set 5 6 or PB22/D set 4 or PA20/C set 2; PAD3 PA25/D set 3 or PB01/D set 5 6 or PB23/D set 4 or PA21/C set 2
  parameters: CLK_REDUCTION=1 (Reduce clock options to pin 1 for SPI and USART), DLY_COMPENSATION=1 (Compensates for a fast DLY50 element. Assuming 20ns), DMA=1 (DMA support implemented?), DMAC_ID_RX=14 (Index of DMA RX trigger), DMAC_ID_TX=15 (Index of DMA TX trigger), FIFO_DEPTH_POWER=1 (2^FIFO_DEPTH_POWER gives rx FIFO depth.), GCLK_ID_CORE=35, GCLK_ID_SLOW=3, INT_MSB=6, PMSB=3, RETENTION_SUPPORT=0 (Retention supported?), SE_CNT=1 (SE counter included?), SPI=1 (SPI mode implemented?), SPI_HW_SS_CTRL=1 (Master _SS hardware control implemented?), SPI_ICSPACE_EXT=1 (SPI inter character space implemented?), SPI_OZMO=0 (OZMO features implemented?), SPI_WAKE_ON_SSL=1 (_SS low detect implemented?), SPI_TX_READY_INT_SRC=66 (SPI TX READY Interrupt), SPI_TX_COMPLETE_INT_SRC=67 (SPI TX COMPLETE Interrupt), SPI_RX_INT_SRC=68 (SPI RX Interrupt), SPI_ERROR_INT_SRC=69 (SPI ERROR Interrupt), TTBIT_EXTENSION=1 (32-bit extension implemented?), I2CM=1 (I2C Master mode implemented?), I2CS=1 (I2C Slave mode implemented?), I2CS_AUTO_ACK=1 (I2C slave automatic acknowledge implemented?), I2CS_GROUP_CMD=1 (I2C slave group command implemented?), I2CS_SDASETUP_CNT_SIZE=8 (I2CS sda setup count size), I2CS_SDASETUP_SIZE=4, I2CS_SUDAT=1 (I2C slave SDA setup implemented?), I2C_FASTMP=1 (I2C fast mode plus implemented?), I2C_HSMODE=1 (USART mode implemented?), I2C_SCLSM_MODE=1 (I2C SCL clock stretch mode implemented?), I2C_SMB_TIMEOUTS=1 (I2C SMBus timeouts implemented?), I2C_TENBIT_ADR=1 (I2C ten bit enabled?), I2C_0_INT_SRC=66 (I2C 0 Interrupt), I2C_1_INT_SRC=67 (I2C 1 Interrupt), I2C_2_INT_SRC=68 (I2C 2 Interrupt), I2C_3_INT_SRC=69 (I2C 3 Interrupt), USART=1 (USART mode implemented?), USART_AUTOBAUD=1 (USART autobaud implemented?), USART_COLDET=1 (USART collision detection implemented?), USART_FLOW_CTRL=1 (USART flow control implemented?), USART_FRAC_BAUD=1 (USART fractional BAUD implemented?), USART_IRDA=1 (USART IrDA implemented?), USART_ISO7816=1 (USART ISO7816 mode implemented?), USART_LIN_MASTER=1 (USART LIN Master mode implemented?), USART_RS485=1 (USART RS485 mode implemented?), USART_SAMPA_EXT=1 (USART sample adjust implemented?), USART_SAMPR_EXT=1 (USART oversampling adjustment implemented?), USART_TX_READY_INT_SRC=66 (USART TX READY Interrupt), USART_TX_COMPLETE_INT_SRC=67 (USART TX COMPLETE Interrupt), USART_RX_INT_SRC=68 (USART RX Interrupt), USART_ERROR_INT_SRC=69 (USART ERROR Interrupt), INSTANCE_ID=97 (Instance index for SERCOM5), INSTANCE_ID=97
SUPC at 0x40001800
  pins: OUT0 PB01 set 1; OUT1 PB02 set 1; VBAT PB03 set 1
  parameters: BOD12_CALIB_MSB=5, BOD33_CALIB_MSB=5, INSTANCE_ID=6 (Instance index for SUPC)
TC0 at 0x40003800 (TC)
  pins: WO0 PA04/E set 1 or PA08/E set 2 or PB30/E set 3; WO1 PA05/E set 1 or PA09/E set 2 or PB31/E set 3
  parameters: CC_NUM=2, DMAC_ID_OVF=44 (Indexes of DMA Overflow trigger), DMAC_ID_MC0=45 (Indexes of DMA Match/Compare 0 trigger), DMAC_ID_MC1=46 (Indexes of DMA Match/Compare 1 trigger), EXT=0 (Coding of implemented extended features (keep 0 value)), GCLK_ID=9 (Index of Generic Clock), MASTER_SLAVE_MODE=1 (TC type 0 : NA, 1 : Master, 2 : Slave), OW_NUM=2 (Number of Output Waveforms), INSTANCE_ID=14 (Instance index for TC0)
TC1 at 0x40003C00 (TC)
  pins: WO0 PA06/E set 1 or PA10/E set 2; WO1 PA07/E set 1 or PA11/E set 2
  parameters: CC_NUM=2, DMAC_ID_OVF=47 (Indexes of DMA Overflow trigger), DMAC_ID_MC0=48 (Indexes of DMA Match/Compare 0 trigger), DMAC_ID_MC1=49 (Indexes of DMA Match/Compare 1 trigger), EXT=0 (Coding of implemented extended features (keep 0 value)), GCLK_ID=9 (Index of Generic Clock), MASTER_SLAVE_MODE=2 (TC type 0 : NA, 1 : Master, 2 : Slave), OW_NUM=2 (Number of Output Waveforms), INSTANCE_ID=15 (Instance index for TC1)
TC2 at 0x4101A000 (TC)
  pins: WO0 PA12/E set 2 or PA16/E set 3 or PA00/E set 1; WO1 PA01/E set 1 or PA13/E set 2 or PA17/E set 3
  parameters: CC_NUM=2, DMAC_ID_OVF=50 (Indexes of DMA Overflow trigger), DMAC_ID_MC0=51 (Indexes of DMA Match/Compare 0 trigger), DMAC_ID_MC1=52 (Indexes of DMA Match/Compare 1 trigger), EXT=0 (Coding of implemented extended features (keep 0 value)), GCLK_ID=26 (Index of Generic Clock), MASTER_SLAVE_MODE=1 (TC type 0 : NA, 1 : Master, 2 : Slave), OW_NUM=2 (Number of Output Waveforms), INSTANCE_ID=45 (Instance index for TC2)
TC3 at 0x4101C000 (TC)
  pins: WO0 PA18/E set 2 or PA14/E set 1; WO1 PA15/E set 1 or PA19/E set 2
  parameters: CC_NUM=2, DMAC_ID_OVF=53 (Indexes of DMA Overflow trigger), DMAC_ID_MC0=54 (Indexes of DMA Match/Compare 0 trigger), DMAC_ID_MC1=55 (Indexes of DMA Match/Compare 1 trigger), EXT=0 (Coding of implemented extended features (keep 0 value)), GCLK_ID=26 (Index of Generic Clock), MASTER_SLAVE_MODE=2 (TC type 0 : NA, 1 : Master, 2 : Slave), OW_NUM=2 (Number of Output Waveforms), INSTANCE_ID=46 (Instance index for TC3)
TC4 at 0x42001400 (TC)
  pins: WO0 PA22/E set 3 or PB08/E set 1 or PB12/E set 2; WO1 PA23/E set 3 or PB09/E set 1 or PB13/E set 2
  parameters: CC_NUM=2, DMAC_ID_OVF=56 (Indexes of DMA Overflow trigger), DMAC_ID_MC0=57 (Indexes of DMA Match/Compare 0 trigger), DMAC_ID_MC1=58 (Indexes of DMA Match/Compare 1 trigger), EXT=0 (Coding of implemented extended features (keep 0 value)), GCLK_ID=30 (Index of Generic Clock), MASTER_SLAVE_MODE=1 (TC type 0 : NA, 1 : Master, 2 : Slave), OW_NUM=2 (Number of Output Waveforms), INSTANCE_ID=69 (Instance index for TC4)
TC5 at 0x42001800 (TC)
  pins: WO0 PA24/E set 3 or PB10/E set 1 or PB14/E set 2; WO1 PA25/E set 3 or PB11/E set 1 or PB15/E set 2
  parameters: CC_NUM=2, DMAC_ID_OVF=59 (Indexes of DMA Overflow trigger), DMAC_ID_MC0=60 (Indexes of DMA Match/Compare 0 trigger), DMAC_ID_MC1=61 (Indexes of DMA Match/Compare 1 trigger), EXT=0 (Coding of implemented extended features (keep 0 value)), GCLK_ID=30 (Index of Generic Clock), MASTER_SLAVE_MODE=2 (TC type 0 : NA, 1 : Master, 2 : Slave), OW_NUM=2 (Number of Output Waveforms), INSTANCE_ID=70 (Instance index for TC5), INSTANCE_ID=70
TCC0 at 0x41016000 (TCC)
  pins: WO0 PA20/G set 6 or PB12/G set 5 or PA08/F set 1; WO1 PA21/G set 6 or PB13/G set 5 or PA09/F set 1; WO2 PA22/G set 6 or PB14/G set 5 or PA10/F set 1; WO3 PA23/G set 6 or PB15/G set 5 or PA11/F set 1; WO4 PA16/G set 5 or PB16/G set 6 or PB10/F set 1; WO5 PA17/G set 5 or PB17/G set 6 or PB11/F set 1; WO6 PA18/G set 3 or PB30/G set 4 or PA12/F set 1; WO7 PA19/G set 3 or PB31/G set 4 or PA13/F set 1
  parameters: CC_NUM=6 (Number of Compare/Capture units), DITHERING=1 (Dithering feature implemented), DMAC_ID_OVF=22 (DMA overflow/underflow/retrigger trigger), DMAC_ID_MC{n}={n+23} (Indexes of DMA Match/Compare {n} trigger) (n=0..5), DTI=1 (Dead-Time-Insertion feature implemented), EXT=31 (Coding of implemented extended features), GCLK_ID=25 (Index of Generic Clock), MASTER_SLAVE_MODE=1 (TCC type 0 : NA, 1 : Master, 2 : Slave), OTMX=1 (Output Matrix feature implemented), OW_NUM=8 (Number of Output Waveforms), PG=1 (Pattern Generation feature implemented), SIZE=24, SWAP=1 (DTI outputs swap feature implemented), INSTANCE_ID=43 (Instance index for TCC0)
TCC1 at 0x41018000 (TCC)
  pins: WO0 PB10/G set 4 or PA16/F set 1; WO1 PB11/G set 4 or PA17/F set 1; WO2 PA12/G set 4 or PA14/G set 5 or PA18/F set 1; WO3 PA13/G set 4 or PA15/G set 5 or PA19/F set 1; WO4 PA08/G set 3 or PA20/F set 1; WO5 PA09/G set 3 or PA21/F set 1; WO6 PA10/G set 2 or PA22/F set 1; WO7 PA11/G set 2 or PA23/F set 1
  parameters: CC_NUM=4 (Number of Compare/Capture units), DITHERING=1 (Dithering feature implemented), DMAC_ID_OVF=29 (DMA overflow/underflow/retrigger trigger), DMAC_ID_MC0=30 (Indexes of DMA Match/Compare 0 trigger), DMAC_ID_MC1=31 (Indexes of DMA Match/Compare 1 trigger), DMAC_ID_MC2=32 (Indexes of DMA Match/Compare 2 trigger), DMAC_ID_MC3=33 (Indexes of DMA Match/Compare 3 trigger), DTI=1 (Dead-Time-Insertion feature implemented), EXT=31 (Coding of implemented extended features), GCLK_ID=25 (Index of Generic Clock), MASTER_SLAVE_MODE=2 (TCC type 0 : NA, 1 : Master, 2 : Slave), OTMX=1 (Output Matrix feature implemented), OW_NUM=8 (Number of Output Waveforms), PG=1 (Pattern Generation feature implemented), SIZE=24, SWAP=1 (DTI outputs swap feature implemented), INSTANCE_ID=44 (Instance index for TCC1)
TCC2 at 0x42000C00 (TCC)
  pins: WO0 PA14/F set 1 or PA30/F set 2; WO1 PA15/F set 1 or PA31/F set 2; WO2 PA24/F set 1 or PB02/F set 2
  parameters: CC_NUM=3 (Number of Compare/Capture units), DITHERING=0 (Dithering feature implemented), DMAC_ID_OVF=34 (DMA overflow/underflow/retrigger trigger), DMAC_ID_MC0=35 (Indexes of DMA Match/Compare 0 trigger), DMAC_ID_MC1=36 (Indexes of DMA Match/Compare 1 trigger), DMAC_ID_MC2=37 (Indexes of DMA Match/Compare 2 trigger), DTI=0 (Dead-Time-Insertion feature implemented), EXT=1 (Coding of implemented extended features), GCLK_ID=29 (Index of Generic Clock), MASTER_SLAVE_MODE=0 (TCC type 0 : NA, 1 : Master, 2 : Slave), OTMX=1 (Output Matrix feature implemented), OW_NUM=3 (Number of Output Waveforms), PG=0 (Pattern Generation feature implemented), SIZE=16, SWAP=0 (DTI outputs swap feature implemented), INSTANCE_ID=67 (Instance index for TCC2)
TCC3 at 0x42001000 (TCC)
  pins: WO0 PB12/F set 1 or PB16/F set 2; WO1 PB13/F set 1 or PB17/F set 2
  parameters: CC_NUM=2 (Number of Compare/Capture units), DITHERING=0 (Dithering feature implemented), DMAC_ID_OVF=38 (DMA overflow/underflow/retrigger trigger), DMAC_ID_MC0=39 (Indexes of DMA Match/Compare 0 trigger), DMAC_ID_MC1=40 (Indexes of DMA Match/Compare 1 trigger), DTI=0 (Dead-Time-Insertion feature implemented), EXT=0 (Coding of implemented extended features), GCLK_ID=29 (Index of Generic Clock), MASTER_SLAVE_MODE=0 (TCC type 0 : NA, 1 : Master, 2 : Slave), OTMX=0 (Output Matrix feature implemented), OW_NUM=2 (Number of Output Waveforms), PG=0 (Pattern Generation feature implemented), SIZE=16, SWAP=0 (DTI outputs swap feature implemented), INSTANCE_ID=68 (Instance index for TCC3)
TCC4 at 0x43001000 (TCC)
  pins: WO0 PB14/F set 1 or PB30/F set 2; WO1 PB15/F set 1 or PB31/F set 2
  parameters: CC_NUM=2 (Number of Compare/Capture units), DITHERING=0 (Dithering feature implemented), DMAC_ID_OVF=41 (DMA overflow/underflow/retrigger trigger), DMAC_ID_MC0=42 (Indexes of DMA Match/Compare 0 trigger), DMAC_ID_MC1=43 (Indexes of DMA Match/Compare 1 trigger), DTI=0 (Dead-Time-Insertion feature implemented), EXT=0 (Coding of implemented extended features), GCLK_ID=38 (Index of Generic Clock), MASTER_SLAVE_MODE=0 (TCC type 0 : NA, 1 : Master, 2 : Slave), OTMX=0 (Output Matrix feature implemented), OW_NUM=2 (Number of Output Waveforms), PG=0 (Pattern Generation feature implemented), SIZE=16, SWAP=0 (DTI outputs swap feature implemented), INSTANCE_ID=100 (Instance index for TCC4)
TRNG at 0x42002800
  parameters: INSTANCE_ID=74 (Instance index for TRNG)
USB at 0x41000000
  pins: DM PA24/H; DP PA25/H; SOF_1KHZ PA23/H set 1 or PB22/H set 2
  parameters: AHB_2_USB_FIFO_DEPTH=4 (bytes number, should be at least 2, and 2^n (4,8,16 ...)), AHB_2_USB_RD_DATA_BITS=8 (8, 16 or 32, here : 8-bits is required as UTMI interface should work in 8-bits mode), AHB_2_USB_WR_DATA_BITS=32 (8, 16 or 32 : here, AHB transfer is made in word mode), AHB_2_USB_WR_THRESHOLD=2 (as soon as there are N bytes-free inside the fifo, ahb read transfer is requested), DATA_BUS_16_8=0 (UTMI/SIE data bus size : 0 -> 8 bits, 1 -> 16 bits), EPNUM=8 (parameter for rtl : max of ENDPOINT and PIPE NUM), EPT_NUM=8 (Number of USB end points), GCLK_ID=10 (Index of Generic Clock), INITIAL_CONTROL_QOS=3 (CONTROL QOS RESET value), INITIAL_DATA_QOS=3 (DATA QOS RESET value), MISSING_SOF_DET_IMPLEMENTED=1 (48 mHz xPLL feature implemented), PIPE_NUM=8 (Number of USB pipes), SYSTEM_CLOCK_IS_CKUSB=0 (Dual (1'b0) or Single (1'b1) clock system), USB_2_AHB_FIFO_DEPTH=4 (bytes number, should be at least 2, and 2^n (4,8,16 ...)), USB_2_AHB_RD_DATA_BITS=16 (8, 16 or 32, here : 8-bits is required as UTMI interface should work in 8-bits mode), USB_2_AHB_RD_THRESHOLD=2 (as soon as there are 16 bytes-free inside the fifo, ahb read transfer is requested), USB_2_AHB_WR_DATA_BITS=8 (8, 16 or 32 : here : 8-bits is required as UTMI interface should work in 8-bits mode), INSTANCE_ID=32 (Instance index for USB)
WDT at 0x40002000
  parameters: INSTANCE_ID=8 (Instance index for WDT)
CoreDebug at 0xE000EDF0
DWT at 0xE0001000
ETM at 0xE0041000
FPU at 0xE000EF30
ITM at 0xE0000000
MPU at 0xE000ED90
NVIC at 0xE000E100
  parameters: NUM_IRQ=137 (Number of interrupt requests), __NVIC_PRIO_BITS=3 (Number of NVIC interrupt priority bits)
SysTick at 0xE000E010
SystemControl at 0xE000E000
TPIU at 0xE0040000

## Interrupts
-15 Reset — Reset Vector, invoked on Power up and warm reset
-14 NonMaskableInt — Non maskable Interrupt, cannot be stopped or preempted
-13 HardFault — Hard Fault, all classes of Fault
-12 MemoryManagement — Memory Management, MPU mismatch, including Access Violation and No Match
-11 BusFault — Bus Fault, Pre-Fetch-, Memory Access Fault, other address/memory related Fault
-10 UsageFault — Usage Fault, i.e. Undef Instruction, Illegal State Transition
-5 SVCall — System Service Call via SVC instruction
-4 DebugMonitor
-2 PendSV — Pendable request for system service
-1 SysTick — System Tick Timer
0 PM — Power Manager
1 MCLK — Main Clock
2 OSCCTRL_XOSC0 (OSCCTRL) — External Oscillator 0
3 OSCCTRL_XOSC1 (OSCCTRL) — External Oscillator 1
4 OSCCTRL_DFLL (OSCCTRL) — Digital Frequency Locked Loop
5 OSCCTRL_DPLL0 (OSCCTRL) — Digital Phase Locked Loop 0
6 OSCCTRL_DPLL1 (OSCCTRL) — Digital Phase Locked Loop 1
7 OSC32KCTRL — 32Khz Oscillator Controller
8 SUPC_OTHER (SUPC) — Suppyly controller
9 SUPC_BODDET (SUPC) — Brown Out Detection
10 WDT — Watch Dog Timer
11 RTC — Real Time Counter
{n+12} EIC_EXTINT_{n} (EIC) (n=0..15) — EIC Channel {n}
28 FREQM — Frequency Meter
29 NVMCTRL_0 (NVMCTRL) — Non-Volatile Memory Controller
30 NVMCTRL_1 (NVMCTRL) — NVMCTRL SmartEEPROM Interrupts
31 DMAC_0 (DMAC) — DMA Channel 0
32 DMAC_1 (DMAC) — DMA Channel 1
33 DMAC_2 (DMAC) — DMA Channel 2
34 DMAC_3 (DMAC) — DMA Channel 3
35 DMAC_OTHER (DMAC) — DMA Channel 4..X
36 EVSYS_0 (EVSYS) — Event System Channel 0
37 EVSYS_1 (EVSYS) — Event System Channel 1
38 EVSYS_2 (EVSYS) — Event System Channel 2
39 EVSYS_3 (EVSYS) — Event System Channel 3
40 EVSYS_OTHER (EVSYS) — Event System Channel 4..X
41 PAC — Peripheral Access Controller
45 RAMECC — RAM Error Correction Code
46 SERCOM0_0 (SERCOM0) — Serial Communication Interface 0
47 SERCOM0_1 (SERCOM0) — Serial Communication Interface 0
48 SERCOM0_2 (SERCOM0) — Serial Communication Interface 0
49 SERCOM0_OTHER (SERCOM0) — Serial Communication Interface 0
50 SERCOM1_0 (SERCOM1) — Serial Communication Interface 1
51 SERCOM1_1 (SERCOM1) — Serial Communication Interface 1
52 SERCOM1_2 (SERCOM1) — Serial Communication Interface 1
53 SERCOM1_OTHER (SERCOM1) — Serial Communication Interface 1
54 SERCOM2_0 (SERCOM2) — Serial Communication Interface 2
55 SERCOM2_1 (SERCOM2) — Serial Communication Interface 2
56 SERCOM2_2 (SERCOM2) — Serial Communication Interface 2
57 SERCOM2_OTHER (SERCOM2) — Serial Communication Interface 2
58 SERCOM3_0 (SERCOM3) — Serial Communication Interface 3
59 SERCOM3_1 (SERCOM3) — Serial Communication Interface 3
60 SERCOM3_2 (SERCOM3) — Serial Communication Interface 3
61 SERCOM3_OTHER (SERCOM3) — Serial Communication Interface 3
62 SERCOM4_0 (SERCOM4) — Serial Communication Interface 4
63 SERCOM4_1 (SERCOM4) — Serial Communication Interface 4
64 SERCOM4_2 (SERCOM4) — Serial Communication Interface 4
65 SERCOM4_OTHER (SERCOM4) — Serial Communication Interface 4
66 SERCOM5_0 (SERCOM5) — Serial Communication Interface 5
67 SERCOM5_1 (SERCOM5) — Serial Communication Interface 5
68 SERCOM5_2 (SERCOM5) — Serial Communication Interface 5
69 SERCOM5_OTHER (SERCOM5) — Serial Communication Interface 5
78 CAN0 — Controller Area Network 0
79 CAN1 — Controller Area Network 1
80 USB_OTHER (USB) — Universal Serial Bus
81 USB_SOF_HSOF (USB) — USB Start of Frame
82 USB_TRCPT0 (USB) — USB Transfer Complete 0
83 USB_TRCPT1 (USB) — USB Transfer Complete 1
85 TCC0_OTHER (TCC0) — Timer Counter Control 0
86 TCC0_MC0 (TCC0) — TCC Match/Compare 0
87 TCC0_MC1 (TCC0) — TCC Match/Compare 1
88 TCC0_MC2 (TCC0) — TCC Match/Compare 2
89 TCC0_MC3 (TCC0) — TCC Match/Compare 3
90 TCC0_MC4 (TCC0) — TCC Match/Compare 4
91 TCC0_MC5 (TCC0) — TCC Match/Compare 5
92 TCC1_OTHER (TCC1) — Timer Counter Control 1
93 TCC1_MC0 (TCC1) — TCC Match/Compare 0
94 TCC1_MC1 (TCC1) — TCC Match/Compare 1
95 TCC1_MC2 (TCC1) — TCC Match/Compare 2
96 TCC1_MC3 (TCC1) — TCC Match/Compare 3
97 TCC2_OTHER (TCC2) — Timer Counter Control 2
98 TCC2_MC0 (TCC2) — TCC Match/Compare 0
99 TCC2_MC1 (TCC2) — TCC Match/Compare 1
100 TCC2_MC2 (TCC2) — TCC Match/Compare 2
101 TCC3_OTHER (TCC3) — Timer Counter Control 3
102 TCC3_MC0 (TCC3) — TCC Match/Compare 0
103 TCC3_MC1 (TCC3) — TCC Match/Compare 1
104 TCC4_OTHER (TCC4) — Timer Counter Control 4
105 TCC4_MC0 (TCC4) — TCC Match/Compare 0
106 TCC4_MC1 (TCC4) — TCC Match/Compare 1
107 TC0 — Timer Counter 0
108 TC1 — Timer Counter 1
109 TC2 — Timer Counter 2
110 TC3 — Timer Counter 3
111 TC4 — Timer Counter 4
112 TC5 — Timer Counter 5
115 PDEC_OTHER (PDEC) — Position Decoder
116 PDEC_MC0 (PDEC) — PDEC Match/Compare 0
117 PDEC_MC1 (PDEC) — PDEC Match Compare 1
118 ADC0_OTHER (ADC0) — Analog To Digital Converter 0
119 ADC0_RESRDY (ADC0) — ADC0 Result Ready
120 ADC1_OTHER (ADC1) — Analog To Digital Converter 1
121 ADC1_RESRDY (ADC1) — ADC1 Result Ready
122 AC — Analog Comparator
123 DAC_OTHER (DAC) — Digital to Analog Converter
124 DAC_EMPTY_0 (DAC) — DAC Buffer 0 Empty
125 DAC_EMPTY_1 (DAC) — DAC Buffer 1 Empty
126 DAC_RESRDY_0 (DAC) — DAC Filter 0 Result Ready
127 DAC_RESRDY_1 (DAC) — DAC Filter 1 Result Ready
128 I2S — Inter-IC Sound Interface
129 PCC — Parallel Capture Controller
130 AES — Advanced Encryption Standard
131 TRNG — True Random Generator
132 ICM — Integrity Check Monitor
133 PUKCC — Public-Key Cryptography Controller
134 QSPI — Quad SPI interface
135 SDHC0 — SD/MMC Host Controller 0

## Notices in the file
Copyright (c) 2021 Microchip Technology Inc.
SPDX-License-Identifier: Apache-2.0
Licensed under the Apache License, Version 2.0 (the "License");
you may not use this file except in compliance with the License.
You may obtain a copy of the License at
http://www.apache.org/licenses/LICENSE-2.0
Unless required by applicable law or agreed to in writing, software
distributed under the License is distributed on an "AS IS" BASIS,
WITHOUT WARRANTIES OR CONDITIONS OF ANY KIND, either express or implied.
See the License for the specific language governing permissions and
limitations under the License.
