# PIC32MZ1064DAB288 register map
Vendor: Microchip
Architecture 32xxxx. Special function registers and configuration words.
Registers are 32-bit, read-write, reset 0x0 unless marked. A register's access mark holds for its fields unless they carry their own. Addresses are absolute, and some are shared; only a register's first bit layout is shown; lines under a group give offsets from that group; [hi:lo] are bit positions; {n}, {i} and the like mark numbered series; 'fields as' and 'values as' point back to an identical list; <NAME> marks a mode.

## Further device data
pins=1: NC; 2: DDRUDQS; 3: DDRDM1; 4: D-; 5: VSS; 6: RH14/INT0; 7: RF2/SDA3/RPF2; 8: RG15/AN21; 9: RG6/SCK2/C1IND/AN14; 10: RF13/SCK5/AN17/TDI; 11: RF12/RPF12/AN31/TDO; 12: RC1/PMD5/RPC1/AN12/EBID5; 13: RC4/PMRD/RPC4/AN19/EBIOE; 14: RB1/CTED1/RPB1/AN9/PGEC1; 15: RB8/PMD10/RPB8/AN4/EBID10; 16: RB3/RPB3/AN8; 17: RA9/AN27/VREF-; 18: NC; 19: NC; 20: DDRUDQS; 21: DDRDQ14; 22: D+; 23: VSS; 24: RE4/PMD4/AN18/EBID4; 25: RE0/PMD0/EBID0; 26: RH4/AN20; 27: RG9/PMA2/RPG9/C2INC/AN23/EBIA2; 28: RE9/RPE9/AN26; 29: RE7/PMD7/AN15/EBID7; 30: NC; 31: RC3/PMWR/RPC3/AN34/EBIWE; 32: RB6/RPB6/PGEC2; 33: RB13/CTPLS/AN48; 34: RB15/OCFB/RPB15/C2INA/AN3; 35: RB4/C1INB/AN2; 36: RA5/PMA5/AN7/EBIA5; 37: DDRDQ8; 38: DDRDQ15; 39: DDRDQ9; 40: VUSB3V3; 41: VBUS; 42: USBID; 43: VSS; 44: NC; 45: RG8/SCL4/RPG8/C2IND/AN30; 46: RE8/RPE8/AN25; 47: RE6/PMD6/AN16/EBID6; 48: VDD; 49: RC2/PMD12/RPC2/AN10/EBID12; 50: RB11/AN49; 51: RA10/AN28/VREF+; 52: VDD; 53: RB2/RPB2/C2INB/AN1; 54: RB12/AN6; 55: DDRDQ13; 56: DDRDQ10; 57: VSS1V8; 58: RA0/SDCD/TMS; 59: VUSB3V3; 60: NC; 61: VDD; 62: RE1/PMD1/AN39/EBID1; 63: RG7/SDA4/RPG7/C1INC/AN13; 64: VSS; 65: VSS; 66: VSS; 67: VSS; 68: VDD; 69: VDD; 70: VDD; 71: RB7/RPB7/AN46/C1INA/PGED2; 72: RB0/CTED2/RPB0/AN0/PGED1; 73: DDRLDQS; 74: DDRLDQS; 75: DDRDQ12; 76: RA6/SQICLK/SDCK/TRCLK; 77: NC; 78: NC; 79: NC; 80: NC; 81: NC; 82: NC; 83: NC; 84: NC; 85: NC; 86: NC; 87: VDD; 88: RB9/PMA7/RPB9/LVDIN/AN47/EBIA7; 89: RB5/RPB5/AN45; 90: RB10/RPB10/AN5/CVREFOUT; 91: DDRDQ0; 92: DDRDQ7; 93: DDRDQ11; 94: RA7/SQID3/SDDATA3/TRD3; 95: NC; 96: VSS1V8; 97: VSS1V8; 98: VSS1V8; 99: VSS; 100: VSS; 101: VDD; 102: AVSS; 103: AVDD; 104: NC; 105: VDD; 106: VBAT; 107: NC; 108: NC; 109: DDRDQ3; 110: DDRDQ4; 111: DDRDM0; 112: RG12/SQID1/SDDATA1/TRD1; 113: NC; 114: VSS1V8; 115: VSS1V8; 116: VSS1V8; 117: VSS1V8; 118: VSS; 119: VDD; 120: AVSS; 121: AVDD; 122: NC; 123: VDD; 124: NC; 125: RC12/CLKI/OSC1; 126: RC15/CLKO/OSC2; 127: DDRDQ2; 128: DDRDQ5; 129: DDRDQ6; 130: RG13/SQID0/SDDATA0/TRD0; 131: NC; 132: VDD1V8; 133: VDD1V8; 134: VDD1V8; 135: VSS1V8; 136: VSS; 137: VDD; 138: VDD; 139: VDD; 140: NC; 141: VDD; 142: RA1/AN24/TCK; 143: RC13/RPC13/SOSCI; 144: RC14/T1CK/RPC14/SOSCO; 145: DDRVREF; 146: NC; 147: DDRDQ1; 148: RG14/SQID2/SDDATA2/TRD2; 149: NC; 150: VDD1V8; 151: VDD1V8; 152: VDD1V8; 153: VSS1V8; 154: VDD; 155: VSS; 156: VSS; 157: VSS; 158: NC; 159: VDD; 160: RD15/SCK6/AN33; 161: RB14/SCK3/AN29; 162: RD14/RPD14/AN22; 163: DDRCK; 164: DDRCK; 165: RE5/PMA6/RPE5/EBIA6; 166: RD4/RPD4/SQICS0/SDCMD; 167: NC; 168: VDD1V8; 169: VDD1V8; 170: VDD1V8; 171: VSS1V8; 172: VDD; 173: VSS; 174: VSS; 175: VSS; 176: NC; 177: VSS; 178: RJ2/AN32/EBIRDY3; 179: RJ3/EBIA22/GD20; 180: RJ4/EBICS0/VSYNC; 181: DDRWE; 182: DDRCKE; 183: DDRA1; 184: RD5/RPD5/SQICS1; 185: NC; 186: VDD1V8; 187: VDD1V8; 188: VDD1V8; 189: VSS1V8; 190: VSS; 191: VDD; 192: VDD; 193: VSS; 194: NC; 195: VSS; 196: RJ7/EBICS3/GEN; 197: RJ6/EBICS2/GCLK; 198: RJ5/EBICS1/HSYNC; 199: DDRRAS; 200: DDRBA0; 201: DDRBA1; 202: RD1/SCK1; 203: NC; 204: VSS1V8; 205: VSS1V8; 206: VSS1V8; 207: VSS1V8; 208: VSS; 209: VSS; 210: VDD; 211: VDD; 212: NC; 213: VDD; 214: RJ13/PMD13/EBID13/GD0; 215: RJ12/EBIBS0/GD9; 216: RJ10/EBIBS1/GD18; 217: DDRODT; 218: DDRCS0; 219: DDRA2; 220: RD13/PMA13/EBIA13/GD22; 221: NC; 222: VSS1V8; 223: VSS1V8; 224: VSS1V8; 225: VSS1V8; 226: VSS; 227: VSS; 228: VDD; 229: VDD; 230: NC; 231: RH7/PMA4/AN36/EBIA4; 232: RH2/EBIRP/SDWP; 233: RJ15/PMA0/EBIA0; 234: RJ14/PMD11/EBID11/GD8; 235: DDRA10; 236: DDRCAS; 237: DDRA4; 238: RF8/SCL3/RPF8; 239: NC; 240: NC; 241: NC; 242: NC; 243: NC; 244: NC; 245: NC; 246: NC; 247: NC; 248: NC; 249: RK4/EBIA18/GD13; 250: RK0/EBIA16/GD23; 251: RH11/AN37/EBIRDY2; 252: RH3/AN35; 253: DDRA0; 254: DDRA3; 255: DDRA9; 256: VSS1V8; 257: MCLR; 258: RD2/PMCS1/PMA14/RPD2/EBIA14/GD10; 259: VSS; 260: VSS; 261: VDD; 262: VDD; 263: VDD; 264: VDD; 265: VDD; 266: VDD; 267: RK5/EBIA19/GD14; 268: RK3/EBIA17/GD12; 269: RK2/PMA3/AN11/EBIA3; 270: RK1/PMA1/AN38/EBIA1; 271: DDRA5; 272: DDRA7; 273: DDRA12; 274: DDRA14; 275: NC; 276: RD3/PMCS2/PMA15/RPD3/EBIA15/GD11; 277: RF5/PMD8/SCL5/RPF5/EBID8/GD16; 278: RG1/PMA9/RPG1/EBIA9/GD4; 279: RE3/PMD3/RPE3/EBID3; 280: RH6/ERXD2; 281: RH10/ECOL; 282: RH1/ETXD3; 283: RJ9/ETXD1; 284: NC; 285: RD7/RPD7/ETXCLK; 286: RA14/SCL1/RPA14; 287: RK7/EBIA21/GD19; 288: RK6/EBIA20/GD15; 289: DDRA6; 290: DDRA8; 291: DDRA13; 292: DDRBA2; 293: RD12/PMA12/RPD12/EBIA12/GD7; 294: RD9/PMD15/RPD9/EBID15/GD2; 295: RF1/PMA10/RPF1/EBIA10/GD5; 296: RF3/RPF3/ERXERR; 297: RF4/PMD9/SDA5/RPF4/EBID9/GD17; 298: RH5/ERXD1; 299: RH12/ECRS; 300: RH8/ERXD0; 301: RJ11/EREFCLK/ERXCLK; 302: RJ1/EMDIO; 303: RD11/RPD11/EMDC; 304: RA15/SDA1/RPA15; 305: RA3/SDA2/EBIRDY1; 306: RA2/SCL2; 307: NC; 308: DDRA11; 309: DDRA15; 310: NC; 311: RD0/RPD0/RTCC; 312: RD10/SCK4; 313: RF0/PMA11/RPF0/EBIA11/GD6; 314: RH15/EBIA23/GD21; 315: RG0/PMA8/RPG0/EBIA8/GD3; 316: RE2/PMD2/EBID2; 317: RH13/ERXDV; 318: RH9/ERXD3; 319: RH0/ETXD2; 320: RJ8/ETXD0; 321: RJ0/ETXERR; 322: RD6/RPD6/ETXEN; 323: RA4/PMD14/EBID14/GD1; 324: NC, interrupts=0 CORE_TIMER — Core Timer; 1 CORE_SOFTWARE_0 — Core Software 0; 2 CORE_SOFTWARE_1 — Core Software 1; 3 EXTERNAL_0 — Ext INT 0; 4 TIMER_1 — Timer1; 5 INPUT_CAPTURE_1_ERROR — Input Capture 1 Error; 6 INPUT_CAPTURE_1 — Input Capture 1; 7 OUTPUT_COMPARE_1 — Output Compare 1; 8 EXTERNAL_1 — Ext INT 1; 9 TIMER_2 — Timer2; 10 INPUT_CAPTURE_2_ERROR — Input Capture 2 Error; 11 INPUT_CAPTURE_2 — Input Capture 2; 12 OUTPUT_COMPARE_2 — Output Compare 2; 13 EXTERNAL_2 — Ext INT 2; 14 TIMER_3 — Timer3; 15 INPUT_CAPTURE_3_ERROR — Input Capture 3 Error; 16 INPUT_CAPTURE_3 — Input Capture 3; 17 OUTPUT_COMPARE_3 — Output Compare 3; 18 EXTERNAL_3 — Ext INT 3; 19 TIMER_4 — Timer4; 20 INPUT_CAPTURE_4_ERROR — Input Capture 4 Error; 21 INPUT_CAPTURE_4 — Input Capture 4; 22 OUTPUT_COMPARE_4 — Output Compare 4; 23 EXTERNAL_4 — Ext INT 4; 24 TIMER_5 — Timer5; 25 INPUT_CAPTURE_5_ERROR — Input Capture 5 Error; 26 INPUT_CAPTURE_5 — Input Capture 5; 27 OUTPUT_COMPARE_5 — Output Compare 5; 28 TIMER_6 — Timer6; 29 INPUT_CAPTURE_6_ERROR — Input Capture 6 Error; 30 INPUT_CAPTURE_6 — Input Capture 6; 31 OUTPUT_COMPARE_6 — Output Compare 6; 32 TIMER_7 — Timer7; 33 INPUT_CAPTURE_7_ERROR — Input Capture 7 Error; 34 INPUT_CAPTURE_7 — Input Capture 7; 35 OUTPUT_COMPARE_7 — Output Compare 7; 36 TIMER_8 — Timer8; 37 INPUT_CAPTURE_8_ERROR — Input Capture 8 Error; 38 INPUT_CAPTURE_8 — Input Capture 8; 39 OUTPUT_COMPARE_8 — Output Compare 8; 40 TIMER_9 — Timer9; 41 INPUT_CAPTURE_9_ERROR — Input Capture 9 Error; 42 INPUT_CAPTURE_9 — Input Capture 9; 43 OUTPUT_COMPARE_9 — Output Compare 9; 44 ADC — ADC Global ; 45 ADC_FIFO — ADC FIFO; 46 ADC_DC1 — ADC Digital Comparator 1; 47 ADC_DC2 — ADC Digital Comparator 2; 48 ADC_DC3 — ADC Digital Comparator 3; 49 ADC_DC4 — ADC Digital Comparator 4; 50 ADC_DC5 — ADC Digital Comparator 5; 51 ADC_DC6 — ADC Digital Comparator 6; 52 ADC_DF1 — ADC Digital Filter 1; 53 ADC_DF2 — ADC Digital Filter 2; 54 ADC_DF3 — ADC Digital Filter 3; 55 ADC_DF4 — ADC Digital Filter 4; 56 ADC_DF5 — ADC Digital Filter 5; 57 ADC_DF6 — ADC Digital Filter 6; 58 ADC_FAULT — ADC Fault; 59 ADC_DATA0 — ADC Data 0; 60 ADC_DATA1 — ADC Data 1; 61 ADC_DATA2 — ADC Data 2; 62 ADC_DATA3 — ADC Data 3; 63 ADC_DATA4 — ADC Data 4; 64 ADC_DATA5 — ADC Data 5; 65 ADC_DATA6 — ADC Data 6; 66 ADC_DATA7 — ADC Data 7; 67 ADC_DATA8 — ADC Data 8; 68 ADC_DATA9 — ADC Data 9; 69 ADC_DATA10 — ADC Data 10; 70 ADC_DATA11 — ADC Data 11; 71 ADC_DATA12 — ADC Data 12; 72 ADC_DATA13 — ADC Data 13; 73 ADC_DATA14 — ADC Data 14; 74 ADC_DATA15 — ADC Data 15; 75 ADC_DATA16 — ADC Data 16; 76 ADC_DATA17 — ADC Data 17; 77 ADC_DATA18 — ADC Data 18; 78 ADC_DATA19 — ADC Data 19; 79 ADC_DATA20 — ADC Data 20; 80 ADC_DATA21 — ADC Data 21; 81 ADC_DATA22 — ADC Data 22; 82 ADC_DATA23 — ADC Data 23; 83 ADC_DATA24 — ADC Data 24; 84 ADC_DATA25 — ADC Data 25; 85 ADC_DATA26 — ADC Data 26; 86 ADC_DATA27 — ADC Data 27; 87 ADC_DATA28 — ADC Data 28; 88 ADC_DATA29 — ADC Data 29; 89 ADC_DATA30 — ADC Data 30; 90 ADC_DATA31 — ADC Data 31; 91 ADC_DATA32 — ADC Data 32; 92 ADC_DATA33 — ADC Data 33; 93 ADC_DATA34 — ADC Data 34; 94 ADC_DATA35 — ADC Data 35; 95 ADC_DATA36 — ADC Data 36; 96 ADC_DATA37 — ADC Data 37; 97 ADC_DATA38 — ADC Data 38; 98 ADC_DATA39 — ADC Data 39; 99 ADC_DATA40 — ADC Data 40; 100 ADC_DATA41 — ADC Data 41; 101 ADC_DATA42 — ADC Data 42; 102 ADC_DATA43 — ADC Data 43; 103 USB_SR — USB Suspend/Resume; 104 CORE_PERF_COUNT — Core Performance Counter; 105 CORE_FAST_DEBUG_CHAN — Core Fast Debug Channel; 106 SYSTEM_BUS_PROTECTION — System Bus Protection Violation; 107 CRYPTO — Crypto Engine Event; 109 SPI1_FAULT — SPI1 Fault; 110 SPI1_RX — SPI1 Receive Done; 111 SPI1_TX — SPI1 Transmit Done; 112 UART1_FAULT — UART1 Fault; 113 UART1_RX — UART1 Receive Done; 114 UART1_TX — UART1 Transmit Done; 115 I2C1_BUS — I2C1 Bus Collision Event; 116 I2C1_SLAVE — I2C1 Slave Event; 117 I2C1_MASTER — I2C1 Master Event; 118 CHANGE_NOTICE_A — PORTA Input Change; 119 CHANGE_NOTICE_B — PORTB Input Change; 120 CHANGE_NOTICE_C — PORTC Input Change; 121 CHANGE_NOTICE_D — PORTD Input Change; 122 CHANGE_NOTICE_E — PORTE Input Change; 123 CHANGE_NOTICE_F — PORTF Input Change; 124 CHANGE_NOTICE_G — PORTG Input Change; 125 CHANGE_NOTICE_H — PORTH Input Change; 126 CHANGE_NOTICE_J — PORTJ Input Change; 127 CHANGE_NOTICE_K — PORTK Input Change; 128 PMP — Parallel Master Port; 129 PMP_ERROR — Parallel Master Port Error; 130 COMPARATOR_1 — Comparator 1; 131 COMPARATOR_2 — Comparator 2; 132 USB — USB General Event; 133 USB_DMA — USB DMA Event; 134 DMA0 — DMA Channel 0; 135 DMA1 — DMA Channel 1; 136 DMA2 — DMA Channel 2; 137 DMA3 — DMA Channel 3; 138 DMA4 — DMA Channel 4; 139 DMA5 — DMA Channel 5; 140 DMA6 — DMA Channel 6; 141 DMA7 — DMA Channel 7; 142 SPI2_FAULT — SPI2 Fault; 143 SPI2_RX — SPI2 Receive Done; 144 SPI2_TX — SPI2 Transmit Done; 145 UART2_FAULT — UART2 Fault; 146 UART2_RX — UART2 Receive Done; 147 UART2_TX — UART2 Transmit Done; 148 I2C2_BUS — I2C2 Bus Collision Event; 149 I2C2_SLAVE — I2C2 Slave Event; 150 I2C2_MASTER — I2C2 Master Event; 151 CAN1 — Control Area Network 1; 152 CAN2 — Control Area Network 2; 153 ETHERNET — Ethernet; 154 SPI3_FAULT — SPI3 Fault; 155 SPI3_RX — SPI3 Receive Done; 156 SPI3_TX — SPI3 Transmit Done; 157 UART3_FAULT — UART3 Fault; 158 UART3_RX — UART3 Receive Done; 159 UART3_TX — UART3 Transmit Done; 160 I2C3_BUS — I2C3 Bus Collision Event; 161 I2C3_SLAVE — I2C3 Slave Event; 162 I2C3_MASTER — I2C3 Master Event; 163 SPI4_FAULT — SPI4 Fault; 164 SPI4_RX — SPI4 Receive Done; 165 SPI4_TX — SPI4 Transmit Done; 166 RTCC — Real Time Clock; 167 FLASH_CONTROL — Flash Control Event; 168 PREFETCH — Prefetch Module SEC Event; 169 SQI1 — SQI1 Event; 170 UART4_FAULT — UART4 Fault; 171 UART4_RX — UART4 Receive Done; 172 UART4_TX — UART4 Transmit Done; 173 I2C4_BUS — I2C4 Bus Collision Event; 174 I2C4_SLAVE — I2C4 Slave Event; 175 I2C4_MASTER — I2C4 Master Event; 176 SPI5_FAULT — SPI5 Fault; 177 SPI5_RX — SPI5 Receive Done; 178 SPI5_TX — SPI5 Transmit Done; 179 UART5_FAULT — UART5 Fault; 180 UART5_RX — UART5 Receive Done; 181 UART5_TX — UART5 Transmit Done; 182 I2C5_BUS — I2C5 Bus Collision Event; 183 I2C5_SLAVE — I2C5 Slave Event; 184 I2C5_MASTER — I2C5 Master Event; 185 SPI6_FAULT — SPI6 Fault; 186 SPI6_RX — SPI6 Receive Done; 187 SPI6_TX — SPI6 Transmit Done; 188 UART6_FAULT — UART6 Fault; 189 UART6_RX — UART6 Receive Done; 190 UART6_TX — UART6 Transmit Done; 191 SDHC — SD Host Controller; 192 GLCD — Grapics LCD Controller; 193 GPU — Graphics Processing Unit; 195 CTMU — Charge Time Measurement Unit; 196 ADC_EOS — ADC End of Scan Ready; 197 ADC_ARDY — ADC Analog Circuits Ready; 198 ADC_URDY — ADC Update Ready; 199 ADC0_EARLY — ADC0 Early Interrupt Request; 200 ADC1_EARLY — ADC1 Early Interrupt Request; 201 ADC2_EARLY — ADC2 Early Interrupt Request; 202 ADC3_EARLY — ADC3 Early Interrupt Request; 203 ADC4_EARLY — ADC4 Early Interrupt Request; 205 ADC_EARLY — ADC Group Early Interrupt Request; 206 ADC7_EARLY — ADC7 Early Interrupt Request; 207 ADC0_WARM — ADC0 Warm Interrupt Request; 208 ADC1_WARM — ADC1 Warm Interrupt Request; 209 ADC2_WARM — ADC2 Warm Interrupt Request; 210 ADC3_WARM — ADC3 Warm Interrupt Request; 211 ADC4_WARM — ADC4 Warm Interrupt Request; 214 ADC7_WARM — ADC7 Warm Interrupt Request; 215 MPLL_FAULT — MPLL Fault
