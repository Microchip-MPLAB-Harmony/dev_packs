# ATSAMD51P20A device description
Architecture: CORTEX-M4; Family: SAMD; Series: SAMD51
Parameters: GCLK_ID_TRACE=47 (Index of Trace Generic Clock), NUM_IRQ=137 (Number of interrupt request lines), __CM4_REV=0x0001 (Cortex-M4 Core Revision), __DEBUG_LVL=3 (Debug Level), __FPU_PRESENT=1 (FPU present or not), __MPU_PRESENT=1 (MPU present or not), __NVIC_PRIO_BITS=3 (Number of Bits used for Priority Levels), __TRACE_LVL=2 (Trace Level), __VTOR_PRESENT=1 (Vector Table Offset Register present or not), __Vendor_SysTickConfig=0 (Set to 1 if different SysTick Config is used), __ARCH_ARM=1, __ARCH_ARM_CORTEX_M=1, __DEVICE_IS_SAM=1
Programming and debug interfaces: SWD
Registers are 32-bit, read-write, reset 0x0 unless marked. A register's access mark holds for its fields unless they carry their own. Offsets are from the block's base; lines under a group give offsets from that group; [hi:lo] are bit positions; {n}, {i} and the like mark numbered series; 'fields as' and 'values as' point back to an identical list; <NAME> marks a mode.

## Ordering variants
ATSAMD51P20A-CTU: TFBGA120, pinout SAMD51PC, up to 120 MHz, -40 to 85 C, 1.71 to 3.60 V
ATSAMD51P20A-CTF: TFBGA120, pinout SAMD51PC, up to 100 MHz, -40 to 125 C, 1.71 to 3.60 V
ATSAMD51P20A-AU: TQFP128, pinout SAMD51P, up to 120 MHz, -40 to 85 C, 1.71 to 3.60 V
ATSAMD51P20A-AF, ATSAMD51P20A-AZ: TQFP128, pinout SAMD51P, up to 100 MHz, -40 to 125 C, 1.71 to 3.60 V

## Memory
base space: start 0 size 0x100000000, little endian
  0x00000000 FLASH size 0x100000 flash, rw, executable, page 512
  0x00800080 SW0 size 0x10 fuses, ro
  0x00800100 TEMP_LOG size 0x200 fuses, rw, page 512
  0x00804000 USER_PAGE size 0x200 user_page, rw, page 512
  0x03000000 CMCC size 0x1000000 io, rw
  0x3000000 CMCC_DATARAM size 0x1000 io, rw
  0x3001000 CMCC_TAGRAM size 0x400 io, rw
  0x3002000 CMCC_VALIDRAM size 0x40 io, rw
  0x04000000 QSPI size 0x1000000 other, rw, executable, external
  0x20000000 HSRAM size 0x40000 ram, rw, executable
  0x20000000 HSRAM_ETB size 0x8000 ram, rw, executable
  0x20000000 HSRAM_RET1 size 0x8000 ram, rw, executable
  0x40000000 HPB0 size 0x4400 io, rw
  0x41000000 HPB1 size 0x22000 io, rw
  0x42000000 HPB2 size 0x3C00 io, rw
  0x43000000 HPB3 size 0x3000 io, rw
  0x44000000 SEEPROM size 0x20000 io, rw
  0x45000000 SDHC0 size 0xC00 io, rw
  0x46000000 SDHC1 size 0xC00 io, rw
  0x47000000 BKUPRAM size 0x2000 ram, rw, executable
  0xE0000000 PPB size 0x100000 io, rw
  0xE000E000 SCS size 0x00001000 io, rw
fuses space: start 0x00000000 size 0x20000000, little endian

## Notices in the file
Copyright (c) 2018 Microchip Technology Inc.
SPDX-License-Identifier: Apache-2.0
Licensed under the Apache License, Version 2.0 (the "License");
you may not use this file except in compliance with the License.
You may obtain a copy of the License at
http://www.apache.org/licenses/LICENSE-2.0
Unless required by applicable law or agreed to in writing, software
distributed under the License is distributed on an "AS IS" BASIS,
WITHOUT WARRANTIES OR CONDITIONS OF ANY KIND, either express or implied.
See the License for the specific language governing permissions and
limitations under the License.
