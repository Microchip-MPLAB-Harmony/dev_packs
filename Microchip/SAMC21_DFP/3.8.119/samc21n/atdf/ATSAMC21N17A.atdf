# ATSAMC21N17A device description
Architecture: CORTEX-M0PLUS; Family: SAMC; Series: SAMC21
Parameters: NUM_IRQ=31 (Number of interrupt request lines), __CM0PLUS_REV=0x0001 (Cortex-M0+ Core Revision), __MPU_PRESENT=1 (MPU present or not), __NVIC_PRIO_BITS=2 (Number of Bits used for Priority Levels), __VTOR_PRESENT=1 (Vector Table Offset Register present or not), __Vendor_SysTickConfig=0 (Set to 1 if different SysTick Config is used), __ARCH_ARM=1, __ARCH_ARM_CORTEX_M=1, __DEVICE_IS_SAM=1
Programming and debug interfaces: SWD
Registers are 32-bit, read-write, reset 0x0 unless marked. A register's access mark holds for its fields unless they carry their own. Offsets are from the block's base; lines under a group give offsets from that group; [hi:lo] are bit positions; {n}, {i} and the like mark numbered series; 'fields as' and 'values as' point back to an identical list; <NAME> marks a mode.

## Ordering variants
ATSAMC21N17A-MN: QFN100, pinout SAMC21N, up to 48 MHz, -40 to 105 C, 2.7 to 5.5 V
ATSAMC21N17A-AN: TQFP100, pinout SAMC21N, up to 48 MHz, -40 to 105 C, 2.7 to 5.5 V

## Memory
base space: start 0 size 0x100000000, little endian
  0x00000000 FLASH size 0x20000 flash, rw, executable, page 64
  0x00800000 CAL size 0x8 fuses, ro
  0x00802000 LOCKBIT size 0x4 fuses, ro
  0x00806000 OTP1 size 0x8 fuses, ro
  0x00806008 OTP2 size 0x8 fuses, ro
  0x00806010 OTP3 size 0x8 fuses, ro
  0x00806018 OTP4 size 0x8 fuses, ro
  0x00806020 OTP5 size 0x8 fuses, ro
  0x00806030 TEMP_LOG size 0x8 fuses, ro
  0x00804000 USER_PAGE size 0x100 user_page, rw, page 64
  0x00400000 RWW size 0x1000 flash, rw, executable, page 64
  0x20000000 HSRAM size 0x4000 ram, rw, executable
  0x40000000 HPB0 size 0x4000 io, rw
  0x41000000 HPB1 size 0x10000 io, rw
  0x42000000 HPB2 size 0x8000 io, rw
  0x43000000 HPB3 size 0x8000 io, rw
  0x48000000 DIVAS size 0x20 io, rw
  0xE0000000 PPB size 0x100000 io, rw
  0xE000E000 SCS size 0x00001000 io, rw
  0x40000000 PERIPHERALS size 0x20000000 io, rw
fuses space: start 0x00000000 size 0x20000000, little endian

## Peripheral instances (address, pins/pin function, parameters)
AC at 0x42005000
  pins: AIN0 PA04/B; AIN1 PA05/B; AIN2 PA06/B; AIN3 PA07/B; AIN4 PA02/B; AIN5 PB04/B; AIN6 PB05/B; AIN7 PB06/B; CMP0 PA12/H or PA18/H or PB24/H; CMP1 PA13/H or PA19/H or PB25/H; CMP2 PA00/H or PA24/H or PB30/H; CMP3 PA01/H or PA25/H or PB31/H
  parameters: COMPCTRL_MUXNEG_OPAMP=7 (OPAMP selection for MUXNEG), GCLK_ID=40 (Index of Generic Clock), NUM_CMP=4 (Number of comparators), PAIRS=2 (Number of pairs of comparators), SPEED_LEVELS=2 (Number of speed values), INSTANCE_ID=84
ADC0 at 0x42004400 (ADC)
  pins: AIN0 PA02/B; AIN1 PA03/B; AIN2 PB08/B; AIN3 PB09/B; AIN4 PA04/B; AIN5 PA05/B; AIN6 PA06/B; AIN7 PA07/B; AIN8 PC00/B; AIN9 PC01/B; AIN10 PC02/B; AIN11 PC03/B; VREFP PA03/B
  parameters: DMAC_ID_RESRDY=42 (index of DMA RESRDY trigger), EXTCHANNEL_MSB=11 (Number of external channels), GCLK_ID=33 (index of Generic Clock), INT_CH30=0 (Select OPAMP or CTAT on Channel 30), MASTER_SLAVE_MODE=1 (ADC Master/Slave Mode), LOAD_CALIB=1 (CALIB register to be loaded from NVM), INSTANCE_ID=81
ADC1 at 0x42004800 (ADC)
  pins: AIN0 PB00/B; AIN1 PB01/B; AIN2 PB02/B; AIN3 PB03/B; AIN4 PB08/B; AIN5 PB09/B; AIN6 PB04/B; AIN7 PB05/B; AIN8 PB06/B; AIN9 PB07/B; AIN10 PA08/B; AIN11 PA09/B
  parameters: DMAC_ID_RESRDY=43 (index of DMA RESRDY trigger), EXTCHANNEL_MSB=11 (Number of external channels), GCLK_ID=34 (index of Generic Clock), INT_CH30=0 (Select OPAMP or CTAT on Channel 30), MASTER_SLAVE_MODE=2 (ADC Master/Slave Mode), LOAD_CALIB=1 (CALIB register to be loaded from NVM), INSTANCE_ID=82
CAN0 at 0x42001C00 (CAN)
  pins: RX PA23/G or PA25/G; TX PA22/G or PA24/G
  parameters: DMAC_ID_DEBUG=14 (DMA CAN Debug Req), GCLK_ID=26 (Index of Generic Clock), MSG_RAM_ADDR=0x200000000, QOS_RESET_VAL=2 (QOS reset value), INSTANCE_ID=71
CAN1 at 0x42002000 (CAN)
  pins: RX PB13/G or PB15/G; TX PB12/G or PB14/G
  parameters: DMAC_ID_DEBUG=15 (DMA CAN Debug Req), GCLK_ID=27 (Index of Generic Clock), MSG_RAM_ADDR=0x200000000, QOS_RESET_VAL=2 (QOS reset value), INSTANCE_ID=72
CCL at 0x42005C00
  pins: IN0 PA04/I or PA16/I or PB22/I; IN1 PA05/I or PA17/I or PB00/I; IN2 PA06/I or PA18/I or PB01/I; IN3 PA08/I or PA30/I; IN4 PA09/I or PC27/I; IN5 PA10/I or PB10/I or PC28/I; IN6 PA22/I or PB06/I; IN7 PB07/I or PA23/I; IN8 PB08/I or PA24/I; IN9 PB14/I or PC20/I; IN10 PB15/I or PC21/I; IN11 PB16/I; OUT0 PA07/I or PA19/I or PB02/I or PB23/I; OUT1 PA11/I or PA31/I or PB11/I; OUT2 PA25/I or PB09/I; OUT3 PB17/I
  parameters: GCLK_ID=38 (GCLK index for CCL), LUT_NUM=4 (Number of LUT in a CCL), SEQ_NUM=2 (Number of SEQ in a CCL), INSTANCE_ID=87
DAC at 0x42005400
  pins: VOUT PA02/B; VREFP PA03/B
  parameters: DMAC_ID_EMPTY=45 (Index of DMA EMPTY trigger), GCLK_ID=36, INSTANCE_ID=85
DIVAS at 0x48000000
DMAC at 0x41006000
  parameters: CH_BITS=4 (Number of bits to select channel), CH_NUM=12 (Number of channels), EVIN_NUM=4 (Number of input events), EVOUT_NUM=4 (Number of output events), LVL_BITS=2 (Number of bit to select level priority), LVL_NUM=4 (Enable priority level number), QOSCTRL_D_RESETVALUE=2 (QOS dmac ahb interface reset value), QOSCTRL_F_RESETVALUE=2 (QOS dmac fetch interface reset value), QOSCTRL_WRB_RESETVALUE=2 (QOS dmac write back interface reset value), TRIG_BITS=6 (Number of bits to select trigger source), TRIG_NUM=62 (Number of peripheral triggers), INSTANCE_ID=35
DSU at 0x41002000
  parameters: INSTANCE_ID=33
EIC at 0x40002800
  pins: EXTINT0 PA16/A or PB00/A or PB16/A or PC08/A or PC24/A or PA00/A; EXTINT1 PA17/A or PB01/A or PB17/A or PC09/A or PC25/A or PA01/A; EXTINT2 PA02/A or PA18/A or PB02/A or PB18/A or PC10/A or PC26/A; EXTINT3 PA03/A or PA19/A or PB03/A or PB19/A or PC11/A or PC27/A; EXTINT4 PA04/A or PA20/A or PB04/A or PB20/A or PC12/A or PC28/A; EXTINT5 PA05/A or PA21/A or PB05/A or PB21/A or PC13/A; EXTINT6 PA06/A or PA22/A or PB06/A or PB22/A or PC14/A; EXTINT7 PA07/A or PA23/A or PB07/A or PB23/A or PC15/A; EXTINT8 PB08/A or PB24/A or PC00/A or PC16/A or PA28/A; EXTINT9 PA09/A or PB09/A or PB25/A or PC01/A or PC17/A; EXTINT10 PA10/A or PA30/A or PB10/A or PC02/A or PC18/A; EXTINT11 PA11/A or PA31/A or PB11/A or PC03/A or PC19/A; EXTINT12 PA12/A or PA24/A or PB12/A or PC20/A; EXTINT13 PA13/A or PA25/A or PB13/A or PC05/A or PC21/A; EXTINT14 PB14/A or PB30/A or PC06/A or PA14/A; EXTINT15 PA27/A or PB15/A or PB31/A or PC07/A or PA15/A; NMI PA08/A
  parameters: EXTINT_NUM=16 (Number of external interrupts), GCLK_ID=2 (Generic Clock index), NUMBER_OF_CONFIG_REGS=2 (Number of CONFIG registers), NUMBER_OF_DPRESCALER_REGS=2 (Number of DPRESCALER registers), NUMBER_OF_INTERRUPTS=16 (Number of external interrupts (obsolete)), INSTANCE_ID=10
EVSYS at 0x42000000
  parameters: CHANNELS=12 (Number of Channels), CHANNELS_BITS=4 (Number of bits to select Channel), CHANNELS_MSB=11 (Number of Channels - 1), EXTEVT_NUM=0 (Number of External Event Generators), GCLK_ID_{n}={n+6} (Index of Generic Clock {n}) (n=0..11), GENERATORS=96 (Total Number of Event Generators), GENERATORS_BITS=7 (Number of bits to select Event Generator), USERS=50 (Total Number of Event Users), USERS_BITS=6 (Number of bits to select Event User), INSTANCE_ID=64
FREQM at 0x40002C00
  parameters: GCLK_ID_MSR=3 (Index of measure generic clock), GCLK_ID_REF=4 (Index of reference generic clock), INSTANCE_ID=11
GCLK at 0x40001C00
  pins: IO0 PB14/H or PB22/H or PA14/H or PA27/H or PA28/H or PA30/H; IO1 PB23/H or PA15/H or PB15/H; IO2 PB16/H or PA16/H; IO3 PA17/H or PB17/H; IO4 PA10/H or PB10/H or PB18/H or PA20/H; IO5 PA11/H or PA21/H or PB11/H or PB19/H; IO6 PA22/H or PB12/H or PB20/H; IO7 PB13/H or PA23/H or PB21/H
  parameters: GENDIV_BITS=16, GEN_BITS=4, GEN_NUM=9 (Number of Generic Clock Generators), GEN_NUM_MSB=8 (Number of Generic Clock Generators - 1), GEN_SOURCE_NUM_MSB=7 (Number of Generic Clock Sources - 1), NUM=46 (Number of Generic Clock Users), SOURCE_BITS=3, SOURCE_DPLL96M=7, SOURCE_GCLKGEN1=2, SOURCE_GCLKIN=1, SOURCE_NUM=8 (Number of Generic Clock Sources), SOURCE_OSCULP32K=3, SOURCE_OSC32K=4, SOURCE_OSC48M=6, SOURCE_XOSC=0, SOURCE_XOSC32K=5, INSTANCE_ID=7
HMATRIXHS at 0x4100A000 (HMATRIXB)
  parameters: MASTER_NUM=3, MASTER_CM0PLUS=0, MASTER_DSU=1, MASTER_DMAC=2, SLAVE_NUM=9, SLAVE_FLASH=0, SLAVE_HSRAMCM0P=1, SLAVE_HSRAMDSU=2, SLAVE_HPB1=3, SLAVE_HPB0=4, SLAVE_HPB2=5, SLAVE_LPRAMDMAC=6, SLAVE_DIVAS=7, SLAVE_HPB3=8, INSTANCE_ID=37
MCLK at 0x40000800
  parameters: CTRLA_MCSEL_GCLK=1, CTRLA_MCSEL_OSC8M=0, MCLK_CLK_APB_NUM=4, SYSTEM_CLOCK=4000000 (System Clock Frequency at Reset), INSTANCE_ID=2
  clocks: AHB HPB0 bit 0, HPB1 bit 1, HPB2 bit 2, DSU bit 3, HMATRIXHS bit 4, NVMCTRL bit 5, HSRAM bit 6, DMAC bit 7, CAN0 bit 8, CAN1 bit 9, PAC bit 10, NVMCTRL_PICACHU bit 11, DIVAS bit 12, HPB3 bit 13
MTB at 0x41008000
  parameters: INSTANCE_ID=36
NVMCTRL at 0x41004000
  pins: MARGIN VMARGIN
  parameters: FACTORY_WORD_IMPLEMENTED_MASK=0XC0000007FFFFFFFF, GCLK_ID=39 (Index of Generic Clock for test), PMSB=3, PSZ_BITS=6, USER_PAGE_OFFSET=0x00800000, USER_WORD_IMPLEMENTED_MASK=0XC01FFFFFFFFFFFFF, RWWEE_PAGES=128, RWWEE_ROW_SIZE=256, RWW_EEPROM_ADDR=0x00400000 (Start address of the WWR EEPROM area), RWW_EEPROM_SIZE=4096 (Byte size of the WWR EEPROM area), FLASH_SIZE=131072, PAGE_SIZE=64, PAGES=2048, PAGES_PR_REGION=128, ROW_SIZE=256, PSM_0_FRMFW_FWS_1_MAX_FREQ=12000000, PSM_0_FRMLP_FWS_0_MAX_FREQ=18000000, PSM_0_FRMLP_FWS_1_MAX_FREQ=36000000, PSM_0_FRMHS_FWS_0_MAX_FREQ=25000000, PSM_0_FRMHS_FWS_1_MAX_FREQ=50000000, PSM_1_FRMFW_FWS_1_MAX_FREQ=12000000, PSM_1_FRMLP_FWS_0_MAX_FREQ=8000000, PSM_1_FRMLP_FWS_1_MAX_FREQ=12000000, INSTANCE_ID=34
FUSES at OTP3_FUSES 0x00806010 in fuses, OTP5_FUSES 0x00806020 in fuses, TEMP_LOG_FUSES 0x00806030 in fuses, USER_FUSES 0x00804000 in fuses
OSCCTRL at 0x40001000
  pins: XIN PA14/XIN; XOUT PA15/XOUT
  parameters: GCLK_ID_FDPLL=0 (Index of Generic Clock for DPLL), GCLK_ID_FDPLL32K=1 (Index of Generic Clock for DPLL 32K), FDPLL_VERSION=0x211, OSC48M_VERSION=0x101, XOSC_VERSION=0x201, INSTANCE_ID=4
OSC32KCTRL at 0x40001400
  pins: XIN32 PA00/XIN32; XOUT32 PA01/XOUT32
  parameters: OSC32K_COARSE_CALIB_MSB=6, INSTANCE_ID=5
PAC at 0x40000000
  parameters: HPB_NUM=4 (Number of bridges AHB/APB), INTFLAG_NUM=4 (Number of intflag registers), INSTANCE_ID=0
PM at 0x40000400
  pins: RESET_N RESET_N
  parameters: BIAS_RAM_HS=1 (one if RAM HS can be back biased), PD_NUM=0 (Number of switchable Power Domain), INSTANCE_ID=1
PORT at 0x41000000, PORT_IOBUS 0x60000000
  pins: P{n} PA{n:02} (n=0..25); P27 PA27; P28 PA28; P30 PA30; P31 PA31; P{n} PB{n-32:02} (n=32..57); P62 PB30; P63 PB31; P64 PC00; P65 PC01; P66 PC02; P67 PC03; P{n} PC{n-64:02} (n=69..85); P88 PC24; P89 PC25; P90 PC26; P91 PC27; P92 PC28
  parameters: BITS=93, DRVSTR=1 (DRVSTR supported), EV_NUM=4, GROUPS=3, ODRAIN=0 (ODRAIN supported), SLEWLIM=0 (SLEWLIM supported), INSTANCE_ID=32
PTC at 0x42005800
  pins: X0 PA08/B; X1 PA09/B; X2 PA10/B; X3 PA11/B; X{n} PA{n+12}/B (n=4..11); X12 PB12/B; X13 PB13/B; X14 PB14/B; X15 PB15/B; Y0 PA02/B; Y1 PA03/B; Y2 PA04/B; Y3 PA05/B; Y4 PA06/B; Y5 PA07/B; Y{n} PB{n-6:02}/B (n=6..15); Y16 PA08/B; Y17 PA09/B; Y18 PA10/B; Y19 PA11/B; Y{n} PA{n-4}/B (n=20..27); Y28 PB12/B; Y29 PB13/B; Y30 PB14/B; Y31 PB15/B
  parameters: DMAC_ID_EOC=46 (Index of DMA EOC trigger), DMAC_ID_SEQ=48 (Index of DMA SEQ trigger), DMAC_ID_WCOMP=47 (Index of DMA WCOMP trigger), GCLK_ID=37 (Index of Generic Clock), X_LINES_NUM=16 (Number of X lines), Y_LINES_NUM=32 (Number of Y lines), SELF_CAP_CHANNELS_NUM=32 (Number of self-capacitance channels), MUTUAL_CAP_CHANNELS_NUM=256 (Number of mutual-capacitance channels), INSTANCE_ID=86
RSTC at 0x40000C00
  pins: EXTWAKE{n} PA{n:02}/A (n=0..15)
  parameters: NUMBER_OF_EXTWAKE=0 (number of external wakeup line), INSTANCE_ID=3
RTC at 0x40002400
  parameters: ALARM_NUM=1 (Number of Alarms), COMP16_NUM=2 (Number of 16-bit Comparators), COMP32_NUM=1 (Number of 32-bit Comparators), GPR_NUM=0 (Number of General-Purpose Registers), PER_NUM=8 (Number of Periodic Intervals), INSTANCE_ID=9
SDADC at 0x42004C00
  pins: INN0 PA06/B; INN1 PB08/B; INN2 PB06/B; INP0 PA07/B; INP1 PB09/B; INP2 PB07/B; VREFP PA04/B
  parameters: DMAC_ID_RESRDY=44 (Index of DMA RESRDY trigger), EXT_CHANNELS=3 (Number of external channels), GCLK_ID=35 (Index of generic clock), INSTANCE_ID=83
SERCOM0 at 0x42000400 (SERCOM)
  pins: PAD0 PA04/D or PA08/C or PB24/C; PAD1 PA05/D or PA09/C or PB25/C; PAD2 PA06/D or PB22/C or PA10/C or PC24/C; PAD3 PA07/D or PA11/C or PB23/C or PC25/C
  parameters: DMAC_ID_RX=2 (Index of DMA RX trigger), DMAC_ID_TX=3 (Index of DMA TX trigger), GCLK_ID_CORE=19, GCLK_ID_SLOW=18, INT_MSB=6, PMSB=3, INSTANCE_ID=65
SERCOM1 at 0x42000800 (SERCOM)
  pins: PAD0 PC27/D or PA16/C or PB30/C or PA00/D; PAD1 PC28/D or PA17/C or PB31/C or PA01/D; PAD2 PA30/D or PA18/C; PAD3 PA31/D or PA19/C
  parameters: DMAC_ID_RX=4 (Index of DMA RX trigger), DMAC_ID_TX=5 (Index of DMA TX trigger), GCLK_ID_CORE=20, GCLK_ID_SLOW=18, INT_MSB=6, PMSB=3, INSTANCE_ID=66
SERCOM2 at 0x42000C00 (SERCOM)
  pins: PAD0 PA08/D or PB20/D or PA12/C; PAD1 PA09/D or PB21/D or PA13/C; PAD2 PA10/D or PA14/C; PAD3 PA11/D or PA15/C
  parameters: DMAC_ID_RX=6 (Index of DMA RX trigger), DMAC_ID_TX=7 (Index of DMA TX trigger), GCLK_ID_CORE=21, GCLK_ID_SLOW=18, INT_MSB=6, PMSB=3, INSTANCE_ID=67
SERCOM3 at 0x42001000 (SERCOM)
  pins: PAD0 PA16/D or PA22/C or PB20/C; PAD1 PA17/D or PA23/C or PB21/C; PAD2 PA18/D or PB18/D or PA20/D or PA24/C; PAD3 PA19/D or PA25/C or PA21/D or PB19/D
  parameters: DMAC_ID_RX=8 (Index of DMA RX trigger), DMAC_ID_TX=9 (Index of DMA TX trigger), GCLK_ID_CORE=22, GCLK_ID_SLOW=18, INT_MSB=6, PMSB=3, INSTANCE_ID=68
SERCOM4 at 0x42001400 (SERCOM)
  pins: PAD0 PA12/D or PB24/D or PB12/C; PAD1 PA13/D or PB09/D or PB25/D or PB13/C; PAD2 PA14/D or PB10/D or PB14/C or PC24/D; PAD3 PA15/D or PB11/D or PC25/D or PB15/C
  parameters: DMAC_ID_RX=10 (Index of DMA RX trigger), DMAC_ID_TX=11 (Index of DMA TX trigger), GCLK_ID_CORE=23, GCLK_ID_SLOW=18, INT_MSB=6, PMSB=3, INSTANCE_ID=69
SERCOM5 at 0x42001800 (SERCOM)
  pins: PAD0 PA22/D or PB02/D or PB16/C or PB30/D; PAD1 PB03/D or PB31/D or PB17/C or PA23/D; PAD2 PB00/D or PB22/D or PB18/C or PA24/D or PA20/C; PAD3 PA25/D or PB01/D or PB23/D or PA21/C or PB19/C
  parameters: DMAC_ID_RX=12 (Index of DMA RX trigger), DMAC_ID_TX=13 (Index of DMA TX trigger), GCLK_ID_CORE=25, GCLK_ID_SLOW=24, INT_MSB=6, PMSB=3, INSTANCE_ID=70
SERCOM6 at 0x43000000 (SERCOM)
  pins: PAD0 PC06/C or PC16/C or PC08/C; PAD1 PC07/C or PC17/C or PC09/C; PAD2 PC18/C or PC10/C; PAD3 PC05/C or PC11/C or PC19/C
  parameters: DMAC_ID_RX=49 (Index of DMA RX trigger), DMAC_ID_TX=50 (Index of DMA TX trigger), GCLK_ID_CORE=41, GCLK_ID_SLOW=18, INT_MSB=6, PMSB=3, INSTANCE_ID=96
SERCOM7 at 0x43000400 (SERCOM)
  pins: PAD0 PC08/D or PC03/C or PC12/C; PAD1 PC09/D or PB06/C or PC13/C; PAD2 PB07/D or PC10/D or PB08/C or PC14/C; PAD3 PB08/D or PC11/D or PB07/C or PC15/C
  parameters: DMAC_ID_RX=51 (Index of DMA RX trigger), DMAC_ID_TX=52 (Index of DMA TX trigger), GCLK_ID_CORE=42, GCLK_ID_SLOW=18, INT_MSB=6, PMSB=3, INSTANCE_ID=97
SUPC at 0x40001800
  parameters: BODCORE_CALIB_MSB=5, BODVDD_CALIB_MSB=5, SUPC_OUT_NUM_MSB=1 (MSB of backup output pad Number), INSTANCE_ID=6
TC0 at 0x42003000 (TC)
  pins: WO0 PA08/E or PA04/E or PB30/E; WO1 PA09/E or PA05/E or PB31/E
  parameters: CC_NUM=2, DMAC_ID_OVF=27 (Indexes of DMA Overflow trigger), DMAC_ID_MC0=28 (Indexes of DMA Match/Compare 0 trigger), DMAC_ID_MC1=29 (Indexes of DMA Match/Compare 1 trigger), EXT=0 (Coding of implemented extended features (keep 0 value)), GCLK_ID=30 (Index of Generic Clock), MASTER_SLAVE_MODE=1 (TC type 0 : NA, 1 : Master, 2 : Slave), OW_NUM=2 (Number of Output Waveforms), INSTANCE_ID=76
TC1 at 0x42003400 (TC)
  pins: WO0 PA10/E or PA06/E or PA30/E; WO1 PA11/E or PA07/E or PA31/E
  parameters: CC_NUM=2, DMAC_ID_OVF=30 (Indexes of DMA Overflow trigger), DMAC_ID_MC0=31 (Indexes of DMA Match/Compare 0 trigger), DMAC_ID_MC1=32 (Indexes of DMA Match/Compare 1 trigger), EXT=0 (Coding of implemented extended features (keep 0 value)), GCLK_ID=30 (Index of Generic Clock), MASTER_SLAVE_MODE=2 (TC type 0 : NA, 1 : Master, 2 : Slave), OW_NUM=2 (Number of Output Waveforms), INSTANCE_ID=77
TC2 at 0x42003800 (TC)
  pins: WO0 PA12/E or PA16/E or PA00/E; WO1 PA01/E or PA13/E or PA17/E
  parameters: CC_NUM=2, DMAC_ID_OVF=33 (Indexes of DMA Overflow trigger), DMAC_ID_MC0=34 (Indexes of DMA Match/Compare 0 trigger), DMAC_ID_MC1=35 (Indexes of DMA Match/Compare 1 trigger), EXT=0 (Coding of implemented extended features (keep 0 value)), GCLK_ID=31 (Index of Generic Clock), MASTER_SLAVE_MODE=1 (TC type 0 : NA, 1 : Master, 2 : Slave), OW_NUM=2 (Number of Output Waveforms), INSTANCE_ID=78
TC3 at 0x42003C00 (TC)
  pins: WO0 PA18/E or PA14/E; WO1 PA15/E or PA19/E
  parameters: CC_NUM=2, DMAC_ID_OVF=36 (Indexes of DMA Overflow trigger), DMAC_ID_MC0=37 (Indexes of DMA Match/Compare 0 trigger), DMAC_ID_MC1=38 (Indexes of DMA Match/Compare 1 trigger), EXT=0 (Coding of implemented extended features (keep 0 value)), GCLK_ID=31 (Index of Generic Clock), MASTER_SLAVE_MODE=2 (TC type 0 : NA, 1 : Master, 2 : Slave), OW_NUM=2 (Number of Output Waveforms), INSTANCE_ID=79
TC4 at 0x42004000 (TC)
  pins: WO0 PB12/E or PA22/E or PB08/E; WO1 PB09/E or PA23/E or PB13/E
  parameters: CC_NUM=2, DMAC_ID_OVF=39 (Indexes of DMA Overflow trigger), DMAC_ID_MC0=40 (Indexes of DMA Match/Compare 0 trigger), DMAC_ID_MC1=41 (Indexes of DMA Match/Compare 1 trigger), EXT=0 (Coding of implemented extended features (keep 0 value)), GCLK_ID=32 (Index of Generic Clock), MASTER_SLAVE_MODE=0 (TC type 0 : NA, 1 : Master, 2 : Slave), OW_NUM=2 (Number of Output Waveforms), INSTANCE_ID=80
TC5 at 0x43000800 (TC)
  pins: WO0 PB14/E or PA24/E or PB10/E; WO1 PA25/E or PB11/E or PB15/E
  parameters: CC_NUM=2, DMAC_ID_OVF=53 (Indexes of DMA Overflow trigger), DMAC_ID_MC0=54 (Indexes of DMA Match/Compare 0 trigger), DMAC_ID_MC1=55 (Indexes of DMA Match/Compare 1 trigger), EXT=0 (Coding of implemented extended features (keep 0 value)), GCLK_ID=43 (Index of Generic Clock), MASTER_SLAVE_MODE=0 (TC type 0 : NA, 1 : Master, 2 : Slave), OW_NUM=2 (Number of Output Waveforms), INSTANCE_ID=98
TC6 at 0x43000C00 (TC)
  pins: WO0 PB16/E or PB02/E; WO1 PB17/E or PB03/E
  parameters: CC_NUM=2, DMAC_ID_OVF=56 (Indexes of DMA Overflow trigger), DMAC_ID_MC0=57 (Indexes of DMA Match/Compare 0 trigger), DMAC_ID_MC1=58 (Indexes of DMA Match/Compare 1 trigger), EXT=0 (Coding of implemented extended features (keep 0 value)), GCLK_ID=44 (Index of Generic Clock), MASTER_SLAVE_MODE=0 (TC type 0 : NA, 1 : Master, 2 : Slave), OW_NUM=2 (Number of Output Waveforms), INSTANCE_ID=99
TC7 at 0x43001000 (TC)
  pins: WO0 PB22/E or PA20/E or PB00/E; WO1 PB01/E or PA21/E or PB23/E
  parameters: CC_NUM=2, DMAC_ID_OVF=59 (Indexes of DMA Overflow trigger), DMAC_ID_MC0=60 (Indexes of DMA Match/Compare 0 trigger), DMAC_ID_MC1=61 (Indexes of DMA Match/Compare 1 trigger), EXT=0 (Coding of implemented extended features (keep 0 value)), GCLK_ID=45 (Index of Generic Clock), MASTER_SLAVE_MODE=0 (TC type 0 : NA, 1 : Master, 2 : Slave), OW_NUM=2 (Number of Output Waveforms), INSTANCE_ID=100
TCC0 at 0x42002400 (TCC)
  pins: WO0 PA08/F; WO1 PA09/F; WO2 PA10/F; WO3 PA11/F; WO4 PB10/F; WO5 PB11/F; WO6 PA12/F or PB12/F; WO7 PA13/F or PB13/F
  parameters: CC_NUM=4 (Number of Compare/Capture units), DITHERING=1 (Dithering feature implemented), DMAC_ID_OVF=16 (DMA overflow/underflow/retrigger trigger), DMAC_ID_MC0=17 (Indexes of DMA Match/Compare 0 trigger), DMAC_ID_MC1=18 (Indexes of DMA Match/Compare 1 trigger), DMAC_ID_MC2=19 (Indexes of DMA Match/Compare 2 trigger), DMAC_ID_MC3=20 (Indexes of DMA Match/Compare 3 trigger), DTI=1 (Dead-Time-Insertion feature implemented), EXT=31 (Coding of implemented extended features), GCLK_ID=28 (Index of Generic Clock), MASTER_SLAVE_MODE=1 (TCC type 0 : NA, 1 : Master, 2 : Slave), OTMX=1 (Output Matrix feature implemented), OW_NUM=8 (Number of Output Waveforms), PG=1 (Pattern Generation feature implemented), SIZE=24, SWAP=1 (DTI outputs swap feature implemented), INSTANCE_ID=73
TCC1 at 0x42002800 (TCC)
  pins: WO0 PA16/F or PA22/F; WO1 PA17/F or PA23/F; WO2 PA18/F or PB22/F; WO3 PA19/F or PB23/F
  parameters: CC_NUM=2 (Number of Compare/Capture units), DITHERING=1 (Dithering feature implemented), DMAC_ID_OVF=21 (DMA overflow/underflow/retrigger trigger), DMAC_ID_MC0=22 (Indexes of DMA Match/Compare 0 trigger), DMAC_ID_MC1=23 (Indexes of DMA Match/Compare 1 trigger), DTI=0 (Dead-Time-Insertion feature implemented), EXT=24 (Coding of implemented extended features), GCLK_ID=28 (Index of Generic Clock), MASTER_SLAVE_MODE=2 (TCC type 0 : NA, 1 : Master, 2 : Slave), OTMX=0 (Output Matrix feature implemented), OW_NUM=4 (Number of Output Waveforms), PG=1 (Pattern Generation feature implemented), SIZE=24, SWAP=0 (DTI outputs swap feature implemented), INSTANCE_ID=74
TCC2 at 0x42002C00 (TCC)
  pins: WO0 PC03/F or PA20/F or PA24/F; WO1 PA25/F or PA21/F or PC05/F
  parameters: CC_NUM=2 (Number of Compare/Capture units), DITHERING=0 (Dithering feature implemented), DMAC_ID_OVF=24 (DMA overflow/underflow/retrigger trigger), DMAC_ID_MC0=25 (Indexes of DMA Match/Compare 0 trigger), DMAC_ID_MC1=26 (Indexes of DMA Match/Compare 1 trigger), DTI=0 (Dead-Time-Insertion feature implemented), EXT=0 (Coding of implemented extended features), GCLK_ID=29 (Index of Generic Clock), MASTER_SLAVE_MODE=0 (TCC type 0 : NA, 1 : Master, 2 : Slave), OTMX=0 (Output Matrix feature implemented), OW_NUM=2 (Number of Output Waveforms), PG=0 (Pattern Generation feature implemented), SIZE=16, SWAP=0 (DTI outputs swap feature implemented), INSTANCE_ID=75
TSENS at 0x40003000
  parameters: DMAC_ID_RESRDY=1 (Index of DMA RESRDY trigger), GCLK_ID=5 (Index of Generic Clock), INSTANCE_ID=12
WDT at 0x40002000
  parameters: INSTANCE_ID=8
MPU at 0xE000ED90
NVIC at 0xE000E100
  parameters: NUM_IRQ=31 (Number of interrupt requests), __NVIC_PRIO_BITS=2 (Number of NVIC interrupt priority bits)
SysTick at 0xE000E010
SystemControl at 0xE000E000
  parameters: __VTOR_PRESENT=1 (Vector Table Offset Register present)

## Interrupts
-15 Reset — Reset Vector, invoked on Power up and warm reset
-14 NonMaskableInt — Non maskable Interrupt, cannot be stopped or preempted
-13 HardFault — Hard Fault, all classes of Fault
-5 SVCall — System Service Call via SVC instruction
-2 PendSV — Pendable request for system service
-1 SysTick — System Tick Timer
0 SYSTEM (MCLK OSCCTRL OSC32KCTRL PAC SUPC) — System peripherals shared interrupt
1 WDT — Watchdog Timer
2 RTC — Real Time Counter
3 EIC — External Interrupt Controller
4 FREQM — Frequency Meter
5 TSENS — Temperature Sensor
6 NVMCTRL — Non-Volatile Memory Controller
7 DMAC — Direct Memory Controller
8 EVSYS — Event Systems
9 SERCOM0_6 (SERCOM0 SERCOM6) — Serial Communication Interface 0_6
10 SERCOM1_7 (SERCOM1 SERCOM7) — Serial Communication Interface 1_7
11 SERCOM2 — Serial Communication Interface 2
12 SERCOM3 — Serial Communication Interface 3
13 SERCOM4 — Serial Communication Interface 4
14 SERCOM5 — Serial Communication Interface 5
15 CAN0 — Control Area Network 0
16 CAN1 — Control Area Network 1
17 TCC0 — Timer/Counter for Control Applications 0
18 TCC1 — Timer/Counter for Control Applications 1
19 TCC2 — Timer/Counter for Control Applications 2
20 TC0_5 (TC0 TC5) — Timer/Counter 0_5
21 TC1_6 (TC1 TC6) — Timer/Counter 1_6
22 TC2_7 (TC2 TC7) — Timer/Counter 2_7
23 TC3 — Timer/Counter 3
24 TC4 — Timer/Counter 4
25 ADC0 — Analog-to-Digital Converter 0
26 ADC1 — Analog-to-Digital Converter 1
27 AC — Analog Comparators
28 DAC — Digital-to-Analog Converter
29 SDADC — Sigma-Delat Analog-to-Digital Converter
30 PTC — Peripheral Touch Controller

## Event generators
1 OSCCTRL_XOSC_FAIL, 2 OSC32KCTRL_XOSC32K_FAIL, 3 RTC_CMP_0, 4 RTC_CMP_1, 5 RTC_OVF, {n+6} RTC_PER_{n} (n=0..7), {n+14} EIC_EXTINT_{n} (n=0..15), 30 TSENS_WINMON, {n+31} DMAC_CH_{n} (n=0..3), 35 TCC0_OVF, 36 TCC0_TRG, 37 TCC0_CNT, {n+38} TCC0_MC_{n} (n=0..3), 42 TCC1_OVF, 43 TCC1_TRG, 44 TCC1_CNT, 45 TCC1_MC_0, 46 TCC1_MC_1, 47 TCC2_OVF, 48 TCC2_TRG, 49 TCC2_CNT, 50 TCC2_MC_0, 51 TCC2_MC_1, {3n+52} TC{n}_OVF (n=0..4), {3n+53} TC{n}_MC_0 (n=0..4), {3n+54} TC{n}_MC_1 (n=0..4), 67 ADC0_RESRDY, 68 ADC0_WINMON, 69 ADC1_RESRDY, 70 ADC1_WINMON, 71 SDADC_RESRDY, 72 SDADC_WINMON, {n+73} AC_COMP_{n} (n=0..3), 77 AC_WIN_0, 78 AC_WIN_1, 79 DAC_EMPTY, 80 PTC_EOC, 81 PTC_WIN_COMP, {n+82} CCL_LUTOUT_{n} (n=0..3), 86 PAC_ACCERR, {3n+73} TC{n}_OVF (n=5..7), {3n+74} TC{n}_MC_0 (n=5..7), {3n+75} TC{n}_MC_1 (n=5..7)

## Event users
0 TSENS_START, {n+1} PORT_EV_{n} (n=0..3), {n+5} DMAC_CH_{n} (n=0..3), 9 TCC0_EV_0, 10 TCC0_EV_1, {n+11} TCC0_MC_{n} (n=0..3), 15 TCC1_EV_0, 16 TCC1_EV_1, 17 TCC1_MC_0, 18 TCC1_MC_1, 19 TCC2_EV_0, 20 TCC2_EV_1, 21 TCC2_MC_0, 22 TCC2_MC_1, {n+23} TC{n}_EVU (n=0..4), 28 ADC0_START, 29 ADC0_SYNC, 30 ADC1_START, 31 ADC1_SYNC, 32 SDADC_START, 33 SDADC_FLUSH, {n+34} AC_SOC_{n} (n=0..3), 38 DAC_START, {n+40} CCL_LUTIN_{n} (n=0..3), 45 MTB_START, 46 MTB_STOP, {n+42} TC{n}_EVU (n=5..7)

## Properties
SIGNATURES: DSU_DID=0x11011421

## Pinouts (pin number, pad)
SAMC21N: 1 PA00, 2 PA01, 3 PC00, 4 PC01, 5 PC02, 6 PC03, 7 PA02, 8 PA03, 9 PB04, 10 PB05, 11 GNDANA, 12 VDDANA, 13 PB06, 14 PB07, 15 PB08, 16 PB09, 17 PA04, 18 PA05, 19 PA06, 20 PA07, 21 PC05, 22 PC06, 23 PC07, 24 GNDIO, 25 VDDIO, 26 PA08, 27 PA09, 28 PA10, 29 PA11, 30 PB10, 31 PB11, 32 PB12, 33 PB13, 34 PB14, 35 PB15, 36 VDDIO, 37 GNDIO, 38 PC08, 39 PC09, 40 PC10, 41 PC11, 42 PC12, 43 PC13, 44 PC14, 45 PC15, 46 PA12, 47 PA13, 48 PA14, 49 PA15, 50 GNDIO, 51 VDDIO, 52 PA16, 53 PA17, 54 PA18, 55 PA19, 56 PC16, 57 PC17, 58 PC18, 59 PC19, 60 PC20, 61 PC21, 62 GNDIO, 63 VDDIO, 64 PB16, 65 PB17, 66 PB18, 67 PB19, 68 PB20, 69 PB21, 70 PA20, 71 PA21, 72 PA22, 73 PA23, 74 PA24, 75 PA25, 76 GNDIO, 77 VDDIO, 78 PB22, 79 PB23, 80 PB24, 81 PB25, 82 PC24, 83 PC25, 84 PC26, 85 PC27, 86 PC28, 87 PA27, 88 RESET_N, 89 PA28, 90 GNDIO, 91 VDDCORE, 92 VDDIN, 93 PA30, 94 PA31, 95 PB30, 96 PB31, 97 PB00, 98 PB01, 99 PB02, 100 PB03

## Notices in the file
Copyright (c) 2018 Microchip Technology Inc.
SPDX-License-Identifier: Apache-2.0
Licensed under the Apache License, Version 2.0 (the "License");
you may not use this file except in compliance with the License.
You may obtain a copy of the License at
http://www.apache.org/licenses/LICENSE-2.0
Unless required by applicable law or agreed to in writing, software
distributed under the License is distributed on an "AS IS" BASIS,
WITHOUT WARRANTIES OR CONDITIONS OF ANY KIND, either express or implied.
See the License for the specific language governing permissions and
limitations under the License.
