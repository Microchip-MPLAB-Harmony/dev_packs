# CEC1734_S0_2ZW device description
Architecture: CORTEX-M4; Family: CEC173X; Series: CEC
Parameters: __FPU_PRESENT=1, __MPU_PRESENT=1, __CM4_REV=0x0100 (CM4 Core Revision), __NVIC_PRIO_BITS=3 (Number of Bits used for Priority Levels), __Vendor_SysTickConfig=0 (Set to 1 if different SysTick Config is used), __VTOR_PRESENT=1 (Vector Table Offset Regisrer present or not), __ARCH_ARM=1, __ARCH_ARM_CORTEX_M=1, LITTLE_ENDIAN=1, EXTERNAL_APPLICATION_FLASH=1, __REVID=1
Programming and debug interfaces: SWD
Registers are 32-bit, read-write, reset 0x0 unless marked. A register's access mark holds for its fields unless they carry their own. Offsets are from the block's base; lines under a group give offsets from that group; [hi:lo] are bit positions; {n}, {i} and the like mark numbered series; 'fields as' and 'values as' point back to an identical list; <NAME> marks a mode.

## Ordering variants
CEC1734-S0-I/2ZW: WFBGA84, pinout CEC1734_S0_2ZW, up to 96 MHz, -40 to +85 C, 3.135 to 3.63 V

## Memory
base space: start 0 size 0x100000000, little endian
  0x000C8000 CODE_SRAM size 0x50000 ram, rw, executable
  0x00118000 DATA_SRAM size 0xA000 ram, rw
  0x00122000 BOOTROM_SRAM size 0x6000 ram, rw
  0x00128000 DATA_SRAM2 size 0x10000 ram, rw
  0x00138000 DATA_SRAM3 size 0x10000 ram, rw
  0x20000000 DATA_SRAM_ALIAS size 0x8000 ram, rw
  0x40000000 EC_DEVICE_REGISTERS size 0x80000 io, rw
  0x40080000 GPIO_REGISTERS size 0x10000 io, rw
  0x400F0000 HOST_DEVICE_REGISTERS size 0x100000 io, rw
  0x40100000 CRYPTO_RAM size 0x6000 ram, ro
  0xE000E000 SCS size 0x00001000 io, rw
  0x50000000 EXTERNAL_FLASH size 0x8000000 flash, rw, executable, external

## Peripheral instances (address, pins/pin function, parameters)
PCR at 0x40080100
  pins: nRESET_IN nRESET_IN/A; VCC_PWRGD GPIO057/B; CLK32KHZ_IN GPIO130/B; CLK32KHZ_OUT GPIO201/B; TST_CLK_OUT GPIO253/B
DMA_MAIN at 0x40002400
  parameters: CH_NUM=10 (Number of channels)
DMA_CHAN00 at 0x40002440
  parameters: CRC_ENGINE_PRESENT=1
DMA_CHAN01 at 0x40002480
  parameters: FILL_ENGINE_PRESENT=1
DMA_CHAN02 at 0x400024C0
DMA_CHAN{n:02} at {0x40002440+0x40*n} (DMA_CHAN02) (n=3..9)
ECIA at 0x4000E000
GCR at 0x400FFF00
UART0 at 0x4000C400 (UART)
  pins: UART0_TX GPIO104/B; UART0_RX GPIO105/B
GPIO at 0x40081000
  pins: GPIO000 GPIO000; GPIO002 GPIO002; GPIO003 GPIO003; GPIO004 GPIO004; GPIO012 GPIO012; GPIO013 GPIO013; GPIO015 GPIO015; GPIO016 GPIO016; GPIO020 GPIO020; GPIO021 GPIO021; GPIO022 GPIO022; GPIO023 GPIO023; GPIO024 GPIO024; GPIO026 GPIO026; GPIO027 GPIO027; GPIO030 GPIO030; GPIO031 GPIO031; GPIO032 GPIO032; GPIO033 GPIO033; GPIO034 GPIO034; GPIO045 GPIO045; GPIO046 GPIO046; GPIO047 GPIO047; GPIO050 GPIO050; GPIO053 GPIO053; GPIO055 GPIO055; GPIO056 GPIO056; GPIO057 GPIO057; GPIO063 GPIO063; GPIO070 GPIO070; GPIO071 GPIO071; GPIO104 GPIO104; GPIO105 GPIO105; GPIO106 GPIO106; GPIO107 GPIO107; GPIO112 GPIO112; GPIO113 GPIO113; GPIO{n} GPIO{n} (n=120..127); GPIO130 GPIO130; GPIO131 GPIO131; GPIO132 GPIO132; GPIO140 GPIO140; GPIO143 GPIO143; GPIO144 GPIO144; GPIO145 GPIO145; GPIO146 GPIO146; GPIO147 GPIO147; GPIO150 GPIO150; GPIO156 GPIO156; GPIO157 GPIO157; GPIO163 GPIO163; GPIO165 GPIO165; GPIO170 GPIO170; GPIO171 GPIO171; GPIO200 GPIO200; GPIO201 GPIO201; GPIO202 GPIO202; GPIO203 GPIO203; GPIO204 GPIO204; GPIO223 GPIO223; GPIO224 GPIO224; GPIO227 GPIO227; GPIO250 GPIO250; GPIO253 GPIO253
WDT at 0x40000400
TIMER32_0 at 0x40000C80 (TIMER32)
TIMER32_1 at 0x40000CA0 (TIMER32)
CCT at 0x40001000
  pins: ICT10 GPIO015/C; ICT0 GPIO050/B; ICT9 GPIO113/B
HTM0 at 0x40009800 (HTM)
HTM1 at 0x40009820 (HTM)
RTOS at 0x40007400
PWM0 at 0x40005800 (PWM)
  pins: PWM0 GPIO053/B
LED0 at 0x4000B800 (LED)
  pins: LED0 GPIO156/B
LED1 at 0x4000B900 (LED)
  pins: LED1 GPIO157/B
SMB{n} at {0x40004000+0x400*n} (SMB) (n=0..4)
  pins: SDA0 GPIO003/B; SCL0 GPIO004/B; SDA4 GPIO143/B; SCL4 GPIO144/B; SDA6 GPIO132/B; SCL6 GPIO140/B; SDA9 GPIO145/B; SCL9 GPIO146/B; SDA10 GPIO030/B; SCL10 GPIO107/B; SDA15 GPIO147/B; SCL15 GPIO150/B
  parameters: DMA_ID_TARGET={2n} (device number of SMB{n} DMA target trigger), DMA_ID_HOST={2n+1} (device number of SMB{n} DMA host trigger)
QMSPI0 at 0x40070000 (QMSPI)
  pins: QSPI0_CLK GPIO056/B; QSPI0_CS0_n GPIO055/B; QSPI0_CS1_n GPIO002/B; QSPI0_IO0 GPIO223/B; QSPI0_IO1 GPIO224/B; QSPI0_IO2 GPIO227/B; QSPI0_IO3 GPIO016/B; QSPI0_IN_CLK GPIO204/B; QSPI0_IN_CS0_n GPIO020/B; QSPI0_IN_CS1_n GPIO021/B; QSPI0_IN_IO1 GPIO022/B; QSPI0_IN_IO0 GPIO023/B; QSPI0_IN_IO2 GPIO202/B; QSPI0_IN_IO3 GPIO203/B
  parameters: DMA_ID_TX=10 (device number of DMA TX trigger), DMA_ID_RX=11 (device number of DMA RX trigger)
QMSPI1 at 0x40070200 (QMSPI)
  pins: QSPI1_CS0_n GPIO124/B; QSPI1_CS1_n GPIO120/B; QSPI1_CLK GPIO125/B; QSPI1_IO0 GPIO121/B; QSPI1_IO1 GPIO122/B; QSPI1_IO2 GPIO123/B; QSPI1_IO3 GPIO126/B; QSPI1_IN_CLK GPIO200/B; QSPI1_IN_CS0_n GPIO071/B; QSPI1_IN_IO0 GPIO070/B; QSPI1_IN_CS1_n GPIO045/B; QSPI1_IN_IO1 GPIO032/B; QSPI1_IN_IO2 GPIO165/B; QSPI1_IN_IO3 GPIO171/B
  parameters: DMA_ID_TX=12 (device number of DMA TX trigger), DMA_ID_RX=13 (device number of DMA RX trigger)
TFDP at 0x40008C00
  pins: TFDP_CLK GPIO104/C or GPIO170/C; TFDP_DATA GPIO105/C or GPIO171/C; ALT_TFDP_CLK GPIO027/B; ALT_TFDP_DATA GPIO112/C
VTR_REG_BANK at 0x4000A400
EC_REG_BANK at 0x4000FC00
OTP at 0x40082000
SPT0 at 0x40007000 (SPT)
  pins: QSPI0_IN_CLK GPIO204/B; SPI0PER_CS_n GPIO131/B; QSPI0_IN_IO1 GPIO022/B; QSPI0_IN_IO0 GPIO023/B; QSPI0_IN_IO2 GPIO202/B; QSPI0_IN_IO3 GPIO203/B; SP0_AP_INTR GPIO053/B
SPT1 at 0x40006C00 (SPT)
  pins: QSPI1_IN_CLK GPIO200/B; SPI1PER_CS_n GPIO024/B; QSPI1_IN_IO0 GPIO070/B; QSPI1_IN_IO1 GPIO032/B; QSPI1_IN_IO2 GPIO165/B; QSPI1_IN_IO3 GPIO171/B; SP1_AP_INTR GPIO034/B
FPU at 0xE000EF30
IMSPI at 0x40220000
NVIC at 0xE000E100
  parameters: NUM_IRQ=32 (Number of interrupt requests), __NVIC_PRIO_BITS=3 (Number of NVIC interrupt priority bits)
SysTick at 0xE000E010
SystemControl at 0xE000E000
PKE_ERR
PKE_END
RNG
AES
HASH
ENV_MON at 0x40200600
SPI_MON0 at 0x40010000 (SPI_MON)
  pins: ALT_VIOL_0 GPIO107/C; SPI0_KILL GPIO000/B; SPI0_RESET_n GPIO000/C; SPI0PER_CS_n GPIO250/B; AP0_RESET_n GPIO106/B; SP0_AP_INTR GPIO026/B; SPIMON_QSPI0_CS1_n GPIO002/C; SPIMON_QSPI0_CS0_n GPIO055/C; QSPI0_CLK_CLAMP GPIO056/C; QSPI0_IO0_CLAMP GPIO223/C; QSPI0_IO1_CLAMP GPIO224/C; QSPI0_IO2_CLAMP GPIO227/C; QSPI0_IO3_CLAMP GPIO016/C
SPI_MON1 at 0x40010400 (SPI_MON)
  pins: ALT_VIOL_1 GPIO112/B; SPI1_KILL GPIO163/B; SPI_RESET_n GPIO163/C; SPI1PER_CS_n GPIO024/B; SPIMON_QSPI1_CS1_n GPIO120/C; SPIMON_QSPI1_CS0_n GPIO124/C; QSPI1_CLK_CLAMP GPIO125/C; QSPI1_IO0_CLAMP GPIO121/C; QSPI1_IO1_CLAMP GPIO122/C; QSPI1_IO2_CLAMP GPIO123/C; QSPI1_IO3_CLAMP GPIO126/C; SP1_AP_INTR GPIO034/B; SP1_ALT_CLK GPIO063/B; SP1_ALT_CS_n GPIO046/B; SP1_ALT_IO0 GPIO031/B; SP1_ALT_IO1 GPIO047/B; SP1_ALT_IO2 GPIO127/B; SP1_ALT_IO3 GPIO013/B; AP1_RESET_n GPIO131/B

## Interrupts
-15 Reset — Reset Vector, invoked on Power up and warm reset
-14 NonMaskableInt — Non maskable Interrupt, cannot be stopped or preempted
-13 HardFault — Hard Fault, all classes of Fault
-12 MemoryManagement — Memory Management, MPU mismatch, including Access Violation and No Match
-11 BusFault — Bus Fault, Pre-Fetch-, Memory Access Fault, other address/memory related Fault
-10 UsageFault — Usage Fault, i.e. Undef Instruction, Illegal State Transition
-5 SVCall — System Service Call via SVC instruction
-4 DebugMonitor
-2 PendSV — Pendable request for system service
-1 SysTick — System Tick Timer
{n-8} GIRQ{n:02} (ECIA) (n=8..18)
12 GIRQ20 (ECIA)
13 GIRQ21 (ECIA)
14 GIRQ23 (ECIA)
15 GIRQ24 (ECIA)
17 GIRQ26 (ECIA)
20 I2CSMB0 (SMB0)
21 I2CSMB1 (SMB1)
22 I2CSMB2 (SMB2)
23 I2CSMB3 (SMB3)
{n+24} DMA_CH{n:02} (DMA_CHAN{n:02}) (n=0..9)
40 UART0
65 PKE_ERR
66 PKE_END
67 RNG
68 AES
69 HASH
83 LED0
84 LED1
90 SPT0
91 QMSPI0
92 QMSPI1
111 RTMR (RTOS)
112 HTMR0 (HTM0)
113 HTMR1 (HTM1)
134 EMC (ENV_MON)
140 TIMER32_0
141 TIMER32_1
146 CCT
147 CCT_CAP0 (CCT)
148 CCT_CAP1 (CCT)
149 CCT_CAP2 (CCT)
150 CCT_CAP3 (CCT)
151 CCT_CAP4 (CCT)
152 CCT_CAP5 (CCT)
153 CCT_CMP0 (CCT)
154 CCT_CMP1 (CCT)
158 I2CSMB4 (SMB4)
171 WDT
174 CLK_MON (PCR)
181 SWI0 (RTOS)
182 SWI1 (RTOS)
183 SWI2 (RTOS)
184 SWI3 (RTOS)
185 IMSPI
187 SPT1
188 SPIMON0_VLTN (SPI_MON0)
189 SPIMON0_MTMON (SPI_MON0)
190 SPIMON0_LTMON (SPI_MON0)
191 SPIMON1_VLTN (SPI_MON1)
192 SPIMON1_MTMON (SPI_MON1)
193 SPIMON1_LTMON (SPI_MON1)
194 VTR1_PAD_MON (EC_REG_BANK)
195 VTR2_PAD_MON (EC_REG_BANK)

## Pinouts (pin number, pad)
CEC1734_S0_2ZW: A4 GPIO000, J2 GPIO002, C6 GPIO003, C1 GPIO004, D6 GPIO012, F2 GPIO013, B3 GPIO015, K4 GPIO016, K1 GPIO020, J3 GPIO021, J7 GPIO022, E9 GPIO023, F7 GPIO024, A10 GPIO026, D5 GPIO027, B6 GPIO030, A3 GPIO031, K10 GPIO032, B4 GPIO033, A5 GPIO034, H9 GPIO045, A7 GPIO046, C2 GPIO047, B2 GPIO050, E1 GPIO053, K2 GPIO055, K7 GPIO056, D4 GPIO057, A1 GPIO063, D10 GPIO070, J9 GPIO071, E4 GPIO104, E2 GPIO105, E3 GPIO106, A6 GPIO107, F4 GPIO112, A2 GPIO113, H10 GPIO120, F9 GPIO121, K9 GPIO122, F10 GPIO123, J8 GPIO124, J10 GPIO125, G10 GPIO126, F3 GPIO127, B1 GPIO130, D2 GPIO131, C9 GPIO132, B7 GPIO140, A9 GPIO143, B9 GPIO144, B10 GPIO145, C10 GPIO146, B8 GPIO147, A8 GPIO150, H2 GPIO156, H1 GPIO157, B5 GPIO163, E10 GPIO165, G5 GPIO170, G9 GPIO171, K8 GPIO200, G2 GPIO201, K5 GPIO202, K3 GPIO203, K6 GPIO204, F8 GPIO223, J6 GPIO224, J4 GPIO227, J5 GPIO250, E8 GPIO253, G1 JTAG_RST_N, G4 nRESET_IN, G6 VSS_ANALOG, F1 VTR_PLL, D9 VSS, D7 VTR_REG, H5 VTR1, C5 VTR_ANALOG, D1 VR_CAP, E7 VSS, H6 VTR2, J1 VSS, G7 VSS
