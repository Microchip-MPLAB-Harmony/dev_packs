# SAM9X60 register map
Vendor: Microchip
Architecture arm32bit. Special function registers and configuration words.
Registers are 32-bit, read-write, no defined reset value unless marked. A register's access mark holds for its fields unless they carry their own. Addresses are absolute, and some are shared; only a register's first bit layout is shown; lines under a group give offsets from that group; [hi:lo] are bit positions; {n}, {i} and the like mark numbered series; 'fields as' and 'values as' point back to an identical list; <NAME> marks a mode.

## Further device data
pins=1: PA0/FLEXCOM0_IO0/FLEXCOM5_IO4/FLEXCOM4_IO4; 2: PA1/FLEXCOM0_IO1/FLEXCOM4_IO5; 3: PA2/FLEXCOM0_IO4/SDMMC1_DAT1/E0_TX0; 4: PA3/FLEXCOM0_IO3/SDMMC1_DAT2/E0_TX1; 5: PA4/FLEXCOM0_IO2/SDMMC1_DAT3/E0_TXER; 6: PA5/FLEXCOM1_IO0/CANTX1; 7: PA6/FLEXCOM1_IO1/CANRX1; 8: PA7/FLEXCOM2_IO0/FLEXCOM4_IO4/FLEXCOM5_IO4; 9: PA8/FLEXCOM2_IO1/FLEXCOM5_IO3/FLEXCOM4_IO5; 10: PA9/DRXD/CANRX0; 11: PA10/DTXD/CANTX0; 12: PA11/FLEXCOM4_IO1/SDMMC1_DAT0; 13: PA12/FLEXCOM4_IO0/SDMMC1_CMD; 14: PA13/FLEXCOM4_IO2/SDMMC1_CK; 15: PA14/FLEXCOM4_IO3; 16: PA15/SDMMC0_DAT0; 17: PA16/SDMMC0_CMD; 18: PA17/SDMMC0_CK; 19: PA18/SDMMC0_DAT1; 20: PA19/SDMMC0_DAT2; 21: PA20/SDMMC0_DAT3; 22: PA21/TIOA0/FLEXCOM5_IO1; 23: PA22/TIOA1/FLEXCOM5_IO0; 24: PA23/TIOA2/FLEXCOM5_IO2; 25: PA24/TCLK0/TK/CLASSD_L0; 26: PA25/TCLK1/TF/CLASSD_L1; 27: PA26/TCLK2/TD/CLASSD_L2; 28: PA27/TIOB0/RD/CLASSD_L3; 29: PA28/TIOB1/RK; 30: PA29/TIOB2/RF/FLEXCOM2_IO7; 31: PA30/FLEXCOM6_IO0/FLEXCOM5_IO6/E0_MDC; 32: PA31/FLEXCOM6_IO1/FLEXCOM5_IO5/E0_TXEN; 33: PB0/E0_RX0/FLEXCOM2_IO4; 34: PB1/E0_RX1/FLEXCOM2_IO3; 35: PB2/E0_RXER/FLEXCOM2_IO2; 36: PB3/E0_RXDV/FLEXCOM4_IO6; 37: PB4/E0_TXCK/FLEXCOM8_IO0; 38: PB5/E0_MDIO/FLEXCOM8_IO1; 39: PB6/E0_MDC/FLEXCOM0_IO7/AD7; 40: PB7/E0_TXEN/AD8; 41: PB8/E0_TXER/AD9; 42: PB9/E0_TX0/PCK1/AD10; 43: PB10/E0_TX1/PCK0/AD11; 44: PB11/E0_TX2/PWM0/AD0; 45: PB12/E0_TX3/PWM1/AD1; 46: PB13/E0_RX2/PWM2/AD2; 47: PB14/E0_RX3/PWM3/AD3; 48: PB15/E0_RXCK/AD4; 49: PB16/E0_CRS/AD5; 50: PB17/E0_COL/AD6; 51: PB18/IRQ/ADTRG; 52: PB19/QSCK/I2SMCC_CK/FLEXCOM11_IO0; 53: PB20/QCS/I2SMCC_WS/FLEXCOM11_IO1; 54: PB21/QIO0/I2SMCC_DIN0/FLEXCOM12_IO0; 55: PB22/QIO1/I2SMCC_DOUT0/FLEXCOM12_IO1; 56: PB23/QIO2/I2SMCC_MCK; 57: PB24/QIO3; 58: PB25/NRST_OUT/NTRST; 59: PC0/LCDDAT0/ISI_D0/FLEXCOM7_IO0; 60: PC1/LCDDAT1/ISI_D1/FLEXCOM7_IO1; 61: PC2/LCDDAT2/ISI_D2/TIOA3; 62: PC3/LCDDAT3/ISI_D3/TIOB3; 63: PC4/LCDDAT4/ISI_D4/TCLK3; 64: PC5/LCDDAT5/ISI_D5/TIOA4; 65: PC6/LCDDAT6/ISI_D6/TIOB4; 66: PC7/LCDDAT7/ISI_D7/TCLK4; 67: PC8/LCDDAT8/ISI_D8/FLEXCOM9_IO0; 68: PC9/LCDDAT9/ISI_D9/FLEXCOM9_IO1; 69: PC10/LCDDAT10/ISI_D10/PWM0; 70: PC11/LCDDAT11/ISI_D11/PWM1; 71: PC12/LCDDAT12/ISI_PCK/TIOA5; 72: PC13/LCDDAT13/ISI_VSYNC/TIOB5; 73: PC14/LCDDAT14/ISI_HSYNC/TCLK5; 74: PC15/LCDDAT15/ISI_MCK/PCK0; 75: PC16/LCDDAT16/E1_RXER/FLEXCOM10_IO0; 76: PC17/LCDDAT17/FLEXCOM1_IO7/FLEXCOM10_IO1; 77: PC18/LCDDAT18/E1_TX0/PWM0; 78: PC19/LCDDAT19/E1_TX1/PWM1; 79: PC20/LCDDAT20/E1_RX0/PWM2; 80: PC21/LCDDAT21/E1_RX1/PWM3; 81: PC22/LCDDAT22/FLEXCOM3_IO0; 82: PC23/LCDDAT23/FLEXCOM3_IO1; 83: PC24/LCDDISP/FLEXCOM3_IO4; 84: PC25/FLEXCOM3_IO3; 85: PC26/LCDPWM/FLEXCOM3_IO2; 86: PC27/LCDVSYNC/E1_TXEN/FLEXCOM1_IO4; 87: PC28/LCDHSYNC/E1_CRSDV/FLEXCOM1_IO3; 88: PC29/LCDDEN/E1_TXCK/FLEXCOM1_IO2; 89: PC30/LCDPCK/E1_MDC/FLEXCOM3_IO7; 90: PC31/FIQ/E1_MDIO/PCK1; 91: PD0/NANDOE; 92: PD1/NANDWE; 93: PD2/A21/NANDALE; 94: PD3/A22/NANDCLE; 95: PD4/NCS3/NANDCS; 96: PD5/NWAIT; 97: PD6/D16; 98: PD7/D17; 99: PD8/D18; 100: PD9/D19; 101: PD10/D20; 102: PD11/D21; 103: PD12/D22; 104: PD13/D23; 105: PD14/D24; 106: PD15/D25/A20; 107: PD16/D26/A23; 108: PD17/D27/A24; 109: PD18/D28/A25; 110: PD19/D29/NCS2; 111: PD20/D30/NCS4; 112: PD21/D31/NCS5; 113: VDDIOM; 114: VDDIOM; 115: VDDIOM; 116: GND; 117: GND; 118: GND; 119: GND; 120: VDDNF; 121: GND; 122: GND; 123: GND; 124: VDDIOP0; 125: VDDIOP0; 126: GND; 127: GND; 128: VDDIOP1; 129: GND; 130: VDDBU; 131: GND; 132: VDDANA; 133: GNDANA; 134: GND; 135: GND; 136: VDDPLLA; 137: VDDOSC; 138: GNDOSC; 139: VDDCORE; 140: VDDCORE; 141: VDDCORE; 142: GND; 143: GND; 144: GND; 145: VDDQSPI; 146: GND; 147: VDDUTMII; 148: GNDUTMI; 149: D0; 150: D1; 151: D2; 152: D3; 153: D4; 154: D5; 155: D6; 156: D7; 157: D8; 158: D9; 159: D10; 160: D11; 161: D12; 162: D13; 163: D14; 164: D15; 165: A0; 166: A1; 167: A2; 168: A3; 169: A4; 170: A5; 171: A6; 172: A7; 173: A8; 174: A9; 175: A10; 176: A11; 177: A12; 178: A13; 179: A14; 180: A15; 181: A16; 182: A17; 183: A18; 184: A19; 185: NCS0; 186: NCS1; 187: NRD; 188: NWR0; 189: NWR1; 190: NWR3; 191: SDCK; 192: SDCKN; 193: SDCKE; 194: RAS; 195: CAS; 196: SDWE; 197: SDA10; 198: DQM0; 199: DQM1; 200: DQS0; 201: NDQS0; 202: DQS1; 203: NDQS1; 204: DDR_CAL; 205: DDR_VREF; 206: ADVREFP; 207: ADVREFN; 208: HHSRTUNE; 209: HHSDPA; 210: HHSDMA; 211: HHSDPB; 212: HHSDMB; 213: HHSDPC; 214: HHSDMC; 215: WKUP0; 216: SHDN; 217: JTAGSEL; 218: TST; 219: TCK; 220: TDI; 221: TDO; 222: TMS; 223: RTCK; 224: NRST; 225: XIN32; 226: XOUT32; 227: XIN; 228: XOUT, interrupts=0 EXT_FIQ — External FIQ; 1 SYSC — System Controller Interrupt; 2 PIOA — Parallel I/O Controller A; 3 PIOB — Parallel I/O Controller B; 4 PIOC — Parallel I/O Controller C; 5 FLEXCOM0 — FLEXCOM 0; 6 FLEXCOM1 — FLEXCOM 1; 7 FLEXCOM2 — FLEXCOM 2; 8 FLEXCOM3 — FLEXCOM 3; 9 FLEXCOM6 — FLEXCOM 6; 10 FLEXCOM7 — FLEXCOM 7; 11 FLEXCOM8 — FLEXCOM 8; 12 SDMMC0 — Secure Digital Multi Media Card 0; 13 FLEXCOM4 — FLEXCOM 4; 14 FLEXCOM5 — FLEXCOM 5; 15 FLEXCOM9 — FLEXCOM 9; 16 FLEXCOM10 — FLEXCOM 10; 17 TC0 — Timer Counter 0; 18 PWM — Pulse Width Modulation; 19 ADC — Analog to Digital Converter; 20 XDMAC — Extended DMA Controller; 21 MATRIX — Matrix; 22 UHPHS — USB Host High Speed; 23 UDPHS — USB Device High Speed; 24 EMAC0 — Ethernet MAC 0; 25 LCDC — LCD Controller; 26 SDMMC1 — Secure Digital Multi Media Card 1; 27 EMAC1 — Ethernet MAC 1; 28 SSC — Synchronous Serial Controller; 29 CAN0 — Controller Area Network 0; 30 CAN1 — Controller Area Network 1; 31 EXT_IRQ — External IRQ; 32 FLEXCOM11 — FLEXCOM 11; 33 FLEXCOM12 — FLEXCOM 12; 34 I2SMCC — I2S Multi Channel Controller; 35 QSPI — Quad I/O SPI Controller; 36 GFX2D — Graphics 2D Controller; 37 PIT64B — Periodic Interval Timer 64-bit ; 38 TRNG — True Random Number Generator; 39 AES — Advanced Encryption Standard; 40 TDES — Triple Data Encryption Standard; 41 SHA — Secure Hash Algorithm; 42 CLASSD — Class D Controller; 43 ISI — Image Sensor Interface; 44 PIOD — Parallel I/O D; 45 TC1 — Timer Counter 1; 46 OTPC — One Time Programmable Controller; 47 DBGU — Debug Unit; 48 ECC — ECC Controller; 49 MC — Memory Controller
