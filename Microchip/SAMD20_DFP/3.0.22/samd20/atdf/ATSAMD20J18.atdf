# ATSAMD20J18 device description
Architecture: CORTEX-M0PLUS; Family: SAMD; Series: SAMD20
Parameters: NUM_IRQ=25 (Number of Interrupt Requests), __CM0PLUS_REV=0x0001 (Cortex-M0+ Core Revision), __MPU_PRESENT=0 (MPU present or not), __NVIC_PRIO_BITS=2 (Number of Bits used for Priority Levels), __VTOR_PRESENT=1 (Vector Table Offset Register present or not), __Vendor_SysTickConfig=0 (Set to 1 if different SysTick Config is used), __ARCH_ARM=1, __ARCH_ARM_CORTEX_M=1, __DEVICE_IS_SAM=1
Programming and debug interfaces: SWD
Registers are 8-bit, read-write, reset 0x0 unless marked. A register's access mark holds for its fields unless they carry their own. Offsets are from the block's base; lines under a group give offsets from that group; [hi:lo] are bit positions; {n}, {i} and the like mark numbered series; 'fields as' and 'values as' point back to an identical list; <NAME> marks a mode.

## Ordering variants
ATSAMD20J18A-CU: CTBGA64, pinout SAMD20JC, up to 48 MHz, -40 to 85 C, 1.62 to 3.63 V
ATSAMD20J18A-CN: CTBGA64, pinout SAMD20JC, up to 48 MHz, -40 to 105 C, 1.62 to 3.63 V
ATSAMD20J18A-MU: QFN64, pinout SAMD20J, up to 48 MHz, -40 to 85 C, 1.62 to 3.63 V
ATSAMD20J18A-MN: QFN64, pinout SAMD20J, up to 48 MHz, -40 to 105 C, 1.62 to 3.63 V
ATSAMD20J18A-AU: TQFP64, pinout SAMD20J, up to 48 MHz, -40 to 85 C, 1.62 to 3.63 V
ATSAMD20J18A-AN: TQFP64, pinout SAMD20J, up to 48 MHz, -40 to 105 C, 1.62 to 3.63 V

## Memory
base space: start 0 size 0x100000000, little endian
  0x00000000 FLASH size 0x40000 flash, rw, executable, page 64
  0x00800000 CAL size 0x8 fuses, ro
  0x00802000 LOCKBIT size 0x4 fuses, ro
  0x00806000 OTP1 size 0x8 fuses, ro
  0x00806008 OTP2 size 0x8 fuses, ro
  0x00806020 OTP4 size 0xE0 fuses, rw, page 64
  0x00806030 TEMP_LOG size 0x8 fuses, ro
  0x00804000 USER_PAGE size 0x100 user_page, rw, page 64
  0x20000000 HRAMC0 size 0x8000 ram, rw, executable
  0x40000000 HPB0 size 0x10000 io, rw
  0x41000000 HPB1 size 0x10000 io, rw
  0x42000000 HPB2 size 0x10000 io, rw
  0xE0000000 PPB size 0x100000 io, rw
  0xE000E000 SCS size 0x00001000 io, rw
  0x40000000 PERIPHERALS size 0x20000000 io, rw
fuses space: start 0x00000000 size 0x20000000, little endian

## Peripheral instances (address, pins/pin function, parameters)
AC at 0x42004400
  pins: AIN0 PA04/B; AIN1 PA05/B; AIN2 PA06/B; AIN3 PA07/B; CMP0 PA12/H or PA18/H; CMP1 PA13/H or PA19/H
  parameters: CMP_NUM=2 (Number of comparators), GCLK_ID_ANA=25 (Index of Generic Clock for analog), GCLK_ID_DIG=24 (Index of Generic Clock for digital), NUM_CMP=2, PAIRS=1 (Number of pairs of comparators), INSTANCE_ID=81
ADC at 0x42004000
  pins: AIN0 PA02/B; AIN1 PA03/B; AIN2 PB08/B; AIN3 PB09/B; AIN4 PA04/B; AIN5 PA05/B; AIN6 PA06/B; AIN7 PA07/B; AIN{n} PB{n-8:02}/B (n=8..15); AIN16 PA08/B; AIN17 PA09/B; AIN18 PA10/B; AIN19 PA11/B; VREFP PA04/B
  parameters: EXTCHANNEL_MSB=19 (Number of external channels), GCLK_ID=23 (Index of Generic Clock), RESULT_BITS=16 (Size of RESULT.RESULT bitfield), RESULT_MSB=15 (Size of Result), INSTANCE_ID=80
DAC at 0x42004800
  pins: VOUT PA02/B; VREFP PA03/B
  parameters: GCLK_ID=26, INSTANCE_ID=82
DSU at 0x41002000
  parameters: INSTANCE_ID=33
EIC at 0x40001800
  pins: EXTINT0 PA16/A or PB00/A or PB16/A or PA00/A; EXTINT1 PA17/A or PB01/A or PB17/A or PA01/A; EXTINT2 PA02/A or PA18/A or PB02/A; EXTINT3 PA03/A or PA19/A or PB03/A; EXTINT4 PA04/A or PA20/A or PB04/A; EXTINT5 PA05/A or PA21/A or PB05/A; EXTINT6 PA06/A or PA22/A or PB06/A or PB22/A; EXTINT7 PA07/A or PA23/A or PB07/A or PB23/A; EXTINT8 PA28/A or PB08/A; EXTINT9 PA09/A or PB09/A; EXTINT10 PA10/A or PA30/A or PB10/A; EXTINT11 PA11/A or PA31/A or PB11/A; EXTINT12 PA12/A or PA24/A or PB12/A; EXTINT13 PA13/A or PA25/A or PB13/A; EXTINT14 PB14/A or PB30/A or PA14/A; EXTINT15 PA27/A or PB15/A or PB31/A or PA15/A; NMI PA08/A
  parameters: CONFIG_NUM=2 (Number of CONFIG registers), EXTINT_NUM=16 (Number of External Interrupts), GCLK_ID=3 (Index of Generic Clock), NUMBER_OF_CONFIG_REGS=2 (Number of CONFIG registers (obsolete)), NUMBER_OF_INTERRUPTS=16 (Number of External Interrupts (obsolete)), INSTANCE_ID=6
EVSYS at 0x42000400
  parameters: CHANNELS=8 (Number of Channels), CHANNELS_BITS=3 (Number of bits to select Channel), CHANNELS_MSB=7 (Number of Channels - 1), EXT_EVT_MSB=0 (Number of External Event Generators - 1), GCLK_ID_{n}={n+4} (Index of Generic Clock {n}) (n=0..7), GENERATORS=59 (Total Number of Event Generators), GENERATORS_BITS=6 (Number of bits to select Event Generator), USERS=14 (Total Number of Event Users), USERS_BITS=4 (Number of bits to select Event User), INSTANCE_ID=65
GCLK at 0x40000C00
  pins: IO0 PB14/H or PB22/H or PA14/H or PA27/H or PA28/H or PA30/H; IO1 PB15/H or PB23/H or PA15/H; IO2 PB16/H or PA16/H; IO3 PA17/H or PB17/H; IO4 PA10/H or PA20/H or PB10/H; IO5 PA11/H or PA21/H or PB11/H; IO6 PA22/H or PB12/H; IO7 PA23/H or PB13/H
  parameters: GENDIV_BITS=16, GEN_NUM=8 (Number of Generic Clock Generators), GEN_NUM_MSB=7 (Number of Generic Clock Generators - 1), GEN_SOURCE_NUM_MSB=7 (Number of Generic Clock Sources - 1), NUM=28 (Number of Generic Clock Users), SOURCE_DFLL48M=7, SOURCE_GCLKGEN1=2, SOURCE_GCLKIN=1, SOURCE_NUM=8 (Number of Generic Clock Sources), SOURCE_OSCULP32K=3, SOURCE_OSC8M=6, SOURCE_OSC32K=4, SOURCE_XOSC=0, SOURCE_XOSC32K=5, INSTANCE_ID=3
NVMCTRL at 0x41004000
  pins: MARGIN VMARGIN
  parameters: FACTORY_WORD_IMPLEMENTED_MASK=0xC0000007FFFFFFFF, PMSB=3, PSZ_BITS=6, ROW_PAGES=4, USER_PAGE_OFFSET=0x00800000, USER_WORD_IMPLEMENTED_MASK=0xC01FFFFFFFFFFFFF, FLASH_SIZE=262144, PAGE_SIZE=64, PAGES=4096, PAGES_PR_REGION=256, PSM_0_FRMFW_FWS_1_MAX_FREQ=12000000, PSM_0_FRMLP_FWS_0_MAX_FREQ=18000000, PSM_0_FRMLP_FWS_1_MAX_FREQ=36000000, PSM_0_FRMHS_FWS_0_MAX_FREQ=25000000, PSM_0_FRMHS_FWS_1_MAX_FREQ=50000000, PSM_1_FRMFW_FWS_1_MAX_FREQ=12000000, PSM_1_FRMLP_FWS_0_MAX_FREQ=8000000, PSM_1_FRMLP_FWS_1_MAX_FREQ=12000000, INSTANCE_ID=34
FUSES at OTP4_FUSES 0x00806020 in fuses, TEMP_LOG_FUSES 0x00806030 in fuses, USER_FUSES 0x00804000 in fuses
PAC0 at 0x40000000 (PAC)
  parameters: WPROT_DEFAULT_VAL=0x00000000 (PAC protection mask at reset), INSTANCE_ID=0
PAC1 at 0x41000000 (PAC)
  parameters: WPROT_DEFAULT_VAL=0x00000002 (PAC protection mask at reset), INSTANCE_ID=32
PAC2 at 0x42000000 (PAC)
  parameters: WPROT_DEFAULT_VAL=0x00100000 (PAC protection mask at reset), INSTANCE_ID=64
PM at 0x40000400
  pins: RESET_N RESET_N
  parameters: CTRL_MCSEL_DFLL48M=3, CTRL_MCSEL_GCLK=0, CTRL_MCSEL_OSC8M=1, CTRL_MCSEL_XOSC=2, PM_CLK_APB_NUM=2, SYSTEM_CLOCK=1000000 (System Clock Frequency at Reset), INSTANCE_ID=1
  clocks: AHB HPB0 bit 0, HPB1 bit 1, HPB2 bit 2, DSU bit 3, NVMCTRL bit 4
PORT at 0x41004400, PORT_IOBUS 0x60000000
  pins: P{n} PA{n:02} (n=0..25); P27 PA27; P28 PA28; P30 PA30; P31 PA31; P{n} PB{n-32:02} (n=32..49); P54 PB22; P55 PB23; P62 PB30; P63 PB31
  parameters: BITS=64 (Number of PORT pins), DRVSTR=1 (DRVSTR supported), GROUPS=2 (Number of 32-bit PORT groups), ODRAIN=0 (ODRAIN supported), SLEWLIM=0 (SLEWLIM supported), INSTANCE_ID=35
PTC at 0x42004C00
  pins: X0 PA08/B; X1 PA09/B; X2 PA10/B; X3 PA11/B; X{n} PA{n+12}/B (n=4..11); X12 PB12/B; X13 PB13/B; X14 PB14/B; X15 PB15/B; Y0 PA02/B; Y1 PA03/B; Y2 PA04/B; Y3 PA05/B; Y4 PA06/B; Y5 PA07/B; Y{n} PB{n-6:02}/B (n=6..15)
  parameters: GCLK_ID=27 (Index of Generic Clock), INSTANCE_ID=83
RTC at 0x40001400
  parameters: ALARM_NUM=1 (Number of Alarms), COMP16_NUM=2 (Number of 16-bit Comparators), COMP32_NUM=1 (Number of 32-bit Comparators), GCLK_ID=2 (Index of Generic Clock), NUM_OF_ALARMS=1 (Number of Alarms (obsolete)), NUM_OF_COMP16=2 (Number of 16-bit Comparators (obsolete)), NUM_OF_COMP32=1 (Number of 32-bit Comparators (obsolete)), INSTANCE_ID=5
SERCOM0 at 0x42000800 (SERCOM)
  pins: PAD0 PA04/D or PA08/C; PAD1 PA05/D or PA09/C; PAD2 PA06/D or PA10/C; PAD3 PA07/D or PA11/C
  parameters: GCLK_ID_CORE=13, GCLK_ID_SLOW=12, INT_MSB=3, PMSB=3, INSTANCE_ID=66
SERCOM1 at 0x42000C00 (SERCOM)
  pins: PAD0 PA16/C or PA00/D; PAD1 PA17/C or PA01/D; PAD2 PA30/D or PA18/C; PAD3 PA31/D or PA19/C
  parameters: GCLK_ID_CORE=14, GCLK_ID_SLOW=12, INT_MSB=3, PMSB=3, INSTANCE_ID=67
SERCOM2 at 0x42001000 (SERCOM)
  pins: PAD0 PA08/D or PA12/C; PAD1 PA09/D or PA13/C; PAD2 PA10/D or PA14/C; PAD3 PA11/D or PA15/C
  parameters: GCLK_ID_CORE=15, GCLK_ID_SLOW=12, INT_MSB=3, PMSB=3, INSTANCE_ID=68
SERCOM3 at 0x42001400 (SERCOM)
  pins: PAD0 PA16/D or PA22/C; PAD1 PA17/D or PA23/C; PAD2 PA18/D or PA20/D or PA24/C; PAD3 PA19/D or PA21/D or PA25/C
  parameters: GCLK_ID_CORE=16, GCLK_ID_SLOW=12, INT_MSB=3, PMSB=3, INSTANCE_ID=69
SERCOM4 at 0x42001800 (SERCOM)
  pins: PAD0 PA12/D or PB08/D or PB12/C; PAD1 PA13/D or PB09/D or PB13/C; PAD2 PA14/D or PB10/D or PB14/C; PAD3 PA15/D or PB11/D or PB15/C
  parameters: GCLK_ID_CORE=17, GCLK_ID_SLOW=12, INT_MSB=3, PMSB=3, INSTANCE_ID=70
SERCOM5 at 0x42001C00 (SERCOM)
  pins: PAD0 PA22/D or PB02/D or PB30/D or PB16/C; PAD1 PA23/D or PB03/D or PB31/D or PB17/C; PAD2 PA24/D or PB00/D or PB22/D or PA20/C; PAD3 PA25/D or PB01/D or PB23/D or PA21/C
  parameters: GCLK_ID_CORE=18, GCLK_ID_SLOW=12, INT_MSB=3, PMSB=3, INSTANCE_ID=71
SYSCTRL at 0x40000800
  pins: XIN PA14/XIN; XIN32 PA00/XIN32; XOUT PA15/XOUT; XOUT32 PA01/XOUT32
  parameters: BGAP_CALIB_MSB=11, BOD33_CALIB_MSB=5, DFLL48M_COARSE_MSB=4, DFLL48M_FINE_MSB=7, GCLK_ID_DFLL48=0, OSC32K_COARSE_CALIB_MSB=6, POR33_ENTEST_MSB=1, ULPVREF_DIVLEV_MSB=3, ULPVREG_FORCEGAIN_MSB=1, ULPVREG_RAMREFSEL_MSB=2, VREF_CONTROL_MSB=48, VREF_STATUS_MSB=7, VREG_LEVEL_MSB=2, BOD12_VERSION=0x111, BOD33_VERSION=0x111, DFLL48M_VERSION=0x211, GCLK_VERSION=0x210, OSCULP32K_VERSION=0x111, OSC8M_VERSION=0x120, OSC32K_VERSION=0x1101, VREF_VERSION=0x200, VREG_VERSION=0x201, XOSC_VERSION=0x1101, XOSC32K_VERSION=0x1101, INSTANCE_ID=2
TC0 at 0x42002000 (TC)
  pins: WO0 PA04/F or PB30/F or PA08/E; WO1 PA05/F or PB31/F or PA09/E
  parameters: CC8_NUM=2, CC16_NUM=2, CC32_NUM=2, DITHERING_EXT=0, GCLK_ID=19, MASTER=1, OW_NUM=2, PERIOD_EXT=0, SHADOW_EXT=0, INSTANCE_ID=72
TC1 at 0x42002400 (TC)
  pins: WO0 PA06/F or PA30/F or PA10/E; WO1 PA07/F or PA31/F or PA11/E
  parameters: CC8_NUM=2, CC16_NUM=2, CC32_NUM=2, DITHERING_EXT=0, GCLK_ID=19, MASTER=0, OW_NUM=2, PERIOD_EXT=0, SHADOW_EXT=0, INSTANCE_ID=73
TC2 at 0x42002800 (TC)
  pins: WO0 PA16/F or PA12/E or PA00/F; WO1 PA17/F or PA13/E or PA01/F
  parameters: CC8_NUM=2, CC16_NUM=2, CC32_NUM=2, DITHERING_EXT=0, GCLK_ID=20, MASTER=1, OW_NUM=2, PERIOD_EXT=0, SHADOW_EXT=0, INSTANCE_ID=74
TC3 at 0x42002C00 (TC)
  pins: WO0 PA18/F or PA14/E; WO1 PA19/F or PA15/E
  parameters: CC8_NUM=2, CC16_NUM=2, CC32_NUM=2, DITHERING_EXT=0, GCLK_ID=20, MASTER=0, OW_NUM=2, PERIOD_EXT=0, SHADOW_EXT=0, INSTANCE_ID=75
TC4 at 0x42003000 (TC)
  pins: WO0 PA22/F or PB08/F or PB12/E; WO1 PA23/F or PB09/F or PB13/E
  parameters: CC8_NUM=2, CC16_NUM=2, CC32_NUM=2, DITHERING_EXT=0, GCLK_ID=21, MASTER=1, OW_NUM=2, PERIOD_EXT=0, SHADOW_EXT=0, INSTANCE_ID=76
TC5 at 0x42003400 (TC)
  pins: WO0 PA24/F or PB10/F or PB14/E; WO1 PA25/F or PB11/F or PB15/E
  parameters: CC8_NUM=2, CC16_NUM=2, CC32_NUM=2, DITHERING_EXT=0, GCLK_ID=21, MASTER=0, OW_NUM=2, PERIOD_EXT=0, SHADOW_EXT=0, INSTANCE_ID=77
TC6 at 0x42003800 (TC)
  pins: WO0 PB02/F or PB16/E; WO1 PB03/F or PB17/E
  parameters: CC8_NUM=2, CC16_NUM=2, CC32_NUM=2, DITHERING_EXT=0, GCLK_ID=22, MASTER=1, OW_NUM=2, PERIOD_EXT=0, SHADOW_EXT=0, INSTANCE_ID=78
TC7 at 0x42003C00 (TC)
  pins: WO0 PB00/F or PB22/F or PA20/E; WO1 PB01/F or PB23/F or PA21/E
  parameters: CC8_NUM=2, CC16_NUM=2, CC32_NUM=2, DITHERING_EXT=0, GCLK_ID=22, MASTER=0, OW_NUM=2, PERIOD_EXT=0, SHADOW_EXT=0, INSTANCE_ID=79
WDT at 0x40001000
  parameters: GCLK_ID=1 (Index of Generic Clock), INSTANCE_ID=4
NVIC at 0xE000E100
  parameters: NUM_IRQ=25 (Number of interrupt requests), __NVIC_PRIO_BITS=2 (Number of NVIC interrupt priority bits)
SysTick at 0xE000E010
SystemControl at 0xE000E000
  parameters: __VTOR_PRESENT=1 (Vector Table Offset Register present)

## Interrupts
-15 Reset — Reset Vector, invoked on Power up and warm reset
-14 NonMaskableInt — Non maskable Interrupt, cannot be stopped or preempted
-13 HardFault — Hard Fault, all classes of Fault
-5 SVCall — System Service Call via SVC instruction
-2 PendSV — Pendable request for system service
-1 SysTick — System Tick Timer
0 PM — Power Manager
1 SYSCTRL — System Controller
2 WDT — Watchdog Timer
3 RTC — Real Time Counter
4 EIC — External Interrupt Controller
5 NVMCTRL — Non-Volatile Memory Controller
6 EVSYS — Event Systems
7 SERCOM0 — Serial Communication Interface 0
8 SERCOM1 — Serial Communication Interface 1
9 SERCOM2 — Serial Communication Interface 2
10 SERCOM3 — Serial Communication Interface 3
11 SERCOM4 — Serial Communication Interface 4
12 SERCOM5 — Serial Communication Interface 5
{n+13} TC{n} (n=0..7) — Timer/Counter {n}
21 ADC — Analog-to-Digital Converter
22 AC — Analog Comparators
23 DAC — Digital-to-Analog Converter
24 PTC — Peripheral Touch Controller

## Event generators
1 RTC_CMP_0, 2 RTC_CMP_1, 3 RTC_OVF, {n+4} RTC_PER_{n} (n=0..7), {n+12} EIC_EXTINT_{n} (n=0..15), {3n+28} TC{n}_OVF (n=0..7), {3n+29} TC{n}_MC_0 (n=0..7), {3n+30} TC{n}_MC_1 (n=0..7), 52 ADC_RESRDY, 53 ADC_WINMON, 54 AC_COMP_0, 55 AC_COMP_1, 56 AC_WIN_0, 57 DAC_EMPTY

## Event users
{n} TC{n}_EVU (n=0..7), 8 ADC_START, 9 ADC_SYNC, 10 AC_SOC_0, 11 AC_SOC_1, 12 DAC_START

## Properties
SIGNATURES: DSU_DID=0x10001400

## Pinouts (pin number, pad)
SAMD20JC: A1 PB02, A2 PB01, A3 VDDIN, A4 VDDCORE, A5 GNDIO, A6 PA28, A7 PB23, A8 PB22, B1 PA00, B2 PB00, B3 PB31, B4 PA31, B5 PA30, B6 RESET_N, B7 PA27, B8 VDDIO, C1 PA01, C2 PB03, C3 PA02, C4 PB30, C5 PA21, C6 PA22, C7 PA23, C8 GNDIO, D1 GNDANA, D2 PB04, D3 PA03, D4 PB05, D5 PB17, D6 PA20, D7 PB16, D8 PA25, E1 VDDANA, E2 PB08, E3 PB07, E4 PB06, E5 PB11, E6 PB15, E7 PA19, E8 PA24, F1 PA04, F2 PA05, F3 PA10, F4 PB09, F5 PB12, F6 PA12, F7 PA18, F8 PA17, G1 PA07, G2 PA06, G3 PA11, G4 PB10, G5 PB13, G6 PA13, G7 PA16, G8 VDDIO, H1 PA08, H2 PA09, H3 VDDIO, H4 GNDIO, H5 PB14, H6 PA14, H7 PA15, H8 GNDIO
SAMD20J: 1 PA00, 2 PA01, 3 PA02, 4 PA03, 5 PB04, 6 PB05, 7 GNDANA, 8 VDDANA, 9 PB06, 10 PB07, 11 PB08, 12 PB09, 13 PA04, 14 PA05, 15 PA06, 16 PA07, 17 PA08, 18 PA09, 19 PA10, 20 PA11, 21 VDDIO, 22 GNDIO, 23 PB10, 24 PB11, 25 PB12, 26 PB13, 27 PB14, 28 PB15, 29 PA12, 30 PA13, 31 PA14, 32 PA15, 33 GNDIO, 34 VDDIO, 35 PA16, 36 PA17, 37 PA18, 38 PA19, 39 PB16, 40 PB17, 41 PA20, 42 PA21, 43 PA22, 44 PA23, 45 PA24, 46 PA25, 47 GNDIO, 48 VDDIO, 49 PB22, 50 PB23, 51 PA27, 52 RESET_N, 53 PA28, 54 GNDIO, 55 VDDCORE, 56 VDDIN, 57 PA30, 58 PA31, 59 PB30, 60 PB31, 61 PB00, 62 PB01, 63 PB02, 64 PB03

## Notices in the file
Copyright (c) 2018 Microchip Technology Inc.
SPDX-License-Identifier: Apache-2.0
Licensed under the Apache License, Version 2.0 (the "License");
you may not use this file except in compliance with the License.
You may obtain a copy of the License at
http://www.apache.org/licenses/LICENSE-2.0
Unless required by applicable law or agreed to in writing, software
distributed under the License is distributed on an "AS IS" BASIS,
WITHOUT WARRANTIES OR CONDITIONS OF ANY KIND, either express or implied.
See the License for the specific language governing permissions and
limitations under the License.
