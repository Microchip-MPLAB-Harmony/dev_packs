# CEC1734_S0_2ZW register map
Vendor: Microchip Technology; Series: CEC; File version: 0
Microchip CEC1734_S0_2ZW Microcontroller
CPU: CM4 r1p0, little endian, MPU, FPU, 3 interrupt priority bits, 196 interrupts
Registers are 32-bit, read-write, reset 0x0 unless marked. A register's access mark holds for its fields unless they carry their own. Offsets are from the block's base; lines under a group give offsets from that group; [hi:lo] are bit positions; {n}, {i} and the like mark numbered series; 'fields as' and 'values as' point back to an identical list; <NAME> marks a mode.

## Memory map
0x40000400 WDT size 0x15 — The function of the Watchdog Timer is to provide a mechanism to detect if the internal embedded controller has failed.
0x40000C80 TIMER32_0 size 0x14 — This 32-bit timer block offers a simple mechanism for firmware to maintain a time base.
0x40000CA0 TIMER32_1 size 0x14
0x40001000 CCT size 0x34 — This is a 16-bit auto-reloading timer/counter.
0x40002400 DMA_MAIN size 0x8 — DMA Main Registers
0x40002440 DMA_CHAN00 size 0x2C — DMA Channel 00 Registers
0x40002480 DMA_CHAN01 size 0x2C — DMA Channel 01 Registers
0x400024C0 DMA_CHAN02 size 0x19 — DMA Channel 02 Registers
0x40002500 DMA_CHAN03 size 0x19
0x40002540 DMA_CHAN04 size 0x19
0x40002580 DMA_CHAN05 size 0x19
0x400025C0 DMA_CHAN06 size 0x19
0x40002600 DMA_CHAN07 size 0x19
0x40002640 DMA_CHAN08 size 0x19
0x40002680 DMA_CHAN09 size 0x19
0x40004000 SMB0 size 0x7D — The SMBus interface can handle standard SMBus 2.0 protocols as well as I2C interface.
0x40004400 SMB1 size 0x7D
0x40004800 SMB2 size 0x7D
0x40004C00 SMB3 size 0x7D
0x40005000 SMB4 size 0x7D
0x40005800 PWM0 size 0xC — The PWM block generates an arbitrary duty cycle output at frequencies from less than 0.1 Hz to 24 MHz.
0x40006C00 SPT1 size 0x4C
0x40007000 SPT0 size 0x4C — SPI Peripheral Target Register.
0x40007400 RTOS size 0x10 — RTOS is a 32-bit timer designed to operate on the 32kHz oscillator which is available during all chip sleep states.
0x40008C00 TFDP size 0x5 — The TFDP serially transmits EC-originated diagnostic vectors to an external debug trace system.
0x40009800 HTM0 size 0xA — The Hibernation Timer can generate a wake event to the Embedded Controller (EC) when it is in a hibernation mode.
0x40009820 HTM1 size 0xA
0x4000A400 VTR_REG_BANK size 0x4 — The VBAT Register Bank block is a block implemented for miscellaneous battery-backed registers.
0x4000B800 LED0 size 0x18 — The LED is implemented using a PWM that can be driven either by the 48 MHz clock or by a 32.768 KHz clock input.
0x4000B900 LED1 size 0x18
0x4000C400 UART0 size 0x3F1 — The 16550 UART is a full-function Two Pin Serial Port that supports the standard RS-232 Interface.
0x4000E000 ECIA size 0x20C — The ECIA works in conjunction with the processor interrupt interface to handle hardware interrupts andd exceptions.
0x4000FC00 EC_REG_BANK size 0x24C — This block is designed to be accessed internally by the EC via the register interface.
0x40010000 SPI_MON0 size 0x318 — SPI Monitor Block
0x40010400 SPI_MON1 size 0x318
0x40070000 QMSPI0 size 0x170 — The QMSPI may be used to communicate with various peripheral devices that use a Serial Peripheral Interface.
0x40070200 QMSPI1 size 0x170
0x40080100 PCR size 0x100 — The Power, Clocks, and Resets (PCR) Section identifies clock sources, and reset inputs to the chip.
0x40081000 GPIO size 0x7C4 — GPIO Pin Control Registers
0x40082000 OTP size 0x54 — OTP Programming registers.
0x400FFF00 GCR size 0x27 — The Logical Device Configuration registers support motherboard designs in which the resources required by their components are known and assigned by the BIOS at POST.
0x40200600 ENV_MON size 0x401 — Environmental Monitor Block
0x40220000 IMSPI size 0x10 — Internal Master SPI.
0xE000E000 SystemControl size 0xD8C — System Control Registers
0xE000E010 SysTick size 0x10 — System timer
0xE000E100 NVIC size 0xE04 — Nested Vectored Interrupt Controller
0xE000EF30 FPU size 0x18 — Floating Point Unit

## Interrupts
{n-8} GIRQ{n:02} (ECIA) (n=8..18)
12 GIRQ20 (ECIA)
13 GIRQ21 (ECIA)
14 GIRQ23 (ECIA)
15 GIRQ24 (ECIA)
17 GIRQ26 (ECIA)
20 I2CSMB0 (SMB0)
21 I2CSMB1 (SMB1)
22 I2CSMB2 (SMB2)
23 I2CSMB3 (SMB3)
{n+24} DMA_CH{n:02} (DMA_CHAN{n:02}) (n=0..9)
40 UART0
83 LED0
84 LED1
90 SPT0
91 QMSPI0
92 QMSPI1
111 RTMR (RTOS)
112 HTMR0 (HTM0)
113 HTMR1 (HTM1)
134 EMC (ENV_MON)
140 TIMER32_0
141 TIMER32_1
146 CCT
147 CCT_CAP0 (CCT)
148 CCT_CAP1 (CCT)
149 CCT_CAP2 (CCT)
150 CCT_CAP3 (CCT)
151 CCT_CAP4 (CCT)
152 CCT_CAP5 (CCT)
153 CCT_CMP0 (CCT)
154 CCT_CMP1 (CCT)
158 I2CSMB4 (SMB4)
171 WDT
174 CLK_MON (PCR)
181 SWI0 (RTOS)
182 SWI1 (RTOS)
183 SWI2 (RTOS)
184 SWI3 (RTOS)
185 IMSPI
187 SPT1
188 SPIMON0_VLTN (SPI_MON0)
189 SPIMON0_MTMON (SPI_MON0)
190 SPIMON0_LTMON (SPI_MON0)
191 SPIMON1_VLTN (SPI_MON1)
192 SPIMON1_MTMON (SPI_MON1)
193 SPIMON1_LTMON (SPI_MON1)
194 VTR1_PAD_MON (EC_REG_BANK)
195 VTR2_PAD_MON (EC_REG_BANK)

## Notices in the file
Copyright (c) 2023 Microchip Technology Inc.
SPDX-License-Identifier: Apache-2.0
Licensed under the Apache License, Version 2.0 (the "License");
you may not use this file except in compliance with the License.
You may obtain a copy of the License at
http://www.apache.org/licenses/LICENSE-2.0
Unless required by applicable law or agreed to in writing, software
distributed under the License is distributed on an "AS IS" BASIS,
WITHOUT WARRANTIES OR CONDITIONS OF ANY KIND, either express or implied.
See the License for the specific language governing permissions and
limitations under the License.
