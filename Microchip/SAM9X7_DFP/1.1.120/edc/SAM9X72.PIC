# SAM9X72 register map
Vendor: Microchip
Architecture arm32bit. Special function registers and configuration words.
Registers are 32-bit, read-write, reset 0x0 unless marked. A register's access mark holds for its fields unless they carry their own. Addresses are absolute, and some are shared; only a register's first bit layout is shown; lines under a group give offsets from that group; [hi:lo] are bit positions; {n}, {i} and the like mark numbered series; 'fields as' and 'values as' point back to an identical list; <NAME> marks a mode.

## Further device data
pins=1: GND; 2: PC8/ISC_D8/FLEXCOM9_IO0/P72; 3: PC20/FLEXCOM10_IO4/PWM2/P84; 4: PC24/FLEXCOM3_IO4/P88; 5: PC28/FLEXCOM1_IO3/P92; 6: PC2/ISC_D2/TIOA3/P66/LVDS_A0M; 7: PC4/ISC_D4/TCLK3/P68/LVDS_A1M; 8: PC6/ISC_D6/TIOB4/P70/LVDS_A2M; 9: PC10/ISC_D10/PWM0/P74/LVDS_CLK1M; 10: PC12/ISC_PCK/TIOA5/P76/LVDS_A3M; 11: PB17/QIO7/FLEXCOM12_IO0/I2SMCC_DOUT0/P49; 12: PB25/QINT/I2SMCC_MCK/P57; 13: D15; 14: D12; 15: NDQS1; 16: GND; 17: PC18/FLEXCOM10_IO2/PWM0/P82; 18: PC22/FLEXCOM3_IO0/P86; 19: PC26/FLEXCOM3_IO2/P90; 20: PC3/ISC_D3/TIOB3/P67/LVDS_A0P; 21: PC5/ISC_D5/TIOA4/P69/LVDS_A1P; 22: PC7/ISC_D7/TCLK4/P71/LVDS_A2P; 23: PC11/ISC_D11/PWM1/P75/LVDS_CLK1P; 24: PC13/ISC_VSYNC/TIOB5/P77/LVDS_A3P; 25: PB19/QSCK/FLEXCOM12_IO2/P51; 26: PB23/QIO2/FLEXCOM9_IO3/P55; 27: D13; 28: D14; 29: DQS1; 30: D11; 31: GND; 32: PC14/ISC_HSYNC/TCLK5/P78; 33: PC16/ISC_FIELD/FLEXCOM10_IO0/P80; 34: PC23/FLEXCOM3_IO1/P87; 35: GND; 36: PC30/FLEXCOM3_IO7/P94; 37: PB15/QIO5/FLEXCOM11_IO0/I2SMCC_WS/P47; 38: GND; 39: PB21/QIO0/FLEXCOM12_IO4/P53; 40: PB24/QIO3/FLEXCOM9_IO4/P56; 41: VDDQSPI; 42: GND; 43: DQM1; 44: D8; 45: PC0/ISC_D0/FLEXCOM7_IO0/P64; 46: PC15/ISC_MCK/PCK0/P79; 47: VDDCORE; 48: PC9/ISC_D9/FLEXCOM9_IO1/P73; 49: VDDIOP; 50: PC29/FLEXCOM1_IO2/P93; 51: PB16/QIO6/FLEXCOM11_IO1/I2SMCC_DIN0/P48; 52: VDDLVDS; 53: PB20/QCS/FLEXCOM12_IO3/P52; 54: PB26/QIO4/I2SMCC_CK/P58; 55: D10; 56: D9; 57: D6; 58: D1; 59: PC21/PWM3/P85; 60: PC19/FLEXCOM10_IO3/PWM1/P83; 61: VDDCORE; 62: PC25/FLEXCOM3_IO3/P89; 63: GND; 64: PC27/FLEXCOM1_IO4/P91; 65: PB18/QDQS/ADTRG/FLEXCOM12_IO1/IRQ/P50; 66: GND; 67: PB22/QIO1/FLEXCOM9_IO2/P54; 68: VDDIOM; 69: D5; 70: D3; 71: D2; 72: D4; 73: PC1/ISC_D1/FLEXCOM7_IO1/P65; 74: PC17/FLEXCOM1_IO7/FLEXCOM10_IO1/P81; 75: NRST; 76: VDDCORE; 77: VDDOUT; 78: PC31/FIQ/PCK1/P95; 79: VDDCORE; 80: D7; 81: DQS0; 82: NDQS0; 83: DQM0; 84: DDR; 85: XIN; 86: XOUT; 87: GND; 88: VDDIN; 89: GND; 90: VDDMIPI; 91: GND; 92: VDDIOM; 93: GND; 94: D0; 95: A18/BA2; 96: SDCKE; 97: HHSDMA; 98: HHSDPA; 99: PA15/TIOA0/FLEXCOM5_IO1/CLASSD_R0/P15; 100: TDI; 101: TCK; 102: GND; 103: GND; 104: DDR; 105: SDWE; 106: RAS; 107: CAS; 108: A15; 109: NCS1; 110: HHSDMB; 111: HHSDPB; 112: PA21/TIOB0/RD/CLASSD_L3/P21; 113: PA18/TCLK0/TK/CLASSD_L0/P18; 114: AUDIO; 115: SHDN; 116: GND; 117: TST; 118: RESETN; 119: SDA10; 120: SDCKN; 121: SDCK; 122: A14; 123: A17/BA1; 124: HHSDMC; 125: HHSDPC; 126: GND; 127: VDDIN; 128: GNDANA; 129: HHSRTUNE; 130: GND; 131: VDDIOM; 132: GND; 133: A5; 134: A7; 135: A8; 136: PA30/FLEXCOM0_IO0/FLEXCOM5_IO4/FLEXCOM4_IO4/P30/AD6; 137: PA27/DTXD/CANTX0/P27/AD3; 138: PA26/DRXD/CANRX0/P26/AD2; 139: PA29/FLEXCOM1_IO1/CANRX1/P29/AD5; 140: WKUP0; 141: VDDANA; 142: GND; 143: PB11/GRX0/PWM0/FLEXCOM8_IO3/P43; 144: VDDCORE; 145: A16/BA0; 146: A2; 147: A4; 148: A3; 149: A6; 150: PA25/FLEXCOM6_IO1/FLEXCOM5_IO5/P25/AD1; 151: PA31/FLEXCOM0_IO1/FLEXCOM4_IO5/GTSUCOMP/P31/AD7; 152: PA24/FLEXCOM6_IO0/FLEXCOM5_IO6/P24/AD0; 153: PA28/FLEXCOM1_IO0/CANTX1/P28/AD4; 154: VDDBU; 155: PA20/TCLK2/TD/CLASSD_L2/P20; 156: GND; 157: PA11/FLEXCOM4_IO2/SDMMC1_CK/P11; 158: PB7/GTXEN/GTXCTL/FLEXCOM6_IO2/P39; 159: GND; 160: PD11/NANDDAT5/NWR0/NWE/P107; 161: VDDIOM; 162: A11; 163: A9; 164: A10; 165: A13; 166: ADVREFN; 167: ADVREFP; 168: PA5/SDMMC0_DAT3/P5; 169: VDDBU; 170: PA13/FLEXCOM2_IO0/FLEXCOM4_IO4/P13; 171: PA16/TIOA1/FLEXCOM5_IO0/CLASSD_R1/P16; 172: VDDIOP; 173: PA1/SDMMC0_CMD/P1; 174: PB5/GTX3/FLEXCOM8_IO1/P37; 175: VDDIOP; 176: PB1/GRX3/FLEXCOM2_IO3/P33; 177: PD9/NANDDAT3/A20/P105; 178: VDDNF; 179: PD5/NCS0/FLEXCOM11_IO4/P101; 180: PD4/NCS2/NANDCS/FLEXCOM11_IO3/P100; 181: PD1/NANDWE/FLEXCOM7_IO3/P97; 182: JTAGSEL; 183: TMS; 184: GND; 185: PA9/FLEXCOM4_IO1/SDMMC1_DAT0/P9; 186: PA7/FLEXCOM0_IO3/SDMMC1_DAT2/P7; 187: PA3/SDMMC0_DAT1/P3; 188: GND; 189: PB9/GMDIO/PCK1/FLEXCOM6_IO4/P41; 190: PB13/GTX0/PWM2/P45; 191: GND; 192: PD13/NANDDAT7/NWR1/NBS1/P109; 193: PD7/NANDDAT1/A12/P103; 194: PD8/NANDDAT2/A19/P104; 195: GND; 196: PD2/A21/NANDALE/FLEXCOM7_IO4/P98; 197: PD3/A22/NANDCLE/FLEXCOM11_IO2/P99; 198: XOUT32; 199: XIN32; 200: RTCK; 201: PA23/TIOB2/RF/FLEXCOM2_IO7/P23; 202: PA17/TIOA2/FLEXCOM5_IO2/CLASSD_R2/P17; 203: PA12/FLEXCOM4_IO3/FLEXCOM5_IO4/P12; 204: PA10/FLEXCOM4_IO0/SDMMC1_CMD/P10; 205: PA4/SDMMC0_DAT2/P4; 206: PB14/GTX1/PWM3/P46; 207: PB10/GMDC/PCK0/FLEXCOM8_IO2/P42; 208: PB6/GTXCK/GREFCK/FLEXCOM0_IO7/P38; 209: PB2/G125CK/FLEXCOM2_IO2/P34; 210: PB0/GRX2/FLEXCOM2_IO4/GRXER/P32; 211: PD10/NANDDAT4/NRD/P106; 212: PD6/NANDDAT0/A1/P102; 213: PD0/NANDOE/FLEXCOM7_IO2/P96; 214: GND; 215: TDO; 216: PA22/TIOB1/RK/CLASSD_R3/P22; 217: PA19/TCLK1/TF/CLASSD_L1/P19; 218: PA14/FLEXCOM2_IO1/FLEXCOM5_IO3/FLEXCOM4_IO5/P14; 219: PA8/FLEXCOM0_IO2/SDMMC1_DAT3/P8; 220: PA6/FLEXCOM0_IO4/SDMMC1_DAT1/P6; 221: PA2/SDMMC0_CK/P2; 222: PA0/SDMMC0_DAT0/P0; 223: PB3/GCRSDV/GRXCTL/FLEXCOM4_IO6/P35; 224: PB12/GRX1/PWM1/FLEXCOM8_IO4/P44; 225: PB8/GRXCK/FLEXCOM6_IO3/P40; 226: PB4/GTX2/FLEXCOM8_IO0/P36; 227: PD12/NANDDAT6/A0/NBS0/P108; 228: PD14/NWAIT/NANDRDY/P110; 229: GND, interrupts=0 EXT_FIQ — Advanced Interrupt Controller; 1 SYSC — Logical-OR interrupt of PMC, WDT, PIT, RSTC, RTT, RTC; 2 PIOA — Parallel I/O Controller A; 3 PIOB — Parallel I/O Controller B; 4 PIOC — Parallel I/O Controller C; 5 FLEXCOM0 — Flexcom 0; 6 FLEXCOM1 — Flexcom 1; 7 FLEXCOM2 — Flexcom 2; 8 FLEXCOM3 — Flexcom 3; 9 FLEXCOM6 — Flexcom 6; 10 FLEXCOM7 — Flexcom 7; 11 FLEXCOM8 — Flexcom 8; 12 SDMMC0 — Secure Data Memory Card Controller 0; 13 FLEXCOM4 — Flexcom 4; 14 FLEXCOM5 — Flexcom 5; 15 FLEXCOM9 — Flexcom 9; 16 FLEXCOM10 — Flexcom 10; 17 TC0 — TC 0,1,2; 18 PWM — Pulse Width Modulation Controller; 19 ADC — ADC Controller; 20 XDMAC — Extended DMA Controller; 21 MATRIX — Matrix; 22 UHPHS — USB Host High Speed; 23 UDPHS — USB Device High Speed; 24 GMAC — Gigabit Ethernet MAC; 25 XLCDC — LCD Controller; 26 SDMMC1 — Secure Data Memory Card Controller 1; 28 SSC — Synchronous Serial Controller; 29 MCAN0_INT0 — Master CAN 0; 30 MCAN1_INT0 — Master CAN 1; 31 EXT_IRQ — Advanced Interrupt Controller; 32 FLEXCOM11 — Flexcom 11; 33 FLEXCOM12 — Flexcom 12; 34 I2SMCC — I2S Multi Channel Controller; 35 QSPI — Quad I/O SPI Controller; 36 GFX2D — 2D Graphic Controller; 37 PIT64B0 — 64-b Timer 0; 38 TRNG — True Random Number Generator; 39 AES — Advanced Encryption Standard; 40 TDES — Triple Data Encryption Standard; 41 SHA — Secure Hash Algorithm; 42 CLASSD — CLASS D Controller; 43 ISC — Camera Interface; 44 PIOD — Parallel I/O Controller D; 45 TC1 — TC 3,4,5; 46 OTPC — OTP Controller; 47 DBGU — DBGU; 48 ECC — logical-OR interrupt of PMECC and PMERRLOC; 49 MC — logical-OR interrupt of MPDDRC and SMC; 56 LVDSC — Display Serial Interface between XLCDC and LVDS interface; 57 LVDSPHY — LVDS PHY; 58 PIT64B1 — 64-b Timer 1; 60 GMAC_Q1 — GMAC Queue 1 Interrupt signal toggled on a DMA write to the first word of each DMA data buffer associated with queue 1; 61 GMAC_Q2 — GMAC Queue 2 Interrupt signal toggled on a DMA write to the first word of each DMA data buffer associated with queue 2; 62 GMAC_Q3 — GMAC Queue 3 Interrupt signal toggled on a DMA write to the first word of each DMA data buffer associated with queue 3; 63 GMAC_Q4 — GMAC Queue 4 Interrupt signal toggled on a DMA write to the first word of each DMA data buffer associated with queue 4; 64 GMAC_Q5 — GMAC Queue 5 Interrupt signal toggled on a DMA write to the first word of each DMA data buffer associated with queue 5; 65 GMAC_EMAC — Gigabit Ethernet MAC - Express MAC; 66 GMAC_MMSL — Gigabit Ethernet MAC - Mac Merge SubLayer; 67 GMAC_TSU — Gigabit Ethernet MAC - Time Stamp Unit; 68 MCAN0_INT1 — Master CAN 0 interrupt 1; 69 MCAN1_INT1 — Master CAN 1 interrupt 1
