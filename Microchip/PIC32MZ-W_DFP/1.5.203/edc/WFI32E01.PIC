# WFI32E01 register map
Vendor: Microchip
Architecture 32xxxx. Special function registers and configuration words.
Registers are 32-bit, read-write, no defined reset value unless marked. A register's access mark holds for its fields unless they carry their own. Addresses are absolute, and some are shared; only a register's first bit layout is shown; lines under a group give offsets from that group; [hi:lo] are bit positions; {n}, {i} and the like mark numbered series; 'fields as' and 'values as' point back to an identical list; <NAME> marks a mode.

## Further device data
pins=1: GND; 2: PGC2ENTRY/PGC2/EMUC2/AN4/CVD4/CVDR4/CVDT3/RPB4/IOCB4/RB4; 3: TA4A/AN1/CVD1/CVDR1/CVDT6/ETH_EXCLK_OUT/RPB1/VBUSON/IOCB1/RB1; 4: VBUS; 5: D-; 6: D+; 7: PGD1ENTRY/PGD1/EMUD1/AN2/CVD2/CVDR2/CVDT5/RPB2/USBID/IOCB2/RB2; 8: CVDT11/ETXEN/RPC13/IOCC13/RC13; 9: CVDT9/ERXD0/RPC11/IOCC11/RC11; 10: CVDT8/ERXD1/RPC10/IOCC10/RC10; 11: GND; 12: CVDT10/ETH_CLK_OUT/ERXCLK/RPC12/IOCC12/RC12; 13: CVDT12/ETXD1/RPC14/IOCC14/RC14; 14: CVDT13/ETXD0/RPC15/IOCC15/RC15; 15: CVDT14/ERXDV/RPK12/IOCK12/RK12; 16: CVDT15/EMDIO/RPK13/IOCK13/RK13; 17: CVDT16/EMDC/RPK14/IOCK14/RK14; 18: CVDT7/ERXERR/RPC9/IOCC9/RC9; 19: RPC7/SDI1/IOCC7/RC7; 20: RPA1/SS1/CS1/FSYNC1/IOCA1/RA1; 21: RPC6/SCK1/IOCC6/RC6; 22: GND; 23: RPC8/SDO1/IOCC8/RC8; 24: VREGCTRL0/BT_CLK_OUT/RPK4/IOCK4/RK4; 25: PTA_BT_PRIO/RPK6/IOCK6/RK6; 26: MCLR; 27: VREGCTRL1/PTA_WLAN_ACTIVE/RPK5/IOCK5/RK5; 28: PTA_BT_ACTIVE/RPK7/IOCK7/RK7; 29: U1TX/IOCA9/RA9; 30: U1RX/IOCA8/RA8; 31: GND; 32: RPA5/SDA1/IOCA5/RA5; 33: RPA4/SCL1/IOCA4/RA4; 34: RF_FE_4/RPK1/IOCK1/RK1; 35: RF_FE_2/AN18/CVD18/CVDR18/RPK3/IOCK3/RK3; 36: GND; 37: GND; 38: RF_ANT_TP; 39: GND; 40: GND; 41: AN17/CVD17/CVDR17/RPA10/INT0/IOCA10/RA10; 42: AN15/ANN1/CVD15/CVDR15/RPA13/IOCA13/RA13; 43: RPA11/SCK2/IOCA11/RA11; 44: AN14/ANN0/CVD14/CVDR14/RPA14/IOCA14/RA14; 45: ANA0/RPB12/IOCB12/RB12; 46: TMS/AN6/CVD6/CVDR6/CVDT1/RPB6/IOCB6/RB6; 47: PGC4ENTRY/PGC4/EMUC4/TCK/AN8/CVD8/CVDR8/RPB8/IOCB8/RB8; 48: PGD4ENTRY/PGD4/EMUD4/TDI/AN9/CVD9/CVDR9/RPB9/IOCB9/RB9; 49: TDO/AN7/CVD7/CVDR7/CVDT0/RPB7/IOCB7/RB7; 50: VDD; 51: VDD; 52: PGD2ENTRY/PGD2/EMUD2/AN5/CVD5/CVDR5/CVDT2/RTCC/RPB5/IOCB5/RB5; 53: SOSCI; 54: SOSCO; 55: RPA2/SCL2/IOCA2/RA2; 56: RPA3/SDA2/IOCA3/RA3, interrupts=0 CORE_TIMER — Core Timer; 1 CORE_SOFTWARE_0 — Core Software 0; 2 CORE_SOFTWARE_1 — Core Software 1; 3 EXTERNAL_0 — Ext INT 0; 4 TIMER_1 — Timer1; 5 INPUT_CAPTURE_1_ERROR — Input Capture 1 Error; 6 INPUT_CAPTURE_1 — Input Capture 1; 7 OUTPUT_COMPARE_1 — Output Compare 1; 8 EXTERNAL_1 — Ext INT 1; 9 TIMER_2 — Timer2; 10 INPUT_CAPTURE_2_ERROR — Input Capture 2 Error; 11 INPUT_CAPTURE_2 — Input Capture 2; 12 OUTPUT_COMPARE_2 — Output Compare 2; 13 EXTERNAL_2 — Ext INT 2; 14 TIMER_3 — Timer3; 15 INPUT_CAPTURE_3_ERROR — Input Capture 3 Error; 16 INPUT_CAPTURE_3 — Input Capture 3; 17 OUTPUT_COMPARE_3 — Output Compare 3; 18 EXTERNAL_3 — Ext INT 3; 19 TIMER_4 — Timer4; 20 INPUT_CAPTURE_4_ERROR — Input Capture 4 Error; 21 INPUT_CAPTURE_4 — Input Capture 4; 22 OUTPUT_COMPARE_4 — Output Compare 4; 23 EXTERNAL_4 — Ext INT 4; 24 TIMER_5 — Timer5; 30 FLASH_CONTROL — Flash Control Event; 31 PREFETCH — Prefetch Module SEC Event; 32 PFW_CRC — PFW CRC event; 33 RTCC — REAL_TIME_CLOCK; 34 USB — USB_1; 35 SPI1_FAULT — SPI_1_FAULT; 36 SPI1_RX — SPI_1_RECEIVE; 37 SPI1_TX — SPI_1_TRANSFER; 38 UART1_FAULT — UART_1_FAULT; 39 UART1_RX — UART_1_RECEIVE; 40 UART1_TX — UART_1_TRANSFER; 41 I2C1_BUS — I2C_1_BUS_COLLISION_EVENT; 42 I2C1_SLAVE — I2C_1_SLAVE_EVENT; 43 I2C1_MASTER — I2C_1_MASTER_EVENT; 44 CHANGE_NOTICE_A — PORT_A_INPUT_CHANGE_INTERRUPT; 45 CHANGE_NOTICE_B — PORT_B_INPUT_CHANGE_INTERRUPT; 46 CHANGE_NOTICE_C — PORT_C_INPUT_CHANGE_INTERRUPT; 47 CHANGE_NOTICE_K — PORT_D_INPUT_CHANGE_INTERRUPT; 53 SPI2_FAULT — SPI 2 Fault; 54 SPI2_RX — SPI 2 Receive Done; 55 SPI2_TX — SPI 2 Transfer Done; 56 UART2_FAULT — UART 2 Error; 57 UART2_RX — UART 2 Receiver; 58 UART2_TX — UART 2 Transmitter; 59 I2C2_BUS — I2C 2 Bus Collision Event; 60 I2C2_SLAVE — I2C 2 Slave Event; 61 I2C2_MASTER — I2C 2 Master Event; 62 UART3_FAULT — UART_3_FAULT; 63 UART3_RX — UART_3_RECEIVE; 64 UART3_TX — UART_3_TRANSFER; 68 DMA0 — DMA Channel 0; 69 DMA1 — DMA Channel 1; 70 DMA2 — DMA Channel 2; 71 DMA3 — DMA Channel 3; 72 DMA4 — DMA Channel 4; 73 DMA5 — DMA Channel 5; 74 DMA6 — DMA Channel 6; 75 DMA7 — DMA Channel 7; 76 TIMER_6 — Timer 6; 80 TIMER_7 — Timer 7; 83 RFSMC — WiFi SMC Event; 84 RFMAC — WiFi MAC Event; 85 CTR1_EVENT — CTR1 EVENT; 86 RFTM0 — WiFi Timer 0 Event; 87 RFTM1 — WiFi Timer 1 Event; 88 RFTM2 — WiFi Timer 2 Event; 89 RFTM3 — WiFi Timer 3 Event; 90 CTR1_TRG — CTR1 Trig out event; 91 RFWCOE — WiFi WCOE Event; 92 ADC — ADC global; 94 ADC_DC1 — ADC Digital Comparator 1; 95 ADC_DC2 — ADC Digital Comparator 2; 96 ADC_DF1 — ADC Digital Filter 1; 97 ADC_DF2 — ADC Digital Filter 2; 100 ADC_FAULT — ADC Fault Interrupt; 101 ADC_EOS — ADC EO Scan; 102 ADC_ARDY — ADC Analog Ready; 103 ADC_URDY — ADC Update Rdy after Suspend; 104 ADC_DMA — ADC 1st Class Buffer Transfer; 106 ADC_DATA0 — ADC A Data #0; 107 ADC_DATA1 — ADC A Data #1; 108 ADC_DATA2 — ADC A Data #2; 109 ADC_DATA3 — ADC A Data #3; 110 ADC_DATA4 — ADC A Data #4; 111 ADC_DATA5 — ADC A Data #5; 112 ADC_DATA6 — ADC A Data #6; 113 ADC_DATA7 — ADC A Data #7; 114 ADC_DATA8 — ADC A Data #8; 115 ADC_DATA9 — ADC A Data #9; 116 ADC_DATA10 — ADC A Data #10; 117 ADC_DATA11 — ADC A Data #11; 118 ADC_DATA12 — ADC A Data #12; 119 ADC_DATA13 — ADC A Data #13; 120 ADC_DATA14 — ADC A Data #14; 121 ADC_DATA15 — ADC A Data #15; 122 ADC_DATA16 — ADC A Data #16; 123 ADC_DATA17 — ADC A Data #17; 124 ADC_DATA18 — ADC A Data #18; 125 ADC_DATA19 — ADC A Data #19; 126 ADC_DATA20 — ADC A Data #20; 127 ADC_DATA21 — ADC A Data #21; 128 ADC_DATA22 — ADC A Data #22; 129 ADC_DATA23 — ADC A Data #23; 142 CAN1 — CAN Combined Interrupt; 143 CAN2_RX — CAN2 Receive Interrupt; 144 CAN2_TX — CAN2 Transmit Interrupt; 145 CAN2_MISC — CAN2 Misc Interrupt; 150 SQI1 — SQI Event Completion; 152 PTG0_STEP — PTG Step Complete; 153 PTG0_WDT — PTG Watchdog Timeout; 154 PTG0_TRG0 — PTG Int. Trigger 0; 155 PTG0_TRG1 — PTG Int. Trigger 1; 156 PTG0_TRG2 — PTG Int. Trigger 2; 157 PTG0_TRG3 — PTG Int. Trigger 3; 162 CORE_PERF_COUNT — Core perform. counter event; 163 CORE_FAST_DEBUG_CHAN — Fast Debug Channel Event; 164 CRYPTO — Crypto Engine Event; 165 ETHERNET — Ethernet; 166 CRYPTO1 — Asymmetric Crypto Engine End Event; 167 CRYPTO1_FAULT — Asymmetric Crypto Engine Error Event; 168 CVD_EVENT — cvd event
