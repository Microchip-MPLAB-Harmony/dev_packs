# PIC32CZ4010CA91176 device description
Architecture: CORTEX-M7; Family: PIC32C; Series: PIC32CZCA91

## Peripheral instances (address, pins/pin function, parameters) (continued)
SDMMC1 at 0x460A0000 (SDMMC)
  pins: SDCD PC28/I; SDCK PC30/I set 1; SDCMD PG03/I set 1; SDDAT0 PC31/I set 1; SDDAT1 PG00/I set 1; SDDAT2 PG01/I set 1; SDDAT3 PG02/I set 1; SDWP PC27/I set 1
  parameters: CARD_DATA_SIZE=4, CLOCK_MULTIPLIER=2 (Multiplier between "sd_mult_src_clock" and "sd_src_clock"), DDR50_SUPPORT=0 (SD - UHS DDR50 Support Implemented), DIVBY2_FOR_SDSRCCLK=1 (Div-by-2 Source Clock is Implemented), DLL_NB_OF_PHASES=16, EIGHT_BITS_BUS_WIDTH=0 (Data Bus Width), GCLK_ID=60, GCLK_ID_SLOW=61, GLOBAL_INTERRUPT=1, HSDDR_SUPPORT=0 (e.MMC - HSDDR Support Implemented), HS200_SUPPORT=0 (e.MMC - HS200 Support Implemented), MAX_BLOCK_LENGTH=512 (Maximum Block Length), MULTIPLE_SLOTS=1 (Multiple Slots Support Enabled), MULT_SRC_CLK_GATED=1 (Internal Clock Gater is Implemented), PROGRAMMABLE_CLK_GENERATOR=1 (Programmabe Clock Generator is Implemented), RETUNING_TIMER=0, RETUNING_TIMER_MAX_VALUE=0 (Retuning Timer Counter Max Value), SDCD_DEBOUNCE_PERIOD=328 (Debounce Period Value), SDR12_SUPPORT=0 (SD - UHS SDR12 Support Implemented), SDR25_SUPPORT=0 (SD - UHS SDR25 Support Implemented), SDR50_SUPPORT=0 (SD - UHS SDR50 Support Implemented), SDR104_SUPPORT=0 (SD - UHS SDR104 Support Implemented), SD_SRC_CLOCK_FREQ=0 (Source Clock Frequency (MHz)), SHARED_BUS=0 (Shared Bus Enabled), SLOT_TYPE=0 (Slot Usage), TIMEOUT_CLK_DIVISION=1 (Division of TIMEOUT CLOCK compared to "sd_src_clock"), TIMEOUT_CLK_FREQ=12 (TIMEOUT CLOCK frequency), TIMEOUT_CLK_FREQ_UNIT=1 (TIMEOUT CLOCK frequency unit (0=KHz , 1=MHz)), TUNING_FOR_SDR50=0 (SDR50 Tuning Support Enabled), USER_DEBOUNCE=0 (User Debouncing), INSTANCE_ID=61 (Instance index for SDMMC1), MCLK_ID_AHB=71 (Index for SDMMC1 AHB clock), MCLK_ID_APB=72 (Index for SDMMC1 APB clock), PAC_ID=61 (Index for SDMMC1 registers write protection)
SERCOM0 at 0x46000000 (SERCOM)
  pins: PAD0 PC00/D; PAD1 PC01/D; PAD2 PC02/D; PAD3 PC03/D
  parameters: CLK_REDUCTION=1 (Reduce clock options to pin 1 for SPI and USART), DMA=1 (DMA support implemented?), DMAC_ID_RX=5 (Index of DMA RX trigger), DMAC_ID_TX=6 (Index of DMA TX trigger), FIFO_IMPLEMENTED=1 (FIFO Rx/Tx implemented?), FIFO_SIZE=16 (Rx-Tx FIFO size in bytes), FSYNC_IMPLEMENTED=1 (SPI Frame Synch mode implemented?), GCLK_ID_CORE=21, GCLK_ID_SLOW=18, SPI=1 (SPI mode implemented?), TWIM=1 (TWI Master mode implemented?), TWIS=1 (TWI Slave mode implemented?), TWI_HSMODE=1 (TWI HighSpeed mode implemented?), ULTRA_IMPLEMENTATION=0 (ULTRA platform compatibility?), USART=1 (USART mode implemented?), USART_AUTOBAUD=1 (USART autobaud implemented?), USART_IRDA=1 (USART IrDA implemented?), USART_ISO7816=1 (USART ISO7816 mode implemented?), USART_LIN_MASTER=1 (USART LIN Master mode implemented?), USART_RS485=1 (USART RS485 mode implemented?), INSTANCE_ID=23 (Instance index for SERCOM0), MCLK_ID_APB=31 (Index for SERCOM0 APB clock), PAC_ID=23 (Index for SERCOM0 registers write protection), USART_ERROR_INT_SRC=55 (USART/SPI/I2C Error), USART_TX_READY_INT_SRC=57 (USART-SPI Data Register Empty/ I2C Stop Received), USART_TX_COMPLETE_INT_SRC=58 (USART-SPI Transmit Complete/ I2C Address Match), USART_RX_INT_SRC=59 (USART-SPI Receive Complete/ I2C Data Ready), SPI_TX_READY_INT_SRC=57 (USART-SPI Data Register Empty/ I2C Stop Received), SPI_TX_COMPLETE_INT_SRC=58 (USART-SPI Transmit Complete/ I2C Address Match), SPI_RX_INT_SRC=59 (USART-SPI Receive Complete/ I2C Data Ready), I2C_0_INT_SRC=55 (USART/SPI/I2C Error), I2C_1_INT_SRC=59 (USART-SPI Receive Complete/ I2C Data Ready), I2C_2_INT_SRC=60 (USART Receive Start/ SPI Slave Select Low/ I2C TX FIFO Empty), I2C_3_INT_SRC=61 (USART Clear To Send Input Change/ I2C RX FIFO Full)
SERCOM1 at 0x46002000 (SERCOM)
  pins: PAD0 PC04/D set 1 or PC20/D set 2; PAD1 PC05/D set 1 or PC19/D set 2; PAD2 PC06/D set 1 or PC18/D set 2; PAD3 PC07/D set 1 or PC17/D set 2
  parameters: CLK_REDUCTION=1 (Reduce clock options to pin 1 for SPI and USART), DMA=1 (DMA support implemented?), DMAC_ID_RX=7 (Index of DMA RX trigger), DMAC_ID_TX=8 (Index of DMA TX trigger), FIFO_IMPLEMENTED=1 (FIFO Rx/Tx implemented?), FIFO_SIZE=16 (Rx-Tx FIFO size in bytes), FSYNC_IMPLEMENTED=1 (SPI Frame Synch mode implemented?), GCLK_ID_CORE=22, GCLK_ID_SLOW=18, SPI=1 (SPI mode implemented?), TWIM=1 (TWI Master mode implemented?), TWIS=1 (TWI Slave mode implemented?), TWI_HSMODE=1 (TWI HighSpeed mode implemented?), ULTRA_IMPLEMENTATION=0 (ULTRA platform compatibility?), USART=1 (USART mode implemented?), USART_AUTOBAUD=1 (USART autobaud implemented?), USART_IRDA=1 (USART IrDA implemented?), USART_ISO7816=1 (USART ISO7816 mode implemented?), USART_LIN_MASTER=1 (USART LIN Master mode implemented?), USART_RS485=1 (USART RS485 mode implemented?), INSTANCE_ID=24 (Instance index for SERCOM1), MCLK_ID_APB=32 (Index for SERCOM1 APB clock), PAC_ID=24 (Index for SERCOM1 registers write protection), USART_ERROR_INT_SRC=62 (USART/SPI/I2C Error), USART_TX_READY_INT_SRC=64 (USART-SPI Data Register Empty/ I2C Stop Received), USART_TX_COMPLETE_INT_SRC=65 (USART-SPI Transmit Complete/ I2C Address Match), USART_RX_INT_SRC=66 (USART-SPI Receive Complete/ I2C Data Ready), SPI_TX_READY_INT_SRC=64 (USART-SPI Data Register Empty/ I2C Stop Received), SPI_TX_COMPLETE_INT_SRC=65 (USART-SPI Transmit Complete/ I2C Address Match), SPI_RX_INT_SRC=66 (USART-SPI Receive Complete/ I2C Data Ready), I2C_0_INT_SRC=62 (USART/SPI/I2C Error), I2C_1_INT_SRC=66 (USART-SPI Receive Complete/ I2C Data Ready), I2C_2_INT_SRC=67 (USART Receive Start/ SPI Slave Select Low/ I2C TX FIFO Empty), I2C_3_INT_SRC=68 (USART Clear To Send Input Change/ I2C RX FIFO Full)
SERCOM2 at 0x45800000 (SERCOM)
  pins: PAD0 PC08/D set 1 or PD11/D set 2; PAD1 PC09/D set 1 or PD12/D set 2; PAD2 PC10/D set 1 or PA04/D set 2; PAD3 PC11/D set 1 or PA03/D set 2
  parameters: CLK_REDUCTION=1 (Reduce clock options to pin 1 for SPI and USART), DMA=1 (DMA support implemented?), DMAC_ID_RX=9 (Index of DMA RX trigger), DMAC_ID_TX=10 (Index of DMA TX trigger), FIFO_IMPLEMENTED=1 (FIFO Rx/Tx implemented?), FIFO_SIZE=16 (Rx-Tx FIFO size in bytes), FSYNC_IMPLEMENTED=1 (SPI Frame Synch mode implemented?), GCLK_ID_CORE=23, GCLK_ID_SLOW=19, SPI=1 (SPI mode implemented?), TWIM=1 (TWI Master mode implemented?), TWIS=1 (TWI Slave mode implemented?), TWI_HSMODE=1 (TWI HighSpeed mode implemented?), ULTRA_IMPLEMENTATION=0 (ULTRA platform compatibility?), USART=1 (USART mode implemented?), USART_AUTOBAUD=1 (USART autobaud implemented?), USART_IRDA=1 (USART IrDA implemented?), USART_ISO7816=1 (USART ISO7816 mode implemented?), USART_LIN_MASTER=1 (USART LIN Master mode implemented?), USART_RS485=1 (USART RS485 mode implemented?), INSTANCE_ID=25 (Instance index for SERCOM2), MCLK_ID_APB=33 (Index for SERCOM2 APB clock), PAC_ID=25 (Index for SERCOM2 registers write protection), USART_ERROR_INT_SRC=69 (USART/SPI/I2C Error), USART_TX_READY_INT_SRC=71 (USART-SPI Data Register Empty/ I2C Stop Received), USART_TX_COMPLETE_INT_SRC=72 (USART-SPI Transmit Complete/ I2C Address Match), USART_RX_INT_SRC=73 (USART-SPI Receive Complete/ I2C Data Ready), SPI_TX_READY_INT_SRC=71 (USART-SPI Data Register Empty/ I2C Stop Received), SPI_TX_COMPLETE_INT_SRC=72 (USART-SPI Transmit Complete/ I2C Address Match), SPI_RX_INT_SRC=73 (USART-SPI Receive Complete/ I2C Data Ready), I2C_0_INT_SRC=69 (USART/SPI/I2C Error), I2C_1_INT_SRC=73 (USART-SPI Receive Complete/ I2C Data Ready), I2C_2_INT_SRC=74 (USART Receive Start/ SPI Slave Select Low/ I2C TX FIFO Empty), I2C_3_INT_SRC=75 (USART Clear To Send Input Change/ I2C RX FIFO Full)
SERCOM3 at 0x45802000 (SERCOM)
  pins: PAD0 PC12/D set 1 or PD03/D set 2; PAD1 PC13/D set 1 or PD04/D set 2; PAD2 PC14/D set 1 or PD05/D set 2; PAD3 PC15/D set 1 or PD06/D set 2
  parameters: CLK_REDUCTION=1 (Reduce clock options to pin 1 for SPI and USART), DMA=1 (DMA support implemented?), DMAC_ID_RX=11 (Index of DMA RX trigger), DMAC_ID_TX=12 (Index of DMA TX trigger), FIFO_IMPLEMENTED=1 (FIFO Rx/Tx implemented?), FIFO_SIZE=16 (Rx-Tx FIFO size in bytes), FSYNC_IMPLEMENTED=1 (SPI Frame Synch mode implemented?), GCLK_ID_CORE=24, GCLK_ID_SLOW=19, SPI=1 (SPI mode implemented?), TWIM=1 (TWI Master mode implemented?), TWIS=1 (TWI Slave mode implemented?), TWI_HSMODE=1 (TWI HighSpeed mode implemented?), ULTRA_IMPLEMENTATION=0 (ULTRA platform compatibility?), USART=1 (USART mode implemented?), USART_AUTOBAUD=1 (USART autobaud implemented?), USART_IRDA=1 (USART IrDA implemented?), USART_ISO7816=1 (USART ISO7816 mode implemented?), USART_LIN_MASTER=1 (USART LIN Master mode implemented?), USART_RS485=1 (USART RS485 mode implemented?), INSTANCE_ID=26 (Instance index for SERCOM3), MCLK_ID_APB=34 (Index for SERCOM3 APB clock), PAC_ID=26 (Index for SERCOM3 registers write protection), USART_ERROR_INT_SRC=76 (USART/SPI/I2C Error), USART_TX_READY_INT_SRC=78 (USART-SPI Data Register Empty/ I2C Stop Received), USART_TX_COMPLETE_INT_SRC=79 (USART-SPI Transmit Complete/ I2C Address Match), USART_RX_INT_SRC=80 (USART-SPI Receive Complete/ I2C Data Ready), SPI_TX_READY_INT_SRC=78 (USART-SPI Data Register Empty/ I2C Stop Received), SPI_TX_COMPLETE_INT_SRC=79 (USART-SPI Transmit Complete/ I2C Address Match), SPI_RX_INT_SRC=80 (USART-SPI Receive Complete/ I2C Data Ready), I2C_0_INT_SRC=76 (USART/SPI/I2C Error), I2C_1_INT_SRC=80 (USART-SPI Receive Complete/ I2C Data Ready), I2C_2_INT_SRC=81 (USART Receive Start/ SPI Slave Select Low/ I2C TX FIFO Empty), I2C_3_INT_SRC=82 (USART Clear To Send Input Change/ I2C RX FIFO Full)
SERCOM4 at 0x46004000 (SERCOM)
  pins: PAD0 PC21/D; PAD1 PC22/D; PAD2 PC23/D; PAD3 PC24/D
  parameters: CLK_REDUCTION=1 (Reduce clock options to pin 1 for SPI and USART), DMA=1 (DMA support implemented?), DMAC_ID_RX=13 (Index of DMA RX trigger), DMAC_ID_TX=14 (Index of DMA TX trigger), FIFO_IMPLEMENTED=1 (FIFO Rx/Tx implemented?), FIFO_SIZE=16 (Rx-Tx FIFO size in bytes), FSYNC_IMPLEMENTED=1 (SPI Frame Synch mode implemented?), GCLK_ID_CORE=25, GCLK_ID_SLOW=18, SPI=1 (SPI mode implemented?), TWIM=1 (TWI Master mode implemented?), TWIS=1 (TWI Slave mode implemented?), TWI_HSMODE=1 (TWI HighSpeed mode implemented?), ULTRA_IMPLEMENTATION=0 (ULTRA platform compatibility?), USART=1 (USART mode implemented?), USART_AUTOBAUD=1 (USART autobaud implemented?), USART_IRDA=1 (USART IrDA implemented?), USART_ISO7816=1 (USART ISO7816 mode implemented?), USART_LIN_MASTER=1 (USART LIN Master mode implemented?), USART_RS485=1 (USART RS485 mode implemented?), INSTANCE_ID=27 (Instance index for SERCOM4), MCLK_ID_APB=35 (Index for SERCOM4 APB clock), PAC_ID=27 (Index for SERCOM4 registers write protection), USART_ERROR_INT_SRC=83 (USART/SPI/I2C Error), USART_TX_READY_INT_SRC=85 (USART-SPI Data Register Empty/ I2C Stop Received), USART_TX_COMPLETE_INT_SRC=76 (USART-SPI Transmit Complete/ I2C Address Match), USART_RX_INT_SRC=87 (USART-SPI Receive Complete/ I2C Data Ready), SPI_TX_READY_INT_SRC=85 (USART-SPI Data Register Empty/ I2C Stop Received), SPI_TX_COMPLETE_INT_SRC=86 (USART-SPI Transmit Complete/ I2C Address Match), SPI_RX_INT_SRC=87 (USART-SPI Receive Complete/ I2C Data Ready), I2C_0_INT_SRC=83 (USART/SPI/I2C Error), I2C_1_INT_SRC=87 (USART-SPI Receive Complete/ I2C Data Ready), I2C_2_INT_SRC=88 (USART Receive Start/ SPI Slave Select Low/ I2C TX FIFO Empty), I2C_3_INT_SRC=89 (USART Clear To Send Input Change/ I2C RX FIFO Full)
SERCOM5 at 0x45804000 (SERCOM)
  pins: PAD0 PC25/D; PAD1 PC26/D; PAD2 PC27/D; PAD3 PC28/D
  parameters: CLK_REDUCTION=1 (Reduce clock options to pin 1 for SPI and USART), DMA=1 (DMA support implemented?), DMAC_ID_RX=15 (Index of DMA RX trigger), DMAC_ID_TX=16 (Index of DMA TX trigger), FIFO_IMPLEMENTED=1 (FIFO Rx/Tx implemented?), FIFO_SIZE=16 (Rx-Tx FIFO size in bytes), FSYNC_IMPLEMENTED=1 (SPI Frame Synch mode implemented?), GCLK_ID_CORE=26, GCLK_ID_SLOW=19, SPI=1 (SPI mode implemented?), TWIM=1 (TWI Master mode implemented?), TWIS=1 (TWI Slave mode implemented?), TWI_HSMODE=1 (TWI HighSpeed mode implemented?), ULTRA_IMPLEMENTATION=0 (ULTRA platform compatibility?), USART=1 (USART mode implemented?), USART_AUTOBAUD=1 (USART autobaud implemented?), USART_IRDA=1 (USART IrDA implemented?), USART_ISO7816=1 (USART ISO7816 mode implemented?), USART_LIN_MASTER=1 (USART LIN Master mode implemented?), USART_RS485=1 (USART RS485 mode implemented?), INSTANCE_ID=28 (Instance index for SERCOM5), MCLK_ID_APB=36 (Index for SERCOM5 APB clock), PAC_ID=28 (Index for SERCOM5 registers write protection), USART_ERROR_INT_SRC=90 (USART/SPI/I2C Error), USART_TX_READY_INT_SRC=92 (USART-SPI Data Register Empty/ I2C Stop Received), USART_TX_COMPLETE_INT_SRC=93 (USART-SPI Transmit Complete/ I2C Address Match), USART_RX_INT_SRC=94 (USART-SPI Receive Complete/ I2C Data Ready), SPI_TX_READY_INT_SRC=92 (USART-SPI Data Register Empty/ I2C Stop Received), SPI_TX_COMPLETE_INT_SRC=93 (USART-SPI Transmit Complete/ I2C Address Match), SPI_RX_INT_SRC=94 (USART-SPI Receive Complete/ I2C Data Ready), I2C_0_INT_SRC=90 (USART/SPI/I2C Error), I2C_1_INT_SRC=94 (USART-SPI Receive Complete/ I2C Data Ready), I2C_2_INT_SRC=95 (USART Receive Start/ SPI Slave Select Low/ I2C TX FIFO Empty), I2C_3_INT_SRC=96 (USART Clear To Send Input Change/ I2C RX FIFO Full)
SERCOM6 at 0x45806000 (SERCOM)
  pins: PAD0 PC30/D; PAD1 PC31/D; PAD2 PG00/D; PAD3 PG01/D
  parameters: CLK_REDUCTION=1 (Reduce clock options to pin 1 for SPI and USART), DMA=1 (DMA support implemented?), DMAC_ID_RX=17 (Index of DMA RX trigger), DMAC_ID_TX=18 (Index of DMA TX trigger), FIFO_IMPLEMENTED=1 (FIFO Rx/Tx implemented?), FIFO_SIZE=16 (Rx-Tx FIFO size in bytes), FSYNC_IMPLEMENTED=1 (SPI Frame Synch mode implemented?), GCLK_ID_CORE=27, GCLK_ID_SLOW=19, SPI=1 (SPI mode implemented?), TWIM=1 (TWI Master mode implemented?), TWIS=1 (TWI Slave mode implemented?), TWI_HSMODE=1 (TWI HighSpeed mode implemented?), ULTRA_IMPLEMENTATION=0 (ULTRA platform compatibility?), USART=1 (USART mode implemented?), USART_AUTOBAUD=1 (USART autobaud implemented?), USART_IRDA=1 (USART IrDA implemented?), USART_ISO7816=1 (USART ISO7816 mode implemented?), USART_LIN_MASTER=1 (USART LIN Master mode implemented?), USART_RS485=1 (USART RS485 mode implemented?), INSTANCE_ID=29 (Instance index for SERCOM6), MCLK_ID_APB=37 (Index for SERCOM6 APB clock), PAC_ID=29 (Index for SERCOM6 registers write protection), USART_ERROR_INT_SRC=97 (USART/SPI/I2C Error), USART_TX_READY_INT_SRC=99 (USART-SPI Data Register Empty/ I2C Stop Received), USART_TX_COMPLETE_INT_SRC=100 (USART-SPI Transmit Complete/ I2C Address Match), USART_RX_INT_SRC=101 (USART-SPI Receive Complete/ I2C Data Ready), SPI_TX_READY_INT_SRC=99 (USART-SPI Data Register Empty/ I2C Stop Received), SPI_TX_COMPLETE_INT_SRC=100 (USART-SPI Transmit Complete/ I2C Address Match), SPI_RX_INT_SRC=101 (USART-SPI Receive Complete/ I2C Data Ready), I2C_0_INT_SRC=97 (USART/SPI/I2C Error), I2C_1_INT_SRC=101 (USART-SPI Receive Complete/ I2C Data Ready), I2C_2_INT_SRC=102 (USART Receive Start/ SPI Slave Select Low/ I2C TX FIFO Empty), I2C_3_INT_SRC=103 (USART Clear To Send Input Change/ I2C RX FIFO Full)
SERCOM7 at 0x45000000 (SERCOM)
  pins: PAD0 PD14/D; PAD1 PD15/D; PAD2 PD16/D; PAD3 PD17/D
  parameters: CLK_REDUCTION=1 (Reduce clock options to pin 1 for SPI and USART), DMA=1 (DMA support implemented?), DMAC_ID_RX=19 (Index of DMA RX trigger), DMAC_ID_TX=20 (Index of DMA TX trigger), FIFO_IMPLEMENTED=1 (FIFO Rx/Tx implemented?), FIFO_SIZE=16 (Rx-Tx FIFO size in bytes), FSYNC_IMPLEMENTED=1 (SPI Frame Synch mode implemented?), GCLK_ID_CORE=28, GCLK_ID_SLOW=20, SPI=1 (SPI mode implemented?), TWIM=1 (TWI Master mode implemented?), TWIS=1 (TWI Slave mode implemented?), TWI_HSMODE=1 (TWI HighSpeed mode implemented?), ULTRA_IMPLEMENTATION=0 (ULTRA platform compatibility?), USART=1 (USART mode implemented?), USART_AUTOBAUD=1 (USART autobaud implemented?), USART_IRDA=1 (USART IrDA implemented?), USART_ISO7816=1 (USART ISO7816 mode implemented?), USART_LIN_MASTER=1 (USART LIN Master mode implemented?), USART_RS485=1 (USART RS485 mode implemented?), INSTANCE_ID=30 (Instance index for SERCOM7), MCLK_ID_APB=38 (Index for SERCOM7 APB clock), PAC_ID=30 (Index for SERCOM7 registers write protection), USART_ERROR_INT_SRC=104 (USART/SPI/I2C Error), USART_TX_READY_INT_SRC=106 (USART-SPI Data Register Empty/ I2C Stop Received), USART_TX_COMPLETE_INT_SRC=107 (USART-SPI Transmit Complete/ I2C Address Match), USART_RX_INT_SRC=108 (USART-SPI Receive Complete/ I2C Data Ready), SPI_TX_READY_INT_SRC=106 (USART-SPI Data Register Empty/ I2C Stop Received), SPI_TX_COMPLETE_INT_SRC=107 (USART-SPI Transmit Complete/ I2C Address Match), SPI_RX_INT_SRC=108 (USART-SPI Receive Complete/ I2C Data Ready), I2C_0_INT_SRC=104 (USART/SPI/I2C Error), I2C_1_INT_SRC=108 (USART-SPI Receive Complete/ I2C Data Ready), I2C_2_INT_SRC=109 (USART Receive Start/ SPI Slave Select Low/ I2C TX FIFO Empty), I2C_3_INT_SRC=110 (USART Clear To Send Input Change/ I2C RX FIFO Full)
SPI_IXS0 at 0x46030000 (SPI_IXS)
  pins: FSYNC PC00/J set 1 or PD02/J set 2; SCK PC01/J set 1 or PD04/J set 2; SDI PC02/J set 1 or PD03/J set 2; SDO PC03/J set 1 or PD05/J set 2
  parameters: DMAC_ID_RX=79, DMAC_ID_TX=80, GCLK_ID=44 (Index of Generic Clock), TPD_MASTER=0 (Indicates a master or slave number for TPD mode( 1=master,0=slave)), INSTANCE_ID=46 (Instance index for SPI_IXS0), MCLK_ID_APB=54 (Index for SPI_IXS0 APB clock), PAC_ID=46 (Index for SPI_IXS0 registers write protection)
SPI_IXS1 at 0x45030000 (SPI_IXS)
  pins: FSYNC PA30/J; SCK PE01/J; SDI PE02/J; SDO PE00/J
  parameters: DMAC_ID_RX=81, DMAC_ID_TX=82, GCLK_ID=45 (Index of Generic Clock), TPD_MASTER=0 (Indicates a master or slave number for TPD mode( 1=master,0=slave)), INSTANCE_ID=47 (Instance index for SPI_IXS1), MCLK_ID_APB=55 (Index for SPI_IXS1 APB clock), PAC_ID=47 (Index for SPI_IXS1 registers write protection)
SQI0 at 0x4F008000 (SQI)
  pins: CLK PC08/H; CS0 PC13/H; CS1 PC15/H; DATA0 PC09/H; DATA1 PC10/H; DATA2 PC11/H; DATA3 PC12/H
  parameters: CBUF_DEPTH=3, GCLK_ID=56 (Index of Generic Clock), SFR_ADDRESS=0x4f008000, TRXBUF_DEPTH=8, XIP_ADDRESS=0x80, XIP_CS_MSB=1, XIP_HSEL=0, INSTANCE_ID=57 (Instance index for SQI0), MCLK_ID_AHB=66 (Index for SQI0 AHB clock), PAC_ID=57 (Index for SQI0 registers write protection)
SQI1 at 0x4F009000 (SQI)
  pins: CLK PC30/H; CS0 PG03/H; CS1 PC28/H; DATA0 PC31/H; DATA1 PG00/H; DATA2 PG01/H; DATA3 PG02/H
  parameters: CBUF_DEPTH=3, GCLK_ID=57 (Index of Generic Clock), SFR_ADDRESS=0x4f009000, TRXBUF_DEPTH=8, XIP_ADDRESS=0x90, XIP_CS_MSB=1, XIP_HSEL=0, INSTANCE_ID=58 (Instance index for SQI1), MCLK_ID_AHB=67 (Index for SQI1 AHB clock), PAC_ID=58 (Index for SQI1 registers write protection)
SUPC at 0x44020000
  parameters: ADDVREG_NUM=3 (Number of additional capless regulators for USB, PLL, ...), ADDVREG_PLL_NUM=1 (Number of additional capless regulators dedicated to PLL(s) (between 0 and ADDVREG_NUM)), ADDVREG_PLL_START_INDEX=2 (Index of the first additional capless regulator dedicated to a PLL within [ADDVREG_NUM-1:0] range. Must be equal to 1 if ADDVREG_PLL_NUM=0.), BKOUT_NUM=2 (Number of BKOUT output pin), BORVDDUSB_NUM=2 (Number of BOR_USB), CHRG_PUMP_NUM=3 (Number of Charge Pump), IOB_IMPLEMENTED=0 (one if IOB feature is implemented), USER_LDO_IMPLEMENTED=0 (one if USER_LDO feature is implemented), VBAT_IMPLEMENTED=0 (one if VBAT feature (battery backup feature) is implemented.), VREGSW_NUM=4 (Number of main voltage regulator (100mA). Example: 1 for Unicorn, 4 for Riverside.), INSTANCE_ID=4 (Instance index for SUPC), MCLK_ID_APB=7 (Index for SUPC APB clock), PAC_ID=4 (Index for SUPC registers write protection)
SysTick at 0xE000E010
SystemControl at 0xE000E000
TCC0 at 0x45010000 (TCC)
  pins: WO{n} PC{n:02}/F (n=0..7)
  parameters: CC_NUM=8 (Number of Compare/Capture units), DITHERING=1 (Dithering feature implemented), DMAC_ID_MC_{n}={n+26} (Indexes of DMA Match/Compare triggers {n}) (n=0..7), DMAC_ID_OVF=25 (DMA overflow/underflow/retrigger trigger), DTI=1 (Dead-Time-Insertion feature implemented), GCLK_ID=31 (Index of Generic Clock), MASTER_SLAVE_MODE=0 (TCC type 0 : NA, 1 : Master, 2 : Slave), OTMX=1 (Output Matrix feature implemented), OW_NUM=8 (Number of Output Waveforms), PG=1 (Pattern Generation feature implemented), SIZE=32, SWAP=1 (DTI outputs swap feature implemented), INSTANCE_ID=33 (Instance index for TCC0), MCLK_ID_APB=41 (Index for TCC0 APB clock), PAC_ID=33 (Index for TCC0 registers write protection)
TCC1 at 0x45012000 (TCC)
  pins: WO{n} PB{n+10}/F (n=0..7)
  parameters: CC_NUM=8 (Number of Compare/Capture units), DITHERING=1 (Dithering feature implemented), DMAC_ID_MC_{n}={n+35} (Indexes of DMA Match/Compare triggers {n}) (n=0..7), DMAC_ID_OVF=34 (DMA overflow/underflow/retrigger trigger), DTI=1 (Dead-Time-Insertion feature implemented), GCLK_ID=32 (Index of Generic Clock), MASTER_SLAVE_MODE=0 (TCC type 0 : NA, 1 : Master, 2 : Slave), OTMX=1 (Output Matrix feature implemented), OW_NUM=8 (Number of Output Waveforms), PG=1 (Pattern Generation feature implemented), SIZE=32, SWAP=1 (DTI outputs swap feature implemented), INSTANCE_ID=34 (Instance index for TCC1), MCLK_ID_APB=42 (Index for TCC1 APB clock), PAC_ID=34 (Index for TCC1 registers write protection)
TCC2 at 0x45014000 (TCC)
  pins: WO0 PD10/F set 1; WO1 PD11/F set 1; WO2 PD12/F set 1; WO3 PA04/F set 1; WO4 PA03/F set 1; WO5 PA02/F set 1
  parameters: CC_NUM=6 (Number of Compare/Capture units), DITHERING=1 (Dithering feature implemented), DMAC_ID_MC_{n}={n+44} (Indexes of DMA Match/Compare triggers {n}) (n=0..5), DMAC_ID_OVF=43 (DMA overflow/underflow/retrigger trigger), DTI=1 (Dead-Time-Insertion feature implemented), GCLK_ID=33 (Index of Generic Clock), MASTER_SLAVE_MODE=0 (TCC type 0 : NA, 1 : Master, 2 : Slave), OTMX=1 (Output Matrix feature implemented), OW_NUM=6 (Number of Output Waveforms), PG=1 (Pattern Generation feature implemented), SIZE=32, SWAP=1 (DTI outputs swap feature implemented), INSTANCE_ID=35 (Instance index for TCC2), MCLK_ID_APB=43 (Index for TCC2 APB clock), PAC_ID=35 (Index for TCC2 registers write protection)
TCC3 at 0x45810000 (TCC)
  pins: WO0 PA05/F; WO1 PA06/F
  parameters: CC_NUM=2 (Number of Compare/Capture units), DITHERING=1 (Dithering feature implemented), DMAC_ID_MC_0=51 (Indexes of DMA Match/Compare triggers 0), DMAC_ID_MC_1=52 (Indexes of DMA Match/Compare triggers 1), DMAC_ID_OVF=50 (DMA overflow/underflow/retrigger trigger), DTI=1 (Dead-Time-Insertion feature implemented), GCLK_ID=34 (Index of Generic Clock), MASTER_SLAVE_MODE=0 (TCC type 0 : NA, 1 : Master, 2 : Slave), OTMX=1 (Output Matrix feature implemented), OW_NUM=2 (Number of Output Waveforms), PG=1 (Pattern Generation feature implemented), SIZE=32, SWAP=1 (DTI outputs swap feature implemented), INSTANCE_ID=36 (Instance index for TCC3), MCLK_ID_APB=44 (Index for TCC3 APB clock), PAC_ID=36 (Index for TCC3 registers write protection)
TCC4 at 0x45812000 (TCC)
  pins: WO0 PC12/F set 1 or PC29/F set 2; WO1 PC13/F set 1 or PD13/F set 2
  parameters: CC_NUM=2 (Number of Compare/Capture units), DITHERING=1 (Dithering feature implemented), DMAC_ID_MC_0=54 (Indexes of DMA Match/Compare triggers 0), DMAC_ID_MC_1=55 (Indexes of DMA Match/Compare triggers 1), DMAC_ID_OVF=53 (DMA overflow/underflow/retrigger trigger), DTI=1 (Dead-Time-Insertion feature implemented), GCLK_ID=35 (Index of Generic Clock), MASTER_SLAVE_MODE=0 (TCC type 0 : NA, 1 : Master, 2 : Slave), OTMX=1 (Output Matrix feature implemented), OW_NUM=2 (Number of Output Waveforms), PG=1 (Pattern Generation feature implemented), SIZE=32, SWAP=1 (DTI outputs swap feature implemented), INSTANCE_ID=37 (Instance index for TCC4), MCLK_ID_APB=45 (Index for TCC4 APB clock), PAC_ID=37 (Index for TCC4 registers write protection)
TCC5 at 0x46010000 (TCC)
  pins: WO0 PC08/F set 1 or PC23/F set 2; WO1 PC09/F set 1 or PC24/F set 2
  parameters: CC_NUM=2 (Number of Compare/Capture units), DITHERING=1 (Dithering feature implemented), DMAC_ID_MC_0=57 (Indexes of DMA Match/Compare triggers 0), DMAC_ID_MC_1=58 (Indexes of DMA Match/Compare triggers 1), DMAC_ID_OVF=56 (DMA overflow/underflow/retrigger trigger), DTI=1 (Dead-Time-Insertion feature implemented), GCLK_ID=36 (Index of Generic Clock), MASTER_SLAVE_MODE=0 (TCC type 0 : NA, 1 : Master, 2 : Slave), OTMX=1 (Output Matrix feature implemented), OW_NUM=2 (Number of Output Waveforms), PG=1 (Pattern Generation feature implemented), SIZE=32, SWAP=1 (DTI outputs swap feature implemented), INSTANCE_ID=38 (Instance index for TCC5), MCLK_ID_APB=46 (Index for TCC5 APB clock), PAC_ID=38 (Index for TCC5 registers write protection)
TCC6 at 0x46012000 (TCC)
  pins: WO0 PC10/F set 1 or PC21/F set 2; WO1 PC11/F set 1 or PC22/F set 2
  parameters: CC_NUM=2 (Number of Compare/Capture units), DITHERING=1 (Dithering feature implemented), DMAC_ID_MC_0=60 (Indexes of DMA Match/Compare triggers 0), DMAC_ID_MC_1=61 (Indexes of DMA Match/Compare triggers 1), DMAC_ID_OVF=59 (DMA overflow/underflow/retrigger trigger), DTI=1 (Dead-Time-Insertion feature implemented), GCLK_ID=37 (Index of Generic Clock), MASTER_SLAVE_MODE=0 (TCC type 0 : NA, 1 : Master, 2 : Slave), OTMX=0 (Output Matrix feature implemented), OW_NUM=2 (Number of Output Waveforms), PG=0 (Pattern Generation feature implemented), SIZE=32, SWAP=1 (DTI outputs swap feature implemented), INSTANCE_ID=39 (Instance index for TCC6), MCLK_ID_APB=47 (Index for TCC6 APB clock), PAC_ID=39 (Index for TCC6 registers write protection)
TCC7 at 0x46810000 (TCC)
  pins: WO0 PA22/F set 1 or PD08/F set 2; WO1 PA23/F set 1 or PD07/F set 2
  parameters: CC_NUM=2 (Number of Compare/Capture units), DITHERING=1 (Dithering feature implemented), DMAC_ID_MC_0=63 (Indexes of DMA Match/Compare triggers 0), DMAC_ID_MC_1=64 (Indexes of DMA Match/Compare triggers 1), DMAC_ID_OVF=62 (DMA overflow/underflow/retrigger trigger), DTI=1 (Dead-Time-Insertion feature implemented), GCLK_ID=38 (Index of Generic Clock), MASTER_SLAVE_MODE=0 (TCC type 0 : NA, 1 : Master, 2 : Slave), OTMX=0 (Output Matrix feature implemented), OW_NUM=2 (Number of Output Waveforms), PG=0 (Pattern Generation feature implemented), SIZE=32, SWAP=1 (DTI outputs swap feature implemented), INSTANCE_ID=40 (Instance index for TCC7), MCLK_ID_APB=48 (Index for TCC7 APB clock), PAC_ID=40 (Index for TCC7 registers write protection)
TCC8 at 0x46812000 (TCC)
  pins: WO0 PA21/F set 1 or PC14/F set 2; WO1 PC15/F set 1 or PD23/F set 2
  parameters: CC_NUM=2 (Number of Compare/Capture units), DITHERING=1 (Dithering feature implemented), DMAC_ID_MC_0=66 (Indexes of DMA Match/Compare triggers 0), DMAC_ID_MC_1=67 (Indexes of DMA Match/Compare triggers 1), DMAC_ID_OVF=65 (DMA overflow/underflow/retrigger trigger), DTI=1 (Dead-Time-Insertion feature implemented), GCLK_ID=39 (Index of Generic Clock), MASTER_SLAVE_MODE=0 (TCC type 0 : NA, 1 : Master, 2 : Slave), OTMX=0 (Output Matrix feature implemented), OW_NUM=2 (Number of Output Waveforms), PG=0 (Pattern Generation feature implemented), SIZE=32, SWAP=1 (DTI outputs swap feature implemented), INSTANCE_ID=41 (Instance index for TCC8), MCLK_ID_APB=49 (Index for TCC8 APB clock), PAC_ID=41 (Index for TCC8 registers write protection)
TCC9 at 0x46814000 (TCC)
  pins: WO0 PD04/F set 1; WO1 PD05/F set 1; WO2 PD06/F set 1; WO3 PD03/F set 1; WO4 PD02/F set 1; WO5 PC20/F set 1
  parameters: CC_NUM=6 (Number of Compare/Capture units), DITHERING=1 (Dithering feature implemented), DMAC_ID_MC_{n}={n+69} (Indexes of DMA Match/Compare triggers {n}) (n=0..5), DMAC_ID_OVF=68 (DMA overflow/underflow/retrigger trigger), DTI=1 (Dead-Time-Insertion feature implemented), GCLK_ID=40 (Index of Generic Clock), MASTER_SLAVE_MODE=0 (TCC type 0 : NA, 1 : Master, 2 : Slave), OTMX=1 (Output Matrix feature implemented), OW_NUM=6 (Number of Output Waveforms), PG=1 (Pattern Generation feature implemented), SIZE=32, SWAP=1 (DTI outputs swap feature implemented), INSTANCE_ID=42 (Instance index for TCC9), MCLK_ID_APB=50 (Index for TCC9 APB clock), PAC_ID=42 (Index for TCC9 registers write protection)
TPI at 0xE0040000
TRAM at 0x44824000
  parameters: ADDR_MSB=10 (Value of the MSB bit of physical RAM address), INSTANCE_ID=17 (Instance index for TRAM), MCLK_ID_APB=21 (Index for TRAM APB clock), PAC_ID=17 (Index for TRAM registers write protection)
TRNG at 0x44870000
  parameters: INSTANCE_ID=59 (Instance index for TRNG), MCLK_ID_APB=68 (Index for TRNG APB clock), PAC_ID=59 (Index for TRNG registers write protection)
USBHS0 at 0x4F010000 (USBHS)
  pins: USB0ID USBID0; USB0PN USBDM0; USB0PP USBDP0; USBRBIAS USBRBIAS0; VBUS VBUS0
  parameters: MCLK_ID_AHB=73 (Index for USBHS0 AHB clock)
USBHS1 at 0x4F012000 (USBHS)
  pins: USB0ID USBID1; USB0PN USBDM1; USB0PP USBDP1; USBRBIAS USBRBIAS1; VBUS VBUS1
  parameters: MCLK_ID_AHB=74 (Index for USBHS1 AHB clock)
WDT at 0x44070000
  parameters: FUSES_UPDATE_SUPPORT=0 (WDT Fuse Update Support), INSTANCE_ID=11 (Instance index for WDT), MCLK_ID_APB=14 (Index for WDT APB clock), PAC_ID=11 (Index for WDT registers write protection)

## Interrupts
-15 Reset — Reset Vector, invoked on Power up and warm reset
-14 NonMaskableInt — Non maskable Interrupt, cannot be stopped or preempted
-13 HardFault — Hard Fault, all classes of Fault
-12 MemoryManagement — Memory Management, MPU mismatch, including Access Violation and No Match
-11 BusFault — Bus Fault, Pre-Fetch-, Memory Access Fault, other address/memory related Fault
-10 UsageFault — Usage Fault, i.e. Undef Instruction, Illegal State Transition
-5 SVCall — System Service Call via SVC instruction
-4 DebugMonitor
-2 PendSV — Pendable request for system service
-1 SysTick — System Tick Timer
0 FCW — Flash Write Controller Interrupt
1 FCR_ECCERR (FCR) — Flash Read Controller ECC Error
2 FCR_CRC_FAULT (FCR) — Flash Read Controller CRC Fault
3 PM — Power Manager
4 SUPC — Supply Controller
5 OSCCTRL_FAIL (OSCCTRL) — External Oscillator Fail
6 OSCCTRL_XOSCRDY (OSCCTRL) — External Oscillator Ready
7 OSCCTRL_DFLLRDY (OSCCTRL) — DFLL Ready
8 OSCCTRL_OTHER (OSCCTRL) — DFLL Other Interrupt
9 OSCCTRL_LOCK (OSCCTRL) — PLL Lock
10 OSC32KCTRL_FAIL (OSC32KCTRL) — 32K Oscillator Fail
11 OSC32KCTRL_RDY (OSC32KCTRL) — 32K Oscillator Ready
12 MCLK — Main Clock
13 FREQM — Frequency Meter
14 WDT — Watchdog Timer
15 RTC_TAMPER (RTC)
16 RTC_OVF (RTC) — RTC Overflow
17 RTC_PERIOD (RTC)
18 RTC_COMPARE (RTC)
{n+19} EIC_EXTINT_{n} (EIC) (n=0..15) — External Interrupt {n}
35 PAC — Peripheral Access Controller
36 DRMTCM — TCM RAM ECC Interrupt
37 MCRAMC — Multi-Channel RAM Controller
38 TRAM — Trust RAM Interrupt
39 DMA_PRI3 (DMA) — DMA Priority 3 Interrupt
40 DMA_PRI2 (DMA) — DMA Priority 2 Interrupt
41 DMA_PRI1 (DMA) — DMA Priority 1 Interrupt
42 DMA_PRI0 (DMA) — DMA Priority 0 Interrupt
43 EVSYS_0 (EVSYS) — Event System InterruptChannel 0
{n+43} EVSYS_{n} (EVSYS) (n=1..11) — Event System Channel {n}
{7n+55} SERCOM{n}_6 (SERCOM{n}) (n=0..7) — USART/SPI/I2C Error
{7n+56} SERCOM{n}_5 (SERCOM{n}) (n=0..7) — USART Receive Break
{7n+57} SERCOM{n}_0 (SERCOM{n}) (n=0..7) — USART-SPI Data Register Empty/ I2C Stop Received
{7n+58} SERCOM{n}_1 (SERCOM{n}) (n=0..7) — USART-SPI Transmit Complete/ I2C Address Match
{7n+59} SERCOM{n}_2 (SERCOM{n}) (n=0..7) — USART-SPI Receive Complete/ I2C Data Ready
{7n+60} SERCOM{n}_3 (SERCOM{n}) (n=0..7) — USART Receive Start/ SPI Slave Select Low/ I2C TX FIFO Empty
{7n+61} SERCOM{n}_4 (SERCOM{n}) (n=0..7) — USART Clear To Send Input Change/ I2C RX FIFO Full
125 TCC0_OTHER (TCC0) — Error/Overflow/Underflow/Fault Interrupt
126 TCC0_CNT_TRIG (TCC0) — Counter/Re-Trigger Interrupt
{n+127} TCC0_MC{n} (TCC0) (n=0..7) — TCC Match/Compare {n}
135 TCC1_OTHER (TCC1) — Error/Overflow/Underflow/Fault Interrupt
136 TCC1_CNT_TRIG (TCC1) — Counter/Re-Trigger Interrupt
{n+137} TCC1_MC{n} (TCC1) (n=0..7) — TCC Match/Compare {n}
145 TCC2_OTHER (TCC2) — Error/Overflow/Underflow/Fault Interrupt
146 TCC2_CNT_TRIG (TCC2) — Counter/Re-Trigger Interrupt
147 TCC2_MC0 (TCC2) — TCC Match/Compare 0
148 TCC2_MC1 (TCC2) — TCC Match/Compare 1
149 TCC2_MC2 (TCC2) — TCC Match/Compare 2
150 TCC2_MC3 (TCC2) — TCC Match/Compare 3
151 TCC2_MC4 (TCC2) — TCC Match/Compare 4
152 TCC2_MC5 (TCC2) — TCC Match/Compare 5
153 TCC3_OTHER (TCC3) — Error/Overflow/Underflow/Fault Interrupt
154 TCC3_CNT_TRIG (TCC3) — Counter/Re-Trigger Interrupt
155 TCC3_MC0 (TCC3) — TCC Match/Compare 0
156 TCC3_MC1 (TCC3) — TCC Match/Compare 1
157 TCC4_OTHER (TCC4) — Error/Overflow/Underflow/Fault Interrupt
158 TCC4_CNT_TRIG (TCC4) — Counter/Re-Trigger Interrupt
159 TCC4_MC0 (TCC4) — TCC Match/Compare 0
160 TCC4_MC1 (TCC4) — TCC Match/Compare 1
161 TCC5_OTHER (TCC5) — Error/Overflow/Underflow/Fault Interrupt
162 TCC5_CNT_TRIG (TCC5) — Counter/Re-Trigger Interrupt
163 TCC5_MC0 (TCC5) — TCC Match/Compare 0
164 TCC5_MC1 (TCC5) — TCC Match/Compare 1
165 TCC6_OTHER (TCC6) — Error/Overflow/Underflow/Fault Interrupt
166 TCC6_CNT_TRIG (TCC6) — Counter/Re-Trigger Interrupt
167 TCC6_MC0 (TCC6) — TCC Match/Compare 0
168 TCC6_MC1 (TCC6) — TCC Match/Compare 1
169 TCC7_OTHER (TCC7) — Error/Overflow/Underflow/Fault Interrupt
170 TCC7_CNT_TRIG (TCC7) — Counter/Re-Trigger Interrupt
171 TCC7_MC0 (TCC7) — TCC Match/Compare 0
172 TCC7_MC1 (TCC7) — TCC Match/Compare 1
173 TCC8_OTHER (TCC8) — Error/Overflow/Underflow/Fault Interrupt
174 TCC8_CNT_TRIG (TCC8) — Counter/Re-Trigger Interrupt
175 TCC8_MC0 (TCC8) — TCC Match/Compare 0
176 TCC8_MC1 (TCC8) — TCC Match/Compare 1
177 TCC9_OTHER (TCC9) — Error/Overflow/Underflow/Fault Interrupt
178 TCC9_CNT_TRIG (TCC9) — Counter/Re-Trigger Interrupt
179 TCC9_MC0 (TCC9) — TCC Match/Compare 0
180 TCC9_MC1 (TCC9) — TCC Match/Compare 1
181 TCC9_MC2 (TCC9) — TCC Match/Compare 2
182 TCC9_MC3 (TCC9) — TCC Match/Compare 3
183 TCC9_MC4 (TCC9) — TCC Match/Compare 4
184 TCC9_MC5 (TCC9) — TCC Match/Compare 5
185 ADC_GLOBAL (ADC) — ADC Global Interrupt
186 ADC_CORE1 (ADC) — ADC Core 1 Interrupt
187 ADC_CORE2 (ADC) — ADC Core 2 Interrupt
188 ADC_CORE3 (ADC) — ADC Core 3 Interrupt
189 ADC_CORE4 (ADC) — ADC Core 4 Interrupt
190 AC — Analog Comparator Interrupt
191 PTC — Peripheral Touch Controller
192 SPI_IXS0 — Audio SPI Interrupt 0
193 SPI_IXS1 — Audio SPI Interrupt 1
194 CAN0 — Controller Area Network 0
195 CAN1 — Controller Area Network 1
196 CAN2 — Controller Area Network 2
197 CAN3 — Controller Area Network 3
198 CAN4 — Controller Area Network 4
199 CAN5 — Controller Area Network 5
202 ETH_PRI_Q_0 (ETH) — Ethernet MAC Interrupt
203 ETH_PRI_Q_1 (ETH) — Ethernet MAC Queue 1 Interrupt
204 ETH_PRI_Q_2 (ETH) — Ethernet MAC Queue 2 Interrupt
205 ETH_PRI_Q_3 (ETH) — Ethernet MAC Queue 3 Interrupt
206 ETH_PRI_Q_4 (ETH) — Ethernet MAC Queue 4 Interrupt
207 ETH_PRI_Q_5 (ETH) — Ethernet MAC Queue 5 Interrupt
208 SQI0 — Quad SPI Interrupt 0
209 SQI1 — Quad SPI Interrupt 1
210 TRNG — True Random Generator
211 SDMMC0 — SD/MMC Host Controller Interrupt 0
212 SDMMC1 — SD/MMC Host Controller Interrupt 1
213 USBHS0 — High Speed USB Interrupt 0
214 USBHS1 — High Speed USB Interrupt 1
215 HSM_TAMPER (HSM) — Hardware Security Module Tamper Interrupt
216 HSM_TXINT (HSM) — Hardware Security Module Transmit Interrupt
217 HSM_RXINT (HSM) — Hardware Security Module Receive Interrupt
218 MLB_GENERAL (MLB) — Media Local Bus General Interrupt
219 MLB_BUSREQ (MLB) — Media Local Bus Request Interrupt
220 CM7H_CTIIRQ_0 (CM7H) — Cross Trigger Interface Interrupt 0
221 CM7H_CTIIRQ_1 (CM7H) — Cross Trigger Interface Interrupt 1

## Event generators
1 SUPC_LVDET, 2 OSCCTRL_XOSC_FAIL, 3 OSC32KCTRL_XOSC32K_FAIL, 4 FREQM_DONE, 5 FREQM_WINMON, {n+6} RTC_PER_{n} (n=0..7), {n+14} RTC_CMP_{n} (n=0..3), 18 RTC_TAMPER, 19 RTC_OVF, 20 RTC_PERD, {n+21} EIC_EXTINT_{n} (n=0..15), 37 PAC_ACCERR, {n+38} DMA_CH_{n} (n=0..15), {11n+54} TCC{n}_OVF (n=0..2), {11n+55} TCC{n}_TRG (n=0..2), {11n+56} TCC{n}_CNT (n=0..2), {11n+57} TCC{n}_MC_0 (n=0..2), {11n+58} TCC{n}_MC_1 (n=0..2), {11n+59} TCC{n}_MC_2 (n=0..2), {11n+60} TCC{n}_MC_3 (n=0..2), {11n+61} TCC{n}_MC_4 (n=0..2), {11n+62} TCC{n}_MC_5 (n=0..2), 63 TCC0_MC_6, 64 TCC0_MC_7, 74 TCC1_MC_6, 75 TCC1_MC_7, {5n+70} TCC{n}_OVF (n=3..9), {5n+71} TCC{n}_TRG (n=3..9), {5n+72} TCC{n}_CNT (n=3..9), {5n+73} TCC{n}_MC_0 (n=3..9), {5n+74} TCC{n}_MC_1 (n=3..9), 120 TCC9_MC_2, 121 TCC9_MC_3, 122 TCC9_MC_4, 123 TCC9_MC_5, {n+124} ADC_CHRDYC_{n} (n=0..3), {n+128} ADC_CMP_{n} (n=0..3), 132 AC_COMP_0, 133 AC_COMP_1, 134 AC_WIN_0, 135 PTC_EOC, 136 PTC_WCOMP, 137 ETH_TSU_CMP, 138 TRNG_READY

## Event users
0 FREQM_START, 1 RTC_TAMPER, {n+2} PORT_EV_{n} (n=0..3), {n+6} DMA_CHSTRT_{n} (n=0..15), {n+22} DMA_CHAUX_{n} (n=0..15), {10n+38} TCC{n}_EV_0 (n=0..2), {10n+39} TCC{n}_EV_1 (n=0..2), {10n+40} TCC{n}_MC_0 (n=0..2), {10n+41} TCC{n}_MC_1 (n=0..2), {10n+42} TCC{n}_MC_2 (n=0..2), {10n+43} TCC{n}_MC_3 (n=0..2), {10n+44} TCC{n}_MC_4 (n=0..2), {10n+45} TCC{n}_MC_5 (n=0..2), 46 TCC0_MC_6, 47 TCC0_MC_7, 56 TCC1_MC_6, 57 TCC1_MC_7, {4n+54} TCC{n}_EV_0 (n=3..9), {4n+55} TCC{n}_EV_1 (n=3..9), {4n+56} TCC{n}_MC_0 (n=3..9), {4n+57} TCC{n}_MC_1 (n=3..9), 94 TCC9_MC_2, 95 TCC9_MC_3, 96 TCC9_MC_4, 97 TCC9_MC_5, {n+98} ADC_TRIGGERS_{n} (n=0..10), 109 AC_SOC_0, 110 AC_SOC_1, 111 PTC_DSEQR, 112 PTC_STCONV, {n+113} HSM_TAMPER_{n} (n=0..3)

## Properties
SIGNATURES: DSU_DID=0x19210053

## Pinouts (pin number, pad)
PIC32CZCA176B: A2 PD10, A3 PD09, A4 PD06, A5 PD05, A6 PD19, A7 PD18, A8 PD17, A9 PD14, A10 PD01, A11 PD00, A12 USBID1, A13 USBDM1, A14 VBUS0, A15 USBID0, B1 PA01, B2 PD12, B3 PD11, B4 PD08, B5 PD20, B6 VDDREG, B7 PD04, B8 PD03, B9 PD02, B10 PD23, B11 VSSUSBD, B12 VDDREG, B13 USBDP1, B14 VSSUSBA, B15 USBDP0, B16 USBDM0, C1 PA03, C2 PA02, C15 PC20, C16 PC19, D1 PA04, D2 PA21, D4 PA00, D13 VCCA3P30, D15 PC18, D16 PC17, E1 PA30, E2 PA06, E5 PA05, E6 PD21, E7 PD16, E8 PD13, E9 USBRBIAS1, E10 VBUS1, E11 VCCA3P31, E12 USBRBIAS0, E15 VSSF, E16 VDDF, F1 PA31, F2 PA22, F5 PE01, F6 PD07, F7 PD15, F8 VSS1, F9 VDDIO, F10 VSS2, F11 PC14, F12 PC15, F15 PC29, F16 RESET_N, G1 PA23, G2 PE00, G5 PE03, G6 PE02, G7 VSS3, G8 VDDIO, G9 VSS4, G10 VDDIO, G11 VSS5, G12 PC27, G15 PC12, G16 PC13, H1 PA07, H2 PA08, H5 PB01, H6 VDDIO, H7 VSSUSBANA1, H8 VDDIO, H9 VSSUSBANA0, H10 VDDIO, H11 VSS, H12 PG00, H15 PG03, H16 PC28, J1 PA09, J2 PA10, J5 PB02, J6 PB23, J7 VDDIO, J8 VSS, J9 VDDIO, J10 VSS6, J11 VDDIO, J12 PC26, J15 PC10, J16 PC11, K1 PA24, K2 PA25, K5 PB03, K6 PB22, K7 VDDIO, K8 VSS10, K9 VDDIO, K10 VSS9, K11 VDDIO, K12 PC31, K15 PG01, K16 PG02, L1 PA26, L2 PA27, L5 PB18, L6 PB06, L7 VSS11, L8 VDDIO, L9 VSS, L10 PB31, L11 PB14, L12 PC30, L15 PC24, L16 PC25, M1 PA11, M2 PA12, M5 PB19, M6 PB21, M7 PB07, M8 PB08, M9 PB30, M10 PB24, M11 PB13, M12 PC01, M15 PC23, M16 PC09, N1 PA13, N2 PA14, N4 PB00, N13 PC00, N15 PC22, N16 PC08, P1 PA28, P2 PA29, P15 PC06, P16 PC07, R1 PA15, R2 PA16, R3 PA18, R4 PA20, R5 AVSS, R6 AVDD, R7 PB27, R8 PF05, R9 PB11, R10 VDDREG, R11 PB12, R12 PB15, R13 PB17, R14 PC02, R15 PC05, R16 PC21, T2 PA19, T3 PA17, T4 PB20, T5 PB04, T6 PB05, T7 PB28, T8 PB09, T9 PB10, T10 PB29, T11 PB25, T12 PB26, T13 PB16, T14 PC03, T15 PC04
PIC32CZCA176DR: A1 PA00, A2 PA02, A3 PA04, A4 VDDIO, A5 PA05, A6 PA21, A7 PA31, A8 PA23, A9 PE01, A10 GND, A11 PA07, A12 PA09, A13 PA25, A14 GND, A15 PA10, A16 PA26, A17 PA12, A18 PA14, A19 PA29, A20 GND, A21 VDDIO, A22 PA17, A23 PA19, A24 PA20, A25 PB00, A26 PB02, A27 PB18, A28 PB20, A29 AVDD, A30 PB05, A31 VDDIO, A32 PB21, A33 PB22, A34 PB07, A35 PB27, A36 GND, A37 PF05, A38 PB10, A39 PB11, A40 VDDIO, A41 PB30, A42 PB24, A43 PB26, A44 VDDREG, A45 PB13, A46 PB15, A47 PB16, A48 PB17, A49 PC00, A50 PC02, A51 PC04, A52 VSSF2, A53 PC06, A54 PC21, A55 PC07, A56 PC23, A57 PC09, A58 VDDIO, A59 PC30, A60 PC26, A61 PG01, A62 PC10, A63 VDDIO, A64 PC27, A65 PC28, A66 PC13, A67 PC14, A68 VDDF, A69 RESET_N, A70 PC18, A71 PC19, A72 PC20, A73 USBDM0, A74 USBDP0, A75 USBID0, A76 VBUS0, A77 VDDREG, A78 USBDM1, A79 VCCA3P31, A80 VSSUSBD, A81 USBRBIAS1, A82 PD01, A83 PD23, A84 PD02, A85 GND, A86 PD15, A87 PD17, A88 PD18, A89 PD05, A90 PD20, A91 PD21, A92 VDDREG, A93 VDDIO, A94 PD09, A95 PD11, A96 PD12, B1 PA01, B2 PA03, B3 GND, B4 PA06, B5 PA30, B6 PA22, B7 PE00, B8 PE02, B9 VDDIO, B10 PA08, B11 PA24, B12 PE03, B13 VDDIO, B14 PA11, B15 PA27, B16 PA13, B17 PA28, B18 PA15, B19 PA16, B20 PA18, B21 PB01, B22 PB03, B23 PB19, B24 AVSS, B25 PB04, B26 GND, B27 PB06, B28 PB23, B29 PB08, B30 VDDIO, B31 PB28, B32 PB09, B33 PB29, B34 GND, B35 PB31, B36 PB25, B37 PB12, B38 GND, B39 VDDIO, B40 PB14, B41 PC01, B42 PC03, B43 VDDF, B44 PC05, B45 PC22, B46 PC08, B47 PC24, B48 PC25, B49 GND, B50 PC31, B51 PG00, B52 PG02, B53 PC11, B54 GND, B55 PG03, B56 PC12, B57 PC29, B58 PC15, B59 VSSF1, B60 PC17, B61 VCCA3P30, B62 VSSUSBA, B63 USBRBIAS0, B64 GND, B65 USBDP1, B66 USBID1, B67 VBUS1, B68 PD00, B69 PD13, B70 PD14, B71 PD03, B72 VDDIO, B73 PD16, B74 PD04, B75 PD19, B76 PD06, B77 PD07, B78 GND, B79 PD08, B80 PD10
PIC32CZCA176: 1 PA00, 2 PA01, 3 PA02, 4 PA03, 5 PA04, 6 GND, 7 VDDIO, 8 PA05, 9 PA06, 10 PA21, 11 PA30, 12 PA31, 13 PA22, 14 PA23, 15 PE00, 16 PE01, 17 PE02, 18 GND, 19 VDDIO, 20 PA07, 21 PA08, 22 PA09, 23 PA24, 24 PA25, 25 PE03, 26 GND, 27 VDDIO, 28 PA10, 29 PA11, 30 PA26, 31 PA27, 32 PA12, 33 PA13, 34 PA14, 35 PA28, 36 PA29, 37 PA15, 38 GND, 39 VDDIO, 40 PA16, 41 PA17, 42 PA18, 43 PA19, 44 PA20, 45 PB00, 46 PB01, 47 PB02, 48 PB03, 49 PB18, 50 PB19, 51 PB20, 52 AVSS, 53 AVDD, 54 PB04, 55 PB05, 56 VDDIO, 57 GND, 58 PB21, 59 PB06, 60 PB22, 61 PB23, 62 PB07, 63 PB08, 64 PB27, 65 VDDIO, 66 GND, 67 PB28, 68 PF05, 69 PB09, 70 PB10, 71 PB11, 72 PB29, 73 VDDIO, 74 GND, 75 PB30, 76 PB31, 77 PB24, 78 PB25, 79 PB26, 80 PB12, 81 VDDREG, 82 GND, 83 VDDIO, 84 PB13, 85 PB14, 86 PB15, 87 PB16, 88 PB17, 89 PC00, 90 PC01, 91 PC02, 92 PC03, 93 PC04, 94 VDDF, 95 VSSF2, 96 PC05, 97 PC06, 98 PC21, 99 PC22, 100 PC07, 101 PC08, 102 PC23, 103 PC24, 104 PC09, 105 PC25, 106 VDDIO, 107 GND, 108 PC30, 109 PC31, 110 PC26, 111 PG00, 112 PG01, 113 PG02, 114 PC10, 115 PC11, 116 VDDIO, 117 GND, 118 PC27, 119 PG03, 120 PC28, 121 PC12, 122 PC13, 123 PC29, 124 PC14, 125 PC15, 126 VDDF, 127 VSSF1, 128 RESET_N, 129 PC17, 130 PC18, 131 PC19, 132 PC20, 133 USBDP0, 134 USBDM0, 135 USBID0, 136 VCCA3P30, 137 VSSUSBA, 138 VBUS0, 139 USBRBIAS0, 140 GND, 141 VDDREG, 142 USBDP1, 143 USBDM1, 144 USBID1, 145 VCCA3P31, 146 VSSUSBD, 147 VBUS1, 148 USBRBIAS1, 149 PD00, 150 PD01, 151 PD13, 152 PD23, 153 PD14, 154 PD02, 155 PD03, 156 GND, 157 VDDIO, 158 PD15, 159 PD16, 160 PD17, 161 PD04, 162 PD18, 163 PD19, 164 PD05, 165 PD06, 166 PD20, 167 PD21, 168 PD07, 169 VDDREG, 170 GND, 171 VDDIO, 172 PD08, 173 PD09, 174 PD10, 175 PD11, 176 PD12

## Notices in the file
Copyright (c) 2021 Microchip Technology Inc.
SPDX-License-Identifier: Apache-2.0
Licensed under the Apache License, Version 2.0 (the "License");
you may not use this file except in compliance with the License.
You may obtain a copy of the License at
http://www.apache.org/licenses/LICENSE-2.0
Unless required by applicable law or agreed to in writing, software
distributed under the License is distributed on an "AS IS" BASIS,
WITHOUT WARRANTIES OR CONDITIONS OF ANY KIND, either express or implied.
See the License for the specific language governing permissions and
limitations under the License.
