# SAM9X60 device description
Architecture: ARM926EJS; Family: SAM9; Series: SAM9X
Programming and debug interfaces: JTAG, SWD
Registers are 32-bit, read-write, no defined reset value unless marked. A register's access mark holds for its fields unless they carry their own. Offsets are from the block's base; lines under a group give offsets from that group; [hi:lo] are bit positions; {n}, {i} and the like mark numbered series; 'fields as' and 'values as' point back to an identical list; <NAME> marks a mode.

## Ordering variants
SAM9X60-CU: BGA228, up to 600 MHz, +0 to +0 C, +0 to +0 V

## Memory
base space: start 0 size 0x100000000, little endian
  0x00100000 ECC_ROM size 0x00100000 other
  0x00300000 SRAM0 size 0x00100000 other, executable
  0x00400000 SRAM1 size 0x00100000 other, executable
  0x00500000 UDPHS_RAM size 0x00100000 other
  0x00600000 UHPHS_OHCI size 0x00100000 other
  0x00700000 UHPHS_EHCI size 0x00100000 other
  0x10000000 EBI_CS0 size 0x10000000 other, executable
  0x20000000 EBI_CS1 size 0x10000000 other, executable
  0x20000000 EBI_MPDDR size 0x10000000 other
  0x20000000 SDRAM_CS size 0x10000000 other
  0x30000000 EBI_CS2 size 0x10000000 other, executable
  0x40000000 EBI_CS3 size 0x10000000 other, executable
  0x40000000 EBI_NF size 0x10000000 other
  0x50000000 EBI_CS4 size 0x10000000 other, executable
  0x60000000 EBI_CS5 size 0x10000000 other, executable
  0x70000000 QSPIMEM size 0x10000000 other, executable
  0x80000000 SDMMC0 size 0x00100000 other, executable
  0x90000000 SDMMC1 size 0x00100000 other, executable
  0xEFF00000 OTPC size 0x00001000 other

## Peripheral instances (address, pins/pin function, parameters)
ADC at 0xF804C000
  pins: ADTRG PB18/B; AD0 PB11/X1; AD1 PB12/X1; AD2 PB13/X1; AD3 PB14/X1; AD4 PB15/X1; AD5 PB16/X1; AD6 PB17/X1; AD7 PB6/X1; AD8 PB7/X1; AD9 PB8/X1; AD10 PB9/X1; AD11 PB10/X1
  parameters: INSTANCE_ID=19, CLOCK_ID=19, DMAC_ID_RX=40
AES at 0xF0034000
  parameters: INSTANCE_ID=39, CLOCK_ID=39, DMAC_ID_TX=32, DMAC_ID_RX=33
AIC at 0xFFFFF100
  pins: FIQ PC31/A; IRQ PB18/A
  parameters: ID_EXT_FIQ=0, ID_EXT_IRQ=31
BSC at 0xFFFFFE54
CAN0 at 0xF8000000 (CAN)
  pins: CANRX0 PA9/B; CANTX0 PA10/B
  parameters: INSTANCE_ID=29, CLOCK_ID=29
CAN1 at 0xF8004000 (CAN)
  pins: CANRX1 PA6/B; CANTX1 PA5/B
  parameters: INSTANCE_ID=30, CLOCK_ID=30
CLASSD at 0xF003C000
  pins: CLASSD_L0 PA24/C; CLASSD_L1 PA25/C; CLASSD_L2 PA26/C; CLASSD_L3 PA27/C
  parameters: INSTANCE_ID=42, CLOCK_ID=42, DMAC_ID_TX=35
DBGU at 0xFFFFF200
  pins: DRXD PA9/A; DTXD PA10/A
  parameters: INSTANCE_ID=47, CLOCK_ID=47, DMAC_ID_TX=28, DMAC_ID_RX=29
EMAC0 at 0xF802C000 (EMAC)
  pins: E0_COL PB17/A; E0_CRS PB16/A; E0_MDC PA30/C or PB6/A; E0_MDIO PB5/A; E0_RXCK PB15/A; E0_RXDV PB3/A; E0_RXER PB2/A; E0_RX0 PB0/A; E0_RX1 PB1/A; E0_RX2 PB13/A; E0_RX3 PB14/A; E0_TXCK PB4/A; E0_TXEN PA31/C or PB7/A; E0_TXER PA4/C or PB8/A; E0_TX0 PA2/C or PB9/A; E0_TX1 PA3/C or PB10/A; E0_TX2 PB11/A; E0_TX3 PB12/A
  parameters: INSTANCE_ID=24, CLOCK_ID=24
EMAC1 at 0xF8030000 (EMAC)
  pins: E1_CRSDV PC28/B; E1_MDC PC30/B; E1_MDIO PC31/B; E1_RXER PC16/B; E1_RX0 PC20/B; E1_RX1 PC21/B; E1_TXCK PC29/B; E1_TXEN PC27/B; E1_TX0 PC18/B; E1_TX1 PC19/B
  parameters: INSTANCE_ID=27, CLOCK_ID=27
EBI
  pins: A20 PD15/B; A21 PD2/A; A22 PD3/A; A23 PD16/B; A24 PD17/B; A25 PD18/B; D{n} PD{n-10}/A (n=16..31); NWAIT PD5/A; NCS2 PD19/B; NCS3 PD4/A; NCS4 PD20/B; NCS5 PD21/B; NANDCS PD4/A; NANDOE PD0/A; NANDWE PD1/A; NANDALE PD2/A; NANDCLE PD3/A
FLEXCOM0 at 0xF801C000 (FLEXCOM)
  pins: FLEXCOM0_IO0 PA0/A; FLEXCOM0_IO1 PA1/A; FLEXCOM0_IO2 PA4/A; FLEXCOM0_IO3 PA3/A; FLEXCOM0_IO4 PA2/A; FLEXCOM0_IO7 PB6/B
  parameters: INSTANCE_ID=5, CLOCK_ID=5, DMAC_ID_TX=0, DMAC_ID_RX=1
FLEXCOM1 at 0xF8020000 (FLEXCOM)
  pins: FLEXCOM1_IO0 PA5/A; FLEXCOM1_IO1 PA6/A; FLEXCOM1_IO2 PC29/C; FLEXCOM1_IO3 PC28/C; FLEXCOM1_IO4 PC27/C; FLEXCOM1_IO7 PC17/B
  parameters: INSTANCE_ID=6, CLOCK_ID=6, DMAC_ID_TX=2, DMAC_ID_RX=3
FLEXCOM2 at 0xF8024000 (FLEXCOM)
  pins: FLEXCOM2_IO0 PA7/A; FLEXCOM2_IO1 PA8/A; FLEXCOM2_IO2 PB2/B; FLEXCOM2_IO3 PB1/B; FLEXCOM2_IO4 PB0/B; FLEXCOM2_IO7 PA29/C
  parameters: INSTANCE_ID=7, CLOCK_ID=7, DMAC_ID_TX=4, DMAC_ID_RX=5
FLEXCOM3 at 0xF8028000 (FLEXCOM)
  pins: FLEXCOM3_IO0 PC22/B; FLEXCOM3_IO1 PC23/B; FLEXCOM3_IO2 PC26/B; FLEXCOM3_IO3 PC25/B; FLEXCOM3_IO4 PC24/B; FLEXCOM3_IO7 PC30/C
  parameters: INSTANCE_ID=8, CLOCK_ID=8, DMAC_ID_TX=6, DMAC_ID_RX=7
FLEXCOM4 at 0xF0000000 (FLEXCOM)
  pins: FLEXCOM4_IO0 PA12/A; FLEXCOM4_IO1 PA11/A; FLEXCOM4_IO2 PA13/A; FLEXCOM4_IO3 PA14/A; FLEXCOM4_IO4 PA0/C or PA7/B; FLEXCOM4_IO5 PA1/B or PA8/C; FLEXCOM4_IO6 PB3/B
  parameters: INSTANCE_ID=13, CLOCK_ID=13, DMAC_ID_TX=8, DMAC_ID_RX=9
FLEXCOM5 at 0xF0004000 (FLEXCOM)
  pins: FLEXCOM5_IO0 PA22/B; FLEXCOM5_IO1 PA21/B; FLEXCOM5_IO2 PA23/B; FLEXCOM5_IO3 PA8/B; FLEXCOM5_IO4 PA0/B or PA7/C; FLEXCOM5_IO5 PA31/B; FLEXCOM5_IO6 PA30/B
  parameters: INSTANCE_ID=14, CLOCK_ID=14, DMAC_ID_TX=10, DMAC_ID_RX=11
FLEXCOM6 at 0xF8010000 (FLEXCOM)
  pins: FLEXCOM6_IO0 PA30/A; FLEXCOM6_IO1 PA31/A
  parameters: INSTANCE_ID=9, CLOCK_ID=9, DMAC_ID_TX=12, DMAC_ID_RX=13
FLEXCOM7 at 0xF8014000 (FLEXCOM)
  pins: FLEXCOM7_IO0 PC0/C; FLEXCOM7_IO1 PC1/C
  parameters: INSTANCE_ID=10, CLOCK_ID=10, DMAC_ID_TX=14, DMAC_ID_RX=15
FLEXCOM8 at 0xF8018000 (FLEXCOM)
  pins: FLEXCOM8_IO0 PB4/B; FLEXCOM8_IO1 PB5/B
  parameters: INSTANCE_ID=11, CLOCK_ID=11, DMAC_ID_TX=16, DMAC_ID_RX=17
FLEXCOM9 at 0xF8040000 (FLEXCOM)
  pins: FLEXCOM9_IO0 PC8/C; FLEXCOM9_IO1 PC9/C
  parameters: INSTANCE_ID=15, CLOCK_ID=15, DMAC_ID_TX=18, DMAC_ID_RX=19
FLEXCOM10 at 0xF8044000 (FLEXCOM)
  pins: FLEXCOM10_IO0 PC16/C; FLEXCOM10_IO1 PC17/C
  parameters: INSTANCE_ID=16, CLOCK_ID=16, DMAC_ID_TX=20, DMAC_ID_RX=21
FLEXCOM11 at 0xF0020000 (FLEXCOM)
  pins: FLEXCOM11_IO0 PB19/C; FLEXCOM11_IO1 PB20/C
  parameters: INSTANCE_ID=32, CLOCK_ID=32, DMAC_ID_TX=22, DMAC_ID_RX=23
FLEXCOM12 at 0xF0024000 (FLEXCOM)
  pins: FLEXCOM12_IO0 PB21/C; FLEXCOM12_IO1 PB22/C
  parameters: INSTANCE_ID=33, CLOCK_ID=33, DMAC_ID_TX=24, DMAC_ID_RX=25
GFX2D at 0xF0018000
  parameters: INSTANCE_ID=36, CLOCK_ID=36
GPBR at 0xFFFFFE60
I2SMCC at 0xF001C000
  pins: I2SMCC_CK PB19/B; I2SMCC_DIN0 PB21/B; I2SMCC_DOUT0 PB22/B; I2SMCC_MCK PB23/B; I2SMCC_WS PB20/B
  parameters: INSTANCE_ID=34, CLOCK_ID=34, DMAC_ID_TX=36, DMAC_ID_RX=37
ICE
  pins: NTRST PB25/B
ISI at 0xF8048000
  pins: ISI_D{n} PC{n}/B (n=0..11); ISI_HSYNC PC14/B; ISI_MCK PC15/B; ISI_PCK PC12/B; ISI_VSYNC PC13/B
  parameters: INSTANCE_ID=43, CLOCK_ID=43
LCDC at 0xF8038000
  pins: LCDDAT{n} PC{n}/A (n=0..23); LCDDEN PC29/A; LCDDISP PC24/A; LCDHSYNC PC28/A; LCDPCK PC30/A; LCDPWM PC26/A; LCDVSYNC PC27/A
  parameters: INSTANCE_ID=25, CLOCK_ID=25
MATRIX at 0xFFFFDE00
  parameters: INSTANCE_ID=21
MPDDRC at 0xFFFFE800
OTPC at 0xEFF00000
  parameters: INSTANCE_ID=46
PIOA at 0xFFFFF400 (PIO)
  pins: P{n} PA{n} (n=0..31)
  parameters: INSTANCE_ID=2, CLOCK_ID=2
PIOB at 0xFFFFF600 (PIO)
  pins: P{n} PB{n-32} (n=32..57)
  parameters: INSTANCE_ID=3, CLOCK_ID=3
PIOC at 0xFFFFF800 (PIO)
  pins: P{n} PC{n-58} (n=58..89)
  parameters: INSTANCE_ID=4, CLOCK_ID=4
PIOD at 0xFFFFFA00 (PIO)
  pins: P{n} PD{n-90} (n=90..111)
  parameters: INSTANCE_ID=44, CLOCK_ID=44
PIT at 0xFFFFFE40
PIT64B at 0xF0028000
  parameters: INSTANCE_ID=37, CLOCK_ID=37
PMC at 0xFFFFFC00
  pins: PCK0 PB10/B or PC15/C; PCK1 PB9/B or PC31/C
PMECC at 0xFFFFE000
  parameters: INSTANCE_ID=48
PMERRLOC at 0xFFFFE600
PWM at 0xF8034000
  pins: PWM0 PB11/B or PC10/C or PC18/C; PWM1 PB12/B or PC11/C or PC19/C; PWM2 PB13/B or PC20/C; PWM3 PB14/B or PC21/C
  parameters: INSTANCE_ID=18, CLOCK_ID=18
QSPI at 0xF0014000
  pins: QCS PB20/A; QIO0 PB21/A; QIO1 PB22/A; QIO2 PB23/A; QIO3 PB24/A; QSCK PB19/A
  parameters: INSTANCE_ID=35, CLOCK_ID=35, DMAC_ID_TX=26, DMAC_ID_RX=27
RSTC at 0xFFFFFE00
  pins: NRST_OUT PB25/A
RTC at 0xFFFFFEA8
RTT at 0xFFFFFE20
SCKC at 0xFFFFFE50
SDMMC0 at 0x80000000 (SDMMC)
  pins: SDMMC0_CK PA17/A; SDMMC0_CMD PA16/A; SDMMC0_DAT0 PA15/A; SDMMC0_DAT1 PA18/A; SDMMC0_DAT2 PA19/A; SDMMC0_DAT3 PA20/A
  parameters: INSTANCE_ID=12, CLOCK_ID=12
SDMMC1 at 0x90000000 (SDMMC)
  pins: SDMMC1_CK PA13/B; SDMMC1_CMD PA12/B; SDMMC1_DAT0 PA11/B; SDMMC1_DAT1 PA2/B; SDMMC1_DAT2 PA3/B; SDMMC1_DAT3 PA4/B
  parameters: INSTANCE_ID=26, CLOCK_ID=26
SDRAMC at 0xFFFFEC00
  parameters: INSTANCE_ID=49
SFR at 0xF8050000
SHA at 0xF002C000
  parameters: INSTANCE_ID=41, CLOCK_ID=41, DMAC_ID_TX=34
SHDWC at 0xFFFFFE10
SMC at 0xFFFFEA00
SSC at 0xF0010000
  pins: RD PA27/B; RF PA29/B; RK PA28/B; TD PA26/B; TF PA25/B; TK PA24/B
  parameters: INSTANCE_ID=28, CLOCK_ID=28, DMAC_ID_TX=38, DMAC_ID_RX=39
SYSCWP at 0xFFFFFEDC
TC0 at 0xF8008000 (TC)
  pins: TCLK0 PA24/A; TCLK1 PA25/A; TCLK2 PA26/A; TIOA0 PA21/A; TIOA1 PA22/A; TIOA2 PA23/A; TIOB0 PA27/A; TIOB1 PA28/A; TIOB2 PA29/A
  parameters: INSTANCE_ID=17, CLOCK_ID=17, DMAC_ID_RX=41, TCCLKS_=0 (MCK), TCCLKS_TIMER_CLOCK1=1 (GCLK), TCCLKS_TIMER_CLOCK2=2 (MCK/8), TCCLKS_TIMER_CLOCK3=3 (MCK/32), TCCLKS_TIMER_CLOCK4=4 (MCK/128), TCCLKS_TIMER_CLOCK5=5 (MD_SLCK), TCCLKS_XC0=6 (XC0), TCCLKS_XC1=7 (XC1), TCCLKS_XC2=8 (XC2), NUM_INTERRUPT_LINES=1, TIMER_WIDTH=32
TC1 at 0xF800C000 (TC)
  pins: TCLK3 PC4/C; TCLK4 PC7/C; TCLK5 PC14/C; TIOA3 PC2/C; TIOA4 PC5/C; TIOA5 PC12/C; TIOB3 PC3/C; TIOB4 PC6/C; TIOB5 PC13/C
  parameters: INSTANCE_ID=45, CLOCK_ID=45, DMAC_ID_RX=42, TCCLKS_=0 (MCK), TCCLKS_TIMER_CLOCK1=1 (GCLK), TCCLKS_TIMER_CLOCK2=2 (MCK/8), TCCLKS_TIMER_CLOCK3=3 (MCK/32), TCCLKS_TIMER_CLOCK4=4 (MCK/128), TCCLKS_TIMER_CLOCK5=5 (MD_SLCK), TCCLKS_XC0=6 (XC0), TCCLKS_XC1=7 (XC1), TCCLKS_XC2=8 (XC2), NUM_INTERRUPT_LINES=1, TIMER_WIDTH=32
TDES at 0xF0038000
  parameters: INSTANCE_ID=40, CLOCK_ID=40, DMAC_ID_TX=31, DMAC_ID_RX=30
TRNG at 0xF0030000
  parameters: INSTANCE_ID=38, CLOCK_ID=38
UDPHS at 0xF803C000
  parameters: INSTANCE_ID=23, CLOCK_ID=23
UHPHS_OHCI at 0x00600000 (UHPFS)
UHPHS_EHCI at 0x00700000 (UHPHS)
  parameters: INSTANCE_ID=22, CLOCK_ID=22
WDT at 0xFFFFFF80
XDMAC at 0xF0008000
  parameters: INSTANCE_ID=20, CLOCK_ID=20

## Interrupts
0 EXT_FIQ (AIC) — External FIQ
1 SYSC (PMC RSTC RTT PIT WDT RTC) — System Controller Interrupt
2 PIOA — Parallel I/O Controller A
3 PIOB — Parallel I/O Controller B
4 PIOC — Parallel I/O Controller C
5 FLEXCOM0
6 FLEXCOM1
7 FLEXCOM2
8 FLEXCOM3
9 FLEXCOM6
10 FLEXCOM7
11 FLEXCOM8
12 SDMMC0 — Secure Digital Multi Media Card 0
13 FLEXCOM4
14 FLEXCOM5
15 FLEXCOM9
16 FLEXCOM10
17 TC0 — Timer Counter 0
18 PWM — Pulse Width Modulation
19 ADC — Analog to Digital Converter
20 XDMAC — Extended DMA Controller
21 MATRIX
22 UHPHS — USB Host High Speed
23 UDPHS — USB Device High Speed
24 EMAC0 — Ethernet MAC 0
25 LCDC — LCD Controller
26 SDMMC1 — Secure Digital Multi Media Card 1
27 EMAC1 — Ethernet MAC 1
28 SSC — Synchronous Serial Controller
29 CAN0 — Controller Area Network 0
30 CAN1 — Controller Area Network 1
31 EXT_IRQ (AIC) — External IRQ
32 FLEXCOM11
33 FLEXCOM12
34 I2SMCC — I2S Multi Channel Controller
35 QSPI — Quad I/O SPI Controller
36 GFX2D — Graphics 2D Controller
37 PIT64B — Periodic Interval Timer 64-bit
38 TRNG — True Random Number Generator
39 AES — Advanced Encryption Standard
40 TDES — Triple Data Encryption Standard
41 SHA — Secure Hash Algorithm
42 CLASSD — Class D Controller
43 ISI — Image Sensor Interface
44 PIOD — Parallel I/O D
45 TC1 — Timer Counter 1
46 OTPC — One Time Programmable Controller
47 DBGU — Debug Unit
48 ECC (PMECC PMERRLOC) — ECC Controller
49 MC (SDRAMC MPDDRC SMC) — Memory Controller

## Properties
SIGNATURES: JTAGID=0x05B4403F, CHIPID_CIDR=0x819B81A0, CHIPID_EXID=0x00000002

## Pinouts (pin number, pad)
BGA228: P2 PA0, M3 PA1, P1 PA2, L3 PA3, N1 PA4, L4 PA5, M2 PA6, K6 PA7, M1 PA8, G8 PA9, L2 PA10, H7 PA11, L1 PA12, J6 PA13, K1 PA14, H6 PA15, K2 PA16, J3 PA17, J1 PA18, J5 PA19, J2 PA20, G6 PA21, G1 PA22, J4 PA23, F8 PA24, H1 PA25, F7 PA26, H2 PA27, F1 PA28, H3 PA29, G2 PA30, H4 PA31, F4 PB0, C1 PB1, D3 PB2, D1 PB3, E3 PB4, E1 PB5, D2 PB6, A5 PB7, E6 PB8, A2 PB9, A3 PB10, D6 PB11, C2 PB12, A4 PB13, F2 PB14, B5 PB15, B3 PB16, B1 PB17, E4 PB18, C6 PB19, A6 PB20, A7 PB21, B7 PB22, B6 PB23, A8 PB24, E2 PB25, M4 PC0, P4 PC1, N5 PC2, P5 PC3, L5 PC4, R4 PC5, M6 PC6, T3 PC7, N8 PC8, T4 PC9, P6 PC10, N6 PC11, R5 PC12, L7 PC13, T5 PC14, J7 PC15, R6 PC16, K8 PC17, T6 PC18, L8 PC19, P8 PC20, M8 PC21, R7 PC22, K9 PC23, R8 PC24, L9 PC25, T8 PC26, M9 PC27, N9 PC28, L10 PC29, T7 PC30, M13 PC31, R14 PD0, T15 PD1, P15 PD2, N14 PD3, R16 PD4, N11 PD5, K16 PD6, J12 PD7, K15 PD8, J10 PD9, L16 PD10, K11 PD11, L15 PD12, J15 PD13, L12 PD14, M16 PD15, M14 PD16, N16 PD17, L13 PD18, P16 PD19, M11 PD20, M15 PD21, C10 VDDIOM, C13 VDDIOM, G14 VDDIOM, E10 GND, B13 GND, G12 GND, A16 GND, K14 VDDNF, N15 GND, K12 GND, T16 GND, G3 VDDIOP0, K3 VDDIOP0, G5 GND, K5 GND, N3 VDDIOP1, N2 GND, P7 VDDBU, M7 GND, C4 VDDANA, B4 GNDANA, A1 GND, T1 GND, P10 VDDPLLA, L11 VDDOSC, R13 GNDOSC, L6 VDDCORE, F6 VDDCORE, F11 VDDCORE, J8 GND, H8 GND, H9 GND, C7 VDDQSPI, E7 GND, P13 VDDUTMII, M10 GNDUTMI, H16 D0, H10 D1, H15 D2, H11 D3, J14 D4, J11 D5, J16 D6, J13 D7, G9 D8, D8 D9, F9 D10, A9 D11, F10 D12, B9 D13, D11 D14, C9 D15, B10 A0, G16 A1, A13 A2, D15 A3, B12 A4, E11 A5, A12 A6, B16 A7, F16 A8, D14 A9, C11 A10, E13 A11, A11 A12, B11 A13, C15 A14, G15 A15, E14 A16, F14 A17, C16 A18, H14 A19, F15 NCS0, E16 NCS1, F12 NRD, E8 NWR0, A10 NWR1, L14 NWR3, A15 SDCK, B14 SDCKN, F13 SDCKE, E15 RAS, C12 CAS, D16 SDWE, D12 SDA10, G11 DQM0, C8 DQM1, H12 DQS0, H13 NDQS0, D9 DQS1, E9 NDQS1, B8 DDR_CAL, A14 DDR_VREF, D5 ADVREFP, C5 ADVREFN, P11 HHSRTUNE, T12 HHSDPA, R12 HHSDMA, T13 HHSDPB, T14 HHSDMB, P12 HHSDPC, N12 HHSDMC, T11 WKUP0, R11 SHDN, P9 JTAGSEL, J9 TST, R3 TCK, F3 TDI, H5 TDO, F5 TMS, T2 RTCK, R1 NRST, T9 XIN32, R9 XOUT32, R10 XIN, T10 XOUT

## Notices in the file
Copyright (c) 2019 Microchip Technology Inc.
SPDX-License-Identifier: Apache-2.0
Licensed under the Apache License, Version 2.0 (the "License");
you may not use this file except in compliance with the License.
You may obtain a copy of the License at
http://www.apache.org/licenses/LICENSE-2.0
Unless required by applicable law or agreed to in writing, software
distributed under the License is distributed on an "AS IS" BASIS,
WITHOUT WARRANTIES OR CONDITIONS OF ANY KIND, either express or implied.
See the License for the specific language governing permissions and
limitations under the License.
