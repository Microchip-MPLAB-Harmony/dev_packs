# ATSAMV71J20B device description
Architecture: CORTEX-M7; Family: SAMV; Series: SAMV71
Parameters: __CM7_REV=0x0101 (CM7 Core Revision), __NVIC_PRIO_BITS=3 (Number of Bits used for Priority Levels), __Vendor_SysTickConfig=0 (Set to 1 if different SysTick Config is used), __MPU_PRESENT=1 (MPU present or not), __VTOR_PRESENT=1 (Vector Table Offset Register present or not), __FPU_PRESENT=1 (FPU present or not), __FPU_DP=1 (Double Precision FPU), __ICACHE_PRESENT=1 (Instruction Cache present), __DCACHE_PRESENT=1 (Data Cache present), __ITCM_PRESENT=1 (Instruction TCM present), __DTCM_PRESENT=1 (Data TCM present), __DEBUG_LVL=1, __TRACE_LVL=1, LITTLE_ENDIAN=1, __ARCH_ARM=1, __ARCH_ARM_CORTEX_M=1, __DEVICE_IS_SAM=1
Programming and debug interfaces: JTAG, SWD
Registers are 32-bit, read-write, no defined reset value unless marked. A register's access mark holds for its fields unless they carry their own. Offsets are from the block's base; lines under a group give offsets from that group; [hi:lo] are bit positions; {n}, {i} and the like mark numbered series; 'fields as' and 'values as' point back to an identical list; <NAME> marks a mode.

## Ordering variants
ATSAMV71J20B-AAB: LQFP64, up to 300 MHz, -40 to +105 C, 1.62 to 3.6 V

## Memory
base space: start 0 size 0x100000000, little endian
  0x40000000 PERIPHERALS size 0x20000000 io, rw
  0xE0000000 SYSTEM size 0x10000000 io, rw
  0x80000000 QSPIMEM size 0x20000000 other, rw, executable
  0xA0000000 AXIMX size 0x00100000 other, rw
  0x00000000 ITCM size 0x00020000 other, rw, executable
  0x00400000 IFLASH size 0x00100000 flash, rw, executable, page 512
  0x00800000 IROM size 0x00004000 rom, executable
  0x20000000 DTCM size 0x00020000 other, rw, executable
  0x20400000 IRAM size 0x00060000 ram, rw, executable
fuses space: start 0 size 1, little endian
lockbits space: start 0 size 0x8, little endian

## Peripheral instances (address, pins/pin function, parameters)
ACC at 0x40044000
  parameters: INSTANCE_ID=33, CLOCK_ID=33, HAS_PLUS_COMPARATOR_SELECTION=1, HAS_MINUS_COMPARATOR_SELECTION=1, HAS_INVERTED_COMPARATOR=1, HAS_EDGETYPE_SELECTION=1, HAS_INTERRUPTS=1, HAS_CURRENT_SELECTION=1, HAS_HYSTERESIS=1, HAS_FAULT_ENABLE=1
AES at 0x4006C000
  parameters: DMAC_ID_TX=37, DMAC_ID_RX=38, INSTANCE_ID=56, CLOCK_ID=56
AFEC0 at 0x4003C000 (AFEC)
  pins: ADTRG PA8/B; AD0 PD30/X1; AD1 PA21/X1; AD2 PB3/X1; AD5 PB2/X1; AD6 PA17/X1; AD7 PA18/X1; AD8 PA19/X1; AD9 PA20/X1; AD10 PB0/X1
  parameters: DMAC_ID_RX=35, INSTANCE_ID=29, CLOCK_ID=29, TRGSEL_AFEC_TRIG0=0x0 (External ADC Trigger Input (AFE0_ADTRG pin)), TRGSEL_AFEC_TRIG1=0x1 (TC0 Channel 0 Output (TIOA0)), TRGSEL_AFEC_TRIG2=0x2 (TC0 Channel 1 Output (TIOA1)), TRGSEL_AFEC_TRIG3=0x3 (TC0 Channel 2 Output (TIOA2)), TRGSEL_AFEC_TRIG4=0x4 (PWM0 event line 0), TRGSEL_AFEC_TRIG5=0x5 (PWM0 event line 1), TRGSEL_AFEC_TRIG6=0x6 (Analog Comparator Fault Output), TEMP_SENSOR_CH_NUM=11 (Temperature Sensor Channel)
AFEC1 at 0x40064000 (AFEC)
  pins: ADTRG PD9/C; AD0 PB1/X1
  parameters: DMAC_ID_RX=36, INSTANCE_ID=40, CLOCK_ID=40, TRGSEL_AFEC_TRIG0=0x0 (External ADC Trigger Input (AFE1_ADTRG Pin)), TRGSEL_AFEC_TRIG1=0x1 (TC1 Channel 0 Output (TIOA3)), TRGSEL_AFEC_TRIG2=0x2 (TC1 Channel 1 Output (TIOA4)), TRGSEL_AFEC_TRIG3=0x3 (TC1 Channel 2 Output (TIOA5)), TRGSEL_AFEC_TRIG4=0x4 (PWM1 event line 0), TRGSEL_AFEC_TRIG5=0x5 (PWM1 event line 1), TRGSEL_AFEC_TRIG6=0x6 (Analog Comparator Fault Output)
CHIPID at 0x400E0940
DACC at 0x40040000
  pins: DAC0 PB13/X1; DAC1 PD0/X1; DATRG PA2/C
  parameters: DMAC_ID_CH0_TX=30, DMAC_ID_CH1_TX=31, INSTANCE_ID=30, CLOCK_ID=30
EFC at 0x400E0C00
  pins: ERASE PB12/X1
  parameters: FLASH_SIZE=1048576, PAGE_SIZE=512, INSTANCE_ID=6, PAGES_PR_REGION=32
GMAC at 0x40050000
  pins: GCOL PD13/A; GCRS PD10/A; GMDC PD8/A; GMDIO PD9/A; GRXCK PD14/A; GRXDV PD4/A; GRXER PD7/A; GRX0 PD5/A; GRX1 PD6/A; GRX2 PD11/A; GRX3 PD12/A; GTSUCOMP PB1/B or PB12/B or PD11/C or PD20/C; GTXCK PD0/A; GTXEN PD1/A; GTXER PD17/A; GTX0 PD2/A; GTX1 PD3/A; GTX2 PD15/A; GTX3 PD16/A
  parameters: INSTANCE_ID=39, CLOCK_ID=39
GPBR at 0x400E1890
ICM at 0x40048000
  parameters: INSTANCE_ID=32, CLOCK_ID=32
ISI at 0x4004C000
  pins: D0 PD22/D; D1 PD21/D; D2 PB3/D; D3 PA9/B; D4 PA5/B; D5 PD11/D; D6 PD12/D; D7 PA27/D; D8 PD27/D; D9 PD28/D; D10 PD30/D; D11 PD31/D; HSYNC PD24/D; PCK PA24/D; VSYNC PD25/D
  parameters: INSTANCE_ID=59, CLOCK_ID=59
MATRIX at 0x40088000
MCAN0 at 0x40030000 (MCAN)
  pins: CANRX0 PB3/A; CANTX0 PB2/A
  parameters: INSTANCE_ID=35, CLOCK_ID=35
MLB at 0x40068000
  pins: MLBCLK PB4/C; MLBDAT PB5/C; MLBSIG PD10/D
  parameters: INSTANCE_ID=53, CLOCK_ID=53
PIOA at 0x400E0E00 (PIO)
  pins: P{n} PA{n} (n=0..31); PIODC0 PA3/X1; PIODC1 PA4/X1; PIODC2 PA5/X1; PIODC3 PA9/X1; PIODC4 PA10/X1; PIODC5 PA11/X1; PIODC6 PA12/X1; PIODC7 PA13/X1; PIODCEN1 PA14/X1; PIODCEN2 PA21/X1; PIODCCLK PA22/X1
  parameters: DMAC_ID_RX=34, INSTANCE_ID=10, CLOCK_ID=10
PIOB at 0x400E1000 (PIO)
  pins: P{n} PB{n-32} (n=32..41); P44 PB12; P45 PB13
  parameters: INSTANCE_ID=11, CLOCK_ID=11
PIOD at 0x400E1400 (PIO)
  pins: P{n} PD{n-96} (n=96..127)
  parameters: INSTANCE_ID=16, CLOCK_ID=16
PMC at 0x400E0600
  pins: PCK0 PA6/B or PB12/D or PB13/B; PCK1 PA17/B or PA21/B; PCK2 PA3/C or PA18/B or PA31/B or PB3/B or PD31/C; XIN PB9/X1; XOUT PB8/X1; XIN32 PA7/X1; XOUT32 PA8/X1
  parameters: INSTANCE_ID=5
PWM0 at 0x40020000 (PWM)
  pins: PWMEXTRG0 PA10/B; PWMEXTRG1 PA22/B; PWMFI0 PA9/C; PWMFI1 PD8/B; PWMFI2 PD9/B; PWMH0 PA0/A or PA11/B or PA23/B or PB0/A or PD11/B or PD20/A; PWMH1 PA2/A or PA12/B or PA24/B or PB1/A or PD21/A; PWMH2 PA13/B or PA25/B or PB4/B or PD22/A; PWMH3 PA7/B or PA14/B or PA17/C or PD23/A; PWML0 PA1/A or PA19/B or PB5/B or PD10/B or PD24/A; PWML1 PA20/B or PB12/A or PD25/A; PWML2 PA16/C or PA30/A or PB13/A or PD26/A; PWML3 PA15/C or PD27/A
  parameters: DMAC_ID_TX=13, INSTANCE_ID=31, CLOCK_ID=31, FAULT_PWM_ID0=0x0 (Fault 0 - PWM0_PWMFI0 Input pin), FAULT_PWM_ID1=0x1 (Fault 1 - PWM0_PWMFI1 Input pin), FAULT_PWM_ID2=0x2 (Fault 2 - PWM0_PWMFI2 Input pin), FAULT_PWM_ID3=0x3 (Fault 3 - MAIN_OSC_PMC), FAULT_PWM_ID4=0x4 (Fault 4 - AFEC0), FAULT_PWM_ID5=0x5 (Fault 5 - AFEC1), FAULT_PWM_ID6=0x6 (Fault 6 - ACC), FAULT_PWM_ID7=0x7 (Fault 7 - TC0)
PWM1 at 0x4005C000 (PWM)
  pins: PWMEXTRG0 PA30/B; PWMEXTRG1 PA18/A; PWMFI0 PA21/C; PWMFI1 PA26/D; PWMFI2 PA28/D; PWMH0 PA12/C or PD1/B; PWMH1 PA14/C or PD3/B; PWMH2 PA31/D or PD5/B; PWMH3 PA8/A or PD7/B; PWML0 PA11/C or PD0/B; PWML1 PA13/C or PD2/B; PWML2 PA23/D or PD4/B; PWML3 PA5/A or PD6/B
  parameters: DMAC_ID_TX=39, INSTANCE_ID=60, CLOCK_ID=60, FAULT_PWM_ID0=0x0 (Fault 0 - PWM0_PWMFI0 Input pin), FAULT_PWM_ID1=0x1 (Fault 1 - PWM0_PWMFI1 Input pin), FAULT_PWM_ID2=0x2 (Fault 2 - PWM0_PWMFI2 Input pin), FAULT_PWM_ID3=0x3 (Fault 3 - MAIN_OSC_PMC), FAULT_PWM_ID4=0x4 (Fault 4 - AFEC0), FAULT_PWM_ID5=0x5 (Fault 5 - AFEC1), FAULT_PWM_ID6=0x6 (Fault 6 - ACC), FAULT_PWM_ID7=0x7 (Fault 7 - TC1)
QSPI at 0x4007C000
  pins: QCS PA11/A; QIO0 PA13/A; QIO1 PA12/A; QIO2 PA17/A; QIO3 PD31/A; QSCK PA14/A
  parameters: DMAC_ID_RX=6, DMAC_ID_TX=5, INSTANCE_ID=43, CLOCK_ID=43
RSTC at 0x400E1800
  parameters: INSTANCE_ID=1
RSWDT at 0x400E1900
  parameters: INSTANCE_ID=63
RTC at 0x400E1860
  pins: RTCOUT0 PB0/X1; RTCOUT1 PB1/X1
  parameters: INSTANCE_ID=2
RTT at 0x400E1830
  parameters: INSTANCE_ID=3
SSC at 0x40004000
  pins: RD PA10/C; RF PD24/B; RK PA22/A; TD PB5/D or PD10/C or PD26/B; TF PB0/D; TK PB1/D
  parameters: DMAC_ID_RX=33, DMAC_ID_TX=32, INSTANCE_ID=22, CLOCK_ID=22
SUPC at 0x400E1810
  pins: WKUP0 PA0/X1; WKUP1 PA1/X1; WKUP2 PA2/X1; WKUP3 PA4/X1; WKUP4 PA5/X1; WKUP6 PA9/X1; WKUP7 PA11/X1; WKUP8 PA14/X1; WKUP9 PA19/X1; WKUP10 PA20/X1; WKUP11 PA30/X1; WKUP12 PB3/X1; WKUP13 PB5/X1; WKUP5 PD28/X1
  parameters: INSTANCE_ID=0
TC0 at 0x4000C000 (TC)
  pins: TCLK0 PA4/B; TCLK1 PA28/B; TCLK2 PA29/B; TIOA0 PA0/B; TIOA1 PA15/B; TIOA2 PA26/B; TIOB0 PA1/B; TIOB1 PA16/B; TIOB2 PA27/B
  parameters: DMAC_ID_RX=40, INSTANCE_ID_CHANNEL0=23, INSTANCE_ID_CHANNEL1=24, INSTANCE_ID_CHANNEL2=25, CLOCK_ID_CHANNEL0=23, CLOCK_ID_CHANNEL1=24, CLOCK_ID_CHANNEL2=25, TCCLKS_=0 (MCK), TCCLKS_TIMER_CLOCK1=1 (PCK), TCCLKS_TIMER_CLOCK2=2 (MCK/8), TCCLKS_TIMER_CLOCK3=3 (MCK/32), TCCLKS_TIMER_CLOCK4=4 (MCK/128), TCCLKS_TIMER_CLOCK5=5 (SLCK), TCCLKS_XC0=6 (XC0), TCCLKS_XC1=7 (XC1), TCCLKS_XC2=8 (XC2), NUM_INTERRUPT_LINES=3, TIMER_WIDTH=16
TC1 at 0x40010000 (TC)
  parameters: DMAC_ID_RX=41, INSTANCE_ID_CHANNEL0=26, INSTANCE_ID_CHANNEL1=27, INSTANCE_ID_CHANNEL2=28, CLOCK_ID_CHANNEL0=26, CLOCK_ID_CHANNEL1=27, CLOCK_ID_CHANNEL2=28, TCCLKS_=0 (MCK), TCCLKS_TIMER_CLOCK1=1 (PCK6), TCCLKS_TIMER_CLOCK2=2 (MCK/8), TCCLKS_TIMER_CLOCK3=3 (MCK/32), TCCLKS_TIMER_CLOCK4=4 (MCK/128), TCCLKS_TIMER_CLOCK5=5 (SLCK), TCCLKS_XC0=6 (XC0), TCCLKS_XC1=7 (XC1), TCCLKS_XC2=8 (XC2), NUM_INTERRUPT_LINES=3, TIMER_WIDTH=16
TC2 at 0x40014000 (TC)
  parameters: DMAC_ID_RX=42, INSTANCE_ID_CHANNEL0=47, INSTANCE_ID_CHANNEL1=48, INSTANCE_ID_CHANNEL2=49, CLOCK_ID_CHANNEL0=47, CLOCK_ID_CHANNEL1=48, CLOCK_ID_CHANNEL2=49, TCCLKS_=0 (MCK), TCCLKS_TIMER_CLOCK1=1 (PCK6), TCCLKS_TIMER_CLOCK2=2 (MCK/8), TCCLKS_TIMER_CLOCK3=3 (MCK/32), TCCLKS_TIMER_CLOCK4=4 (MCK/128), TCCLKS_TIMER_CLOCK5=5 (SLCK), TCCLKS_XC0=6 (XC0), TCCLKS_XC1=7 (XC1), TCCLKS_XC2=8 (XC2), NUM_INTERRUPT_LINES=3, TIMER_WIDTH=16
TC3 at 0x40054000 (TC)
  pins: TCLK11 PD24/C; TIOA11 PD21/C; TIOB11 PD22/C
  parameters: DMAC_ID_RX=43, INSTANCE_ID_CHANNEL0=50, INSTANCE_ID_CHANNEL1=51, INSTANCE_ID_CHANNEL2=52, CLOCK_ID_CHANNEL0=50, CLOCK_ID_CHANNEL1=51, CLOCK_ID_CHANNEL2=52, TCCLKS_=0 (MCK), TCCLKS_TIMER_CLOCK1=1 (PCK6), TCCLKS_TIMER_CLOCK2=2 (MCK/8), TCCLKS_TIMER_CLOCK3=3 (MCK/32), TCCLKS_TIMER_CLOCK4=4 (MCK/128), TCCLKS_TIMER_CLOCK5=5 (SLCK), TCCLKS_XC0=6 (XC0), TCCLKS_XC1=7 (XC1), TCCLKS_XC2=8 (XC2), NUM_INTERRUPT_LINES=3, TIMER_WIDTH=16
TRNG at 0x40070000
  parameters: INSTANCE_ID=57, CLOCK_ID=57
TWIHS0 at 0x40018000 (TWIHS)
  pins: TWCK0 PA4/A; TWD0 PA3/A
  parameters: DMAC_ID_RX=15, DMAC_ID_TX=14, INSTANCE_ID=19, CLOCK_ID=19
TWIHS1 at 0x4001C000 (TWIHS)
  pins: TWCK1 PB5/A; TWD1 PB4/A
  parameters: DMAC_ID_RX=17, DMAC_ID_TX=16, INSTANCE_ID=20, CLOCK_ID=20
UART0 at 0x400E0800 (UART)
  pins: URXD0 PA9/A; UTXD0 PA10/A
  parameters: DMAC_ID_RX=21, DMAC_ID_TX=20, INSTANCE_ID=7, CLOCK_ID=7, BRSRCCK_PERIPH_CLK=0 (MCK), BRSRCCK_PMC_PCK=0 (PCK4)
UART1 at 0x400E0A00 (UART)
  pins: URXD1 PA5/C; UTXD1 PA4/C or PA6/C or PD26/D
  parameters: DMAC_ID_RX=23, DMAC_ID_TX=22, INSTANCE_ID=8, CLOCK_ID=8, BRSRCCK_PERIPH_CLK=0 (MCK), BRSRCCK_PMC_PCK=0 (PCK4)
UART2 at 0x400E1A00 (UART)
  pins: URXD2 PD25/C; UTXD2 PD26/C
  parameters: DMAC_ID_RX=25, DMAC_ID_TX=24, INSTANCE_ID=44, CLOCK_ID=44, BRSRCCK_PERIPH_CLK=0 (MCK), BRSRCCK_PMC_PCK=0 (PCK4)
USART0 at 0x40024000 (USART)
  pins: CTS0 PB2/C; DCD0 PD0/D; DSR0 PD2/D; DTR0 PD1/D; RI0 PD3/D; RTS0 PB3/C; RXD0 PB0/C; SCK0 PB13/C; TXD0 PB1/C
  parameters: DMAC_ID_RX=8, DMAC_ID_TX=7, INSTANCE_ID=13, CLOCK_ID=13, USCLKS_MCK=0 (MCK), USCLKS_DIV=1 (MCK/8), USCLKS_PCK=2 (PCK4), USCLKS_SCK=3 (SCK)
USART1 at 0x40028000 (USART)
  pins: CTS1 PA25/A; DCD1 PA26/A; DSR1 PA28/A; DTR1 PA27/A; LONCOL1 PA3/B; RI1 PA29/A; RTS1 PA24/A; RXD1 PA21/A; SCK1 PA23/A; TXD1 PB4/D
  parameters: DMAC_ID_RX=10, DMAC_ID_TX=9, INSTANCE_ID=14, CLOCK_ID=14, USCLKS_MCK=0 (MCK), USCLKS_DIV=1 (MCK/8), USCLKS_PCK=2 (PCK4), USCLKS_SCK=3 (SCK)
USBHS at 0x40038000
  parameters: INSTANCE_ID=34, CLOCK_ID=34
UTMI at 0x400E0400
WDT at 0x400E1850
  parameters: INSTANCE_ID=4
XDMAC at 0x40078000
  parameters: INSTANCE_ID=58, CLOCK_ID=58
FUSES at GPNVMBITS 0 in fuses
LOCKBIT at 0 in lockbits
SCnSCB at 0xE000E000
SCB at 0xE000ED00
SysTick at 0xE000E010
NVIC at 0xE000E100
MPU at 0xE000ED90
FPU at 0xE000EF30
ITM at 0xE0000000
DWT at 0xE0001000
FPB at 0xE0002000
  parameters: __BKPT_NUM=8 (Number of FPB breakpoint comparators)
CoreDebug at 0xE000EDF0
ETM at 0xE0041000
ICE
  pins: TDI PB4/X1; TDO PB5/X1; TRACESWO PB5/X1; TMS PB6/X1; SWDIO PB6/X1; TCK PB7/X1; SWDCLK PB7/X1
TPIU at 0xE0040000
  pins: TRACECLK PD8/D; TRACED0 PD4/C; TRACED1 PD5/C; TRACED2 PD6/C; TRACED3 PD7/C

## Interrupts
-15 Reset — Reset Vector, invoked on Power up and warm reset
-14 NonMaskableInt — Non maskable Interrupt, cannot be stopped or preempted
-13 HardFault — Hard Fault, all classes of Fault
-12 MemoryManagement — Memory Management, MPU mismatch, including Access Violation and No Match
-11 BusFault — Bus Fault, Pre-Fetch-, Memory Access Fault, other address/memory related Fault
-10 UsageFault — Usage Fault, i.e. Undef Instruction, Illegal State Transition
-5 SVCall — System Service Call via SVC instruction
-4 DebugMonitor
-2 PendSV — Pendable request for system service
-1 SysTick — System Tick Timer
0 SUPC — Supply Controller
1 RSTC — Reset Controller
2 RTC — Real Time Clock
3 RTT — Real Time Timer
4 WDT — Watchdog Timer
5 PMC — Power Management Controller
6 EFC — Enhanced Embedded Flash Controller
7 UART0
8 UART1
10 PIOA — Parallel I/O Controller A
11 PIOB — Parallel I/O Controller B
13 USART0
14 USART1
16 PIOD — Parallel I/O Controller D
19 TWIHS0 — Two Wire Interface 0 HS
20 TWIHS1 — Two Wire Interface 1 HS
22 SSC — Synchronous Serial Controller
23 TC0 — Timer/Counter 0
24 TC1 (TC0) — Timer/Counter 1
25 TC2 (TC0) — Timer/Counter 2
26 TC3 (TC1) — Timer/Counter 3
27 TC4 (TC1) — Timer/Counter 4
28 TC5 (TC1) — Timer/Counter 5
29 AFEC0 — Analog Front End 0
30 DACC — Digital To Analog Converter
31 PWM0 — Pulse Width Modulation 0
32 ICM — Integrity Check Monitor
33 ACC — Analog Comparator
34 USBHS — USB Host / Device Controller
35 MCAN0_INT0 (MCAN0) — MCAN Controller 0 Interrupt 0
36 MCAN0_INT1 (MCAN0) — MCAN Controller 0 Interrupt 1
39 GMAC — Ethernet MAC
40 AFEC1 — Analog Front End 1
43 QSPI — Quad I/O Serial Peripheral Interface
44 UART2
47 TC6 (TC2) — Timer/Counter 6
48 TC7 (TC2) — Timer/Counter 7
49 TC8 (TC2) — Timer/Counter 8
50 TC9 (TC3) — Timer/Counter 9
51 TC10 (TC3) — Timer/Counter 10
52 TC11 (TC3) — Timer/Counter 11
53 MLB — MediaLB
56 AES
57 TRNG — True Random Generator
58 XDMAC — DMA
59 ISI — Camera Interface
60 PWM1 — Pulse Width Modulation 1
61 FPU — Floating Point Unit
63 RSWDT — Reinforced Secure Watchdog Timer
64 CCW (SCB) — Cache ECC Warning
65 CCF (SCB) — Cache ECC Fault
66 GMAC_Q1 (GMAC) — GMAC Queue 1
67 GMAC_Q2 (GMAC) — GMAC Queue 2
68 IXC (FPU) — Floating Point Unit IXC
71 GMAC_Q3 (GMAC) — GMAC Queue 3
72 GMAC_Q4 (GMAC) — GMAC Queue 4
73 GMAC_Q5 (GMAC) — GMAC Queue 5

## Properties
SIGNATURES: JTAGID=0x05B3D03F, CHIPID_CIDR=0xA1220C01, CHIPID_EXID=0x00000000
LEGACY_INSTANCE_IDS: ID_TC0=TC0_INSTANCE_ID_CHANNEL0, ID_TC1=TC0_INSTANCE_ID_CHANNEL1, ID_TC2=TC0_INSTANCE_ID_CHANNEL2, ID_TC3=TC1_INSTANCE_ID_CHANNEL0, ID_TC4=TC1_INSTANCE_ID_CHANNEL1, ID_TC5=TC1_INSTANCE_ID_CHANNEL2, ID_TC6=TC2_INSTANCE_ID_CHANNEL0, ID_TC7=TC2_INSTANCE_ID_CHANNEL1, ID_TC8=TC2_INSTANCE_ID_CHANNEL2, ID_TC9=TC3_INSTANCE_ID_CHANNEL0, ID_TC10=TC3_INSTANCE_ID_CHANNEL1, ID_TC11=TC3_INSTANCE_ID_CHANNEL2
ELECTRICAL_CHARACTERISTICS: CHIP_FREQ_SLCK_RC_MIN=20000, CHIP_FREQ_SLCK_RC=32000 (Typical Slow Clock Internal RC frequency), CHIP_FREQ_SLCK_RC_MAX=44000, CHIP_FREQ_MAINCK_RC_4MHZ=4000000, CHIP_FREQ_MAINCK_RC_8MHZ=8000000, CHIP_FREQ_MAINCK_RC_12MHZ=12000000, CHIP_FREQ_CPU_MAX=300000000, CHIP_FREQ_XTAL_32K=32768, CHIP_FREQ_XTAL_12M=12000000, CHIP_FREQ_FWS_0=23000000 (Maximum operating frequency when FWS is 0), CHIP_FREQ_FWS_1=46000000 (Maximum operating frequency when FWS is 1), CHIP_FREQ_FWS_2=69000000 (Maximum operating frequency when FWS is 2), CHIP_FREQ_FWS_3=92000000 (Maximum operating frequency when FWS is 3), CHIP_FREQ_FWS_4=115000000 (Maximum operating frequency when FWS is 4), CHIP_FREQ_FWS_5=138000000 (Maximum operating frequency when FWS is 5), CHIP_FREQ_FWS_6=150000000 (Maximum operating frequency when FWS is 6), CHIP_FREQ_FWS_NUMBER=7 (Number of FWS ranges)

## Pinouts (pin number, pad)
LQFP64: 40 PA3, 34 PA4, 32 PA5, 15 PA7, 16 PA8, 33 PA9, 28 PA10, 27 PA11, 29 PA12, 18 PA13, 19 PA14, 12 PA21, 17 PA22, 23 PA24, 30 PA27, 8 PB0, 7 PB1, 9 PB2, 11 PB3, 46 PB4, 47 PB5, 35 PB6, 39 PB7, 62 PB8, 63 PB9, 38 PB12, 1 PD0, 57 PD1, 56 PD2, 55 PD3, 54 PD4, 53 PD5, 51 PD6, 50 PD7, 49 PD8, 48 PD9, 44 PD10, 43 PD11, 41 PD12, 26 PD21, 25 PD22, 22 PD24, 20 PD25, 21 PD26, 2 PD31, 3 VDDOUT, 4 VDDIN, 5 VREFP, 36 NRST, 37 TST, 10 VDDIO, 42 VDDIO, 58 VDDIO, 45 JTAGSEL, 13 VDDCORE, 24 VDDCORE, 61 VDDCORE, 52 VDDPLL, 59 DM, 60 DP, 6 GND, 14 GND, 31 GND, 64 VDDPLLUSB

## Notices in the file
Copyright (c) 2017 Microchip Technology Inc.
SPDX-License-Identifier: Apache-2.0
Licensed under the Apache License, Version 2.0 (the "License");
you may not use this file except in compliance with the License.
You may obtain a copy of the License at
http://www.apache.org/licenses/LICENSE-2.0
Unless required by applicable law or agreed to in writing, software
distributed under the License is distributed on an "AS IS" BASIS,
WITHOUT WARRANTIES OR CONDITIONS OF ANY KIND, either express or implied.
See the License for the specific language governing permissions and
limitations under the License.
