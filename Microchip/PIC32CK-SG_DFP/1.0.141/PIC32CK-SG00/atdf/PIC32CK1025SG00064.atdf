# PIC32CK1025SG00064 device description
Architecture: CORTEX-M33; Family: PIC32CK; Series: PIC32CKSG00
Parameters: GCLK_ID_TRACE=47 (Index of Generic Clock), LITTLE_ENDIAN=1, NUM_IRQ=158 (Number of Interrupt Requests), __BKPT_NUM=8 (Number of FPB breakpoint comparators), __CM33_REV=0x0000 (Cortex-M33 Revision), __DEBUG_LVL=2 (Debug Level), __DSP_PRESENT=1 (DSP extension present or not), __ETM_PRESENT=1 (ETM present or not), __FPU_PRESENT=1 (FPU present or not), __ITM_PRESENT=1 (ITM present or not), __MPU_NS_REGIONS=8 (Number of MPU_NS regions), __MPU_PRESENT=1 (MPU present or not), __MPU_S_REGIONS=8 (Number of MPU_S regions), __MTB_PRESENT=0 (MTB present or not), __NVIC_PRIO_BITS=3 (Number of NVIC Priority bits), __SAU_PRESENT=0 (SAU present or not), __SEC_ENABLED=1 (TrustZone-M enabled or not), __SYST_NUM=2 (Number of SysTick instances), __TRACE_LVL=2 (Trace Level), __VTOR_PRESENT=1 (Vector Table Offset Register present or not), __Vendor_SysTickConfig=0 (Set to 1 if different SysTick Config is used), __WPT_NUM=4 (Number of DWT watchpoint comparators), POWER_DOMAIN=PD_CORE_SW, __ARCH_ARM=1, __ARCH_ARM_CORTEX_M=1
Programming and debug interfaces: JTAG, SWD
Registers are 32-bit, read-write, reset 0x0 unless marked. A register's access mark holds for its fields unless they carry their own. Offsets are from the block's base; lines under a group give offsets from that group; [hi:lo] are bit positions; {n}, {i} and the like mark numbered series; 'fields as' and 'values as' point back to an identical list; <NAME> marks a mode.

## Ordering variants
PIC32CK1025SG00064-I/AA: QFN64, pinout P64_1, up to 120 MHz, -40 to 85 C, 1.71 to 3.60 V
PIC32CK1025SG00064-E/AA: QFN64, pinout P64_1, up to 120 MHz, -40 to 125 C, 1.71 to 3.60 V
PIC32CK1025SG00064-I/AA: TQFP64, pinout P64, up to 120 MHz, -40 to 85 C, 1.71 to 3.60 V
PIC32CK1025SG00064-E/AA: TQFP64, pinout P64, up to 120 MHz, -40 to 125 C, 1.71 to 3.60 V

## Memory
base space: start 0 size 0x100000000, little endian
  0x0 CMCC_DATARAM size 0x1000 ram, rw, executable
  0x1000 CMCC_TAGRAM size 0x400 ram, rw
  0x3000 CMCC_VALIDRAM size 0x40 ram, rw
  0x4000000 PRM_ROM size 0x8000 rom, ro, executable
  0x8000000 FLASH_BFM size 0x20000 flash, rw, executable, page 4096
  0xA000000 FLASH_CFM_USERCFG1 size 0x1000 flash, rw, page 4096
  0xA001000 FLASH_CFM_USEROTP1 size 0x1000 user_signatures, rw, page 4096
  0xA002000 FLASH_CFM_BOOTCFG1 size 0x1000 flash, rw, page 4096
  0xA004000 FLASH_CFM_DALCFG size 0x1000 flash, rw, page 4096
  0xA006000 FLASH_CFM_CALBACKUP size 0x1000 flash, rw, page 4096
  0xA007000 FLASH_CFM_CALOTP size 0x1000 other, ro, page 4096
  0xA008000 FLASH_CFM_USERCFG2 size 0x1000 flash, rw, page 4096
  0xA009000 FLASH_CFM_USEROTP2 size 0x1000 user_signatures, rw, page 4096
  0xA00A000 FLASH_CFM_BOOTCFG2 size 0x1000 flash, rw, page 4096
  0xC000000 FLASH_PFM size 0x100000 flash, rw, executable, page 4096
  0xFFFF000 SQI_SFR size 0x1000 io, rw
  0x10000000 SQI_XIP size 0x10000000 ram, rw, executable, external
  0x20000000 HSRAM_RET size 0x40000 ram, rw, executable
  0x44000000 HPB0_BRIDGE size 0x30000 io, rw
  0x44800000 HPB1_BRIDGE size 0x30000 io, rw
  0x45000000 HPB2_BRIDGE size 0x30000 io, rw
  0x46000000 USBHS_SFR size 0x1600 io, rw
  0x48000000 HSM_SFR size 0x1000 io, rw
  0xE0000000 PPB size 0x100000 io, rw

## Notices in the file
Copyright (c) 2021 Microchip Technology Inc.
SPDX-License-Identifier: Apache-2.0
Licensed under the Apache License, Version 2.0 (the "License");
you may not use this file except in compliance with the License.
You may obtain a copy of the License at
http://www.apache.org/licenses/LICENSE-2.0
Unless required by applicable law or agreed to in writing, software
distributed under the License is distributed on an "AS IS" BASIS,
WITHOUT WARRANTIES OR CONDITIONS OF ANY KIND, either express or implied.
See the License for the specific language governing permissions and
limitations under the License.
