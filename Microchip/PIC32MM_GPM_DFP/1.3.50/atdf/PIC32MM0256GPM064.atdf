# PIC32MM0256GPM064 device description
Architecture: MIPS; Family: PIC32MM1387; Series: PIC32MM
Parameters: __INT_PRIO_LEVELS=7 (Number of interrupt priority levels), __INT_SUBPRIO_LEVELS=4 (Number of interrupt subpriority levels), __INT_NUM_SHADOW_SETS=1 (Number of interrupt shadow register sets), __SYS_DEF_FREQ=24000000 (System Clock Default Frequency), __PB_DEF_FREQ=24000000 (Peripheral Bus Default Clock Frequency), __REFCLK1_DEF_FREQ=24000000 (Reference Clock 1 Default Clock Frequency), __POSC_DEF_FREQ=8000000 (Primary Oscillator Input Default Frequency), __SOSC_DEF_FREQ=32768 (Secondary Oscillator Input Default Frequency), __PB_DEF_DIV=1 (Peripheral Bus Default Divider Value), __NUM_DMA_CHANNELS=4 (Number of DMA Channels), __NUM_CMP_CHANNELS=3 (Number of Comparator Channels), __DAC_RESOLUTION=5 (DAC resolution in bits), __NUM_ADC_PINS=20 (Number of ADC Pins)
Programming and debug interfaces: JTAG, SWD
Registers are 32-bit, read-write, no defined reset value unless marked. A register's access mark holds for its fields unless they carry their own. Offsets are from the block's base; lines under a group give offsets from that group; [hi:lo] are bit positions; {n}, {i} and the like mark numbered series; 'fields as' and 'values as' point back to an identical list; <NAME> marks a mode.

## Ordering variants
PIC32MM0256GPM064: UQFN64, up to 25 MHz, -40 to 125 C, 2 to 3.6 V
PIC32MM0256GPM064: TQFP64, up to 25 MHz, -40 to 125 C, 2 to 3.6 V

## Memory
base space: start 0 size 0x100000000, little endian
  0xff300000 emulation size 0x100000
  0xbf803660 devid size 0x4
  0x1d000000 code size 0x40000
  0x1fc00000 bootconfig size 0x1700
  0x1fc01740 altconfig size 0x28
  0x0 kseg0_data_mem size 0x8000
  0x1f800000 periph0 size 0x8000
  0x1f808000 periph1 size 0x8000
  0x1FC41840 UDIDx size 0x14
config space: start 0x1fc017c0 size 0x28

## Peripheral instances (address, pins/pin function, parameters)
ADC at 0x1f802100 in periph0
CCP1 at CCP 0x1f800100 in periph0
  parameters: MCCP_PRESENT=1 (Extended PWM features)
CCP2
  parameters: MCCP_PRESENT=1 (Extended PWM features)
CCP3
  parameters: MCCP_PRESENT=1 (Extended PWM features)
CCP{n} (n=4..9)
  parameters: MCCP_PRESENT=0 (Extended PWM features)
CDAC1 at CDAC 0x1f802380 in periph0
CFG at 0x1f802910 in periph0
CLC1 at CLC 0x1f802480 in periph0
CLC{n} (n=2..4)
CMP at 0x1f802300 in periph0
CORE at 0x0
CRU at 0x1f802680 in periph0
DMAC at 0x1f808900 in periph1
FUSECONFIG at 0x1fc017c0 in config
GPIO at 0x1f802910 in periph0
HLVD at 0x1f802920 in periph0
I2C1 at I2C 0x1f801500 in periph0
I2C2
I2C3
INT at 0x1f802910 in periph0
NVM at 0x1f802930 in periph0
  parameters: PAGE_SIZE=2048, ROW_SIZE=256
RCON at 0x1f802680 in periph0
RTCC at 0x1f800000 in periph0
SPI1 at SPI 0x1f808100 in periph1
SPI2
SPI3
TMR1 at 0x1f808000 in periph1
TMR2 at TMR 0x1f808040 in periph1
TMR3
UART1 at UART 0x1f801800 in periph0
UART2
UART3
UDID at 0x1fc41840 in UDIDx
USB at 0x1f808440 in periph1
WDT at 0x1f803990 in periph0

## Interrupts
0 CORE_TIMER
1 CORE_SOFTWARE_0
2 CORE_SOFTWARE_1
3 EXTERNAL_0
4 EXTERNAL_1
5 EXTERNAL_2
6 EXTERNAL_3
7 EXTERNAL_4
8 CHANGE_NOTICE_A — PORT A Change Notification
9 CHANGE_NOTICE_B — PORT B Change Notification
10 CHANGE_NOTICE_C — PORT C Change Notification
11 CHANGE_NOTICE_D — PORT D Change Notification
17 TIMER_1
18 TIMER_2
19 TIMER_3
23 COMPARATOR_1
24 COMPARATOR_2
25 COMPARATOR_3
29 USB
32 RTCC — Real Time Clock Alarm
33 ADC — ADC Conversion Done
36 HLVD
37 CLC1 — Logic Cell 1
38 CLC2 — Logic Cell 2
39 CLC3 — Logic Cell 3
40 CLC4 — Logic Cell 4
41 SPI1_ERR — SPI 1 Error
42 SPI1_TX — SPI 1 Transmission
43 SPI1_RX — SPI 1 Reception
44 SPI2_ERR — SPI 2 Error
45 SPI2_TX — SPI 2 Transmission
46 SPI2_RX — SPI 2 Reception
47 SPI3_ERR — SPI 3 Error
48 SPI3_TX — SPI 3 Transmission
49 SPI3_RX — SPI 3 Reception
53 UART1_RX — UART 1 Reception
54 UART1_TX — UART 1 Transmission
55 UART1_ERR — UART 1 Error
56 UART2_RX — UART 2 Reception
57 UART2_TX — UART 2 Transmission
58 UART2_ERR — UART 2 Error
59 UART3_RX — UART 3 Reception
60 UART3_TX — UART 3 Transmission
61 UART3_ERR — UART 3 Error
65 I2C1_SLAVE
66 I2C1_MASTER
67 I2C1_BUS — I2C 1 Bus Collision
68 I2C2_SLAVE
69 I2C2_MASTER
70 I2C2_BUS — I2C 2 Bus Collision
71 I2C3_SLAVE
72 I2C3_MASTER
73 I2C3_BUS — I2C 3 Bus Collision
{2n+72} CCP{n} (n=1..9) — CCP {n} Input Capture or Output Compare
{2n+73} CCT{n} (n=1..9) — CCP {n} Timer
92 FRC_TUNE
94 NVM — NVM Program or Erase Complete
95 PERFORMANCE_COUNTER — Core Performance Counter
97 ECCSB_ERR — ECC Single Bit error
98 DMA0 — DMA channel 0
99 DMA1 — DMA channel 1
100 DMA2 — DMA channel 2
101 DMA3 — DMA channel 3

## Notices in the file
Copyright (c) 2019 Microchip Technology Inc.
SPDX-License-Identifier: Apache-2.0
Licensed under the Apache License, Version 2.0 (the "License");
you may not use this file except in compliance with the License.
You may obtain a copy of the License at
http://www.apache.org/licenses/LICENSE-2.0
Unless required by applicable law or agreed to in writing, software
distributed under the License is distributed on an "AS IS" BASIS,
WITHOUT WARRANTIES OR CONDITIONS OF ANY KIND, either express or implied.
See the License for the specific language governing permissions and
limitations under the License.
