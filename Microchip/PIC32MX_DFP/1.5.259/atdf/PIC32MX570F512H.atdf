# PIC32MX570F512H device description
Architecture: MIPS; Family: PIC32MX; Series: PIC32MX
Parameters: __INT_PRIO_LEVELS=7 (Number of interrupt priority levels), __INT_SUBPRIO_LEVELS=4 (Number of interrupt subpriority levels), __INT_NUM_SHADOW_SETS=0 (Number of interrupt shadow register sets), __NUM_OSC=1 (Number of oscillators present), __SYS_DEF_FREQ=48000000 (System Clock Default Frequency), __PB_DEF_FREQ=48000000 (Peripheral Bus Default Clock Frequency), __REFCLK_DEF_FREQ=8000000 (Reference Clock Default Frequency), __POSC_DEF_FREQ=8000000 (Primary Oscillator Input Default Frequency), __SOSC_DEF_FREQ=32768 (Secondary Oscillator Input Default Frequency), __PB_DEF_DIV=1 (Peripheral Bus Default Divider Value), __NUM_DMA_CHANNELS=4 (Number of DMA Channels)
Programming and debug interfaces: JTAG, SWD
Registers are 32-bit, read-write, no defined reset value unless marked. A register's access mark holds for its fields unless they carry their own. Offsets are from the block's base; lines under a group give offsets from that group; [hi:lo] are bit positions; {n}, {i} and the like mark numbered series; 'fields as' and 'values as' point back to an identical list; <NAME> marks a mode.

## Ordering variants
PIC32MX570F512H: QFN64, up to 50 MHz, -40 to 85 C, 2.3 to 3.6 V
PIC32MX570F512H: TQFP64, up to 50 MHz, -40 to 85 C, 2.3 to 3.6 V

## Memory
base space: start 0 size 0x100000000, little endian
  0xff300000 emulation size 0x100000
  0xffffffff devid size 0x0
  0x1d000000 code size 0x80000
  0x1fc00000 bootconfig size 0xbf0
  0x0 kseg1_data_mem size 0x10000
  0x1f800000 periph0 size 0xa400
  0x1f80f000 periph1 size 0xdbc
  0x1f880000 periph2 size 0xe000
config space: start 0x1fc00bf0 size 0x10

## Peripheral instances (address, pins/pin function, parameters)
ADC at 0x1f809000 in periph0
BMX at 0x1f882000 in periph2
CAN1 at CAN 0x1f88b000 in periph2
CFG at 0x1f80f200 in periph1
CMP at 0x1f80a000 in periph0
CORE at 0x0
CTMU at 0x1f80a200 in periph0
CVR at 0x1f809800 in periph0
DMAC at 0x1f883000 in periph2
I2C1 at I2C 0x1f805000 in periph0
I2C2
ICAP1 at ICAP 0x1f802000 in periph0
  parameters: TMR_SRC_0=0 (Timer 3), TMR_SRC_1=1 (Timer 2)
ICAP{n} (n=2..5)
  parameters: TMR_SRC_0=0 (Timer 3), TMR_SRC_1=1 (Timer 2)
INT at 0x1f881000 in periph2
NVM at 0x1f80f400 in periph1
  parameters: PAGE_SIZE=1024, ROW_SIZE=128
OCMP1 at OCMP 0x1f803000 in periph0
  parameters: TMR_SRC_0=0 (Timer 2), TMR_SRC_1=1 (Timer 3)
OCMP{n} (n=2..5)
  parameters: TMR_SRC_0=0 (Timer 2), TMR_SRC_1=1 (Timer 3)
OSC at 0x1f80f000 in periph1
PMP at 0x1f807000 in periph0
PORTB at PORT 0x1f886100 in periph2
PORTC
PORTD
PORTE
PORTF
PORTG
RCON at 0x1f80f600 in periph1
RPIN at 0x1f80fa04 in periph1
RPOR at 0x1f80fb00 in periph1
RTCC at 0x1f800200 in periph0
SPI1 at SPI 0x1f805800 in periph0
SPI2
SPI3
TMR1 at 0x1f800600 in periph0
TMR2 at TMR 0x1f800800 in periph0
TMR{n} (n=3..5)
UART1 at UART 0x1f806000 in periph0
UART{n} (n=2..4)
USB at 0x1f885040 in periph2
WDT at 0x1f800000 in periph0

## Interrupts
0 CORE_TIMER
1 CORE_SOFTWARE_0
2 CORE_SOFTWARE_1
3 EXTERNAL_0 — Ext INT 0
4 TIMER_1
5 INPUT_CAPTURE_1, IRQ 5 INPUT_CAPTURE_ERROR_1 — Input Capture 1 Error
5 INPUT_CAPTURE_1, IRQ 6 INPUT_CAPTURE_1
6 OUTPUT_COMPARE_1, IRQ 7 OUTPUT_COMPARE_1
7 EXTERNAL_1, IRQ 8 EXTERNAL_1 — Ext INT 1
8 TIMER_2, IRQ 9 TIMER_2
9 INPUT_CAPTURE_2, IRQ 10 INPUT_CAPTURE_ERROR_2 — Input Capture 2 Error
9 INPUT_CAPTURE_2, IRQ 11 INPUT_CAPTURE_2
10 OUTPUT_COMPARE_2, IRQ 12 OUTPUT_COMPARE_2
11 EXTERNAL_2, IRQ 13 EXTERNAL_2 — Ext INT 2
12 TIMER_3, IRQ 14 TIMER_3
13 INPUT_CAPTURE_3, IRQ 15 INPUT_CAPTURE_ERROR_3 — Input Capture 3 Error
13 INPUT_CAPTURE_3, IRQ 16 INPUT_CAPTURE_3
14 OUTPUT_COMPARE_3, IRQ 17 OUTPUT_COMPARE_3
15 EXTERNAL_3, IRQ 18 EXTERNAL_3 — Ext INT 3
16 TIMER_4, IRQ 19 TIMER_4
17 INPUT_CAPTURE_4, IRQ 20 INPUT_CAPTURE_ERROR_4 — Input Capture 4 Error
17 INPUT_CAPTURE_4, IRQ 21 INPUT_CAPTURE_4
18 OUTPUT_COMPARE_4, IRQ 22 OUTPUT_COMPARE_4
19 EXTERNAL_4, IRQ 23 EXTERNAL_4 — Ext INT 4
20 TIMER_5, IRQ 24 TIMER_5
21 INPUT_CAPTURE_5, IRQ 25 INPUT_CAPTURE_ERROR_5 — Input Capture 5 Error
21 INPUT_CAPTURE_5, IRQ 26 INPUT_CAPTURE_5
22 OUTPUT_COMPARE_5, IRQ 27 OUTPUT_COMPARE_5
23 ADC, IRQ 28 ADC — ADC1 Convert Done
24 FAIL_SAFE_MONITOR, IRQ 29 FAIL_SAFE_MONITOR — Fail Safe Clock Monitor
25 RTCC, IRQ 30 RTCC — Real Time Clock Calendar
26 FCE, IRQ 31 FLASH_CONTROL — Flash Control Event
27 COMPARATOR_1, IRQ 32 COMPARATOR_1
28 COMPARATOR_2, IRQ 33 COMPARATOR_2
29 USB_1, IRQ 34 USB — USB Module 1
30 SPI_1, IRQ 35 SPI1_ERR — SPI1 Fault
30 SPI_1, IRQ 36 SPI1_RX
30 SPI_1, IRQ 37 SPI1_TX
31 UART_1, IRQ 38 UART1_ERR — UART1 Error
31 UART_1, IRQ 39 UART1_RX
31 UART_1, IRQ 40 UART1_TX
32 I2C_1, IRQ 41 I2C1_BUS — I2C1 Bus Collision Event
32 I2C_1, IRQ 42 I2C1_SLAVE — I2C1 Slave Event
32 I2C_1, IRQ 43 I2C1_MASTER — I2C1 Master Event
33 CHANGE_NOTICE, IRQ 44 CHANGE_NOTICE_A — PORTA Input Change Interrupt
33 CHANGE_NOTICE, IRQ 45 CHANGE_NOTICE_B — PORTB Input Change Interrupt
33 CHANGE_NOTICE, IRQ 46 CHANGE_NOTICE_C — PORTC Input Change Interrupt
33 CHANGE_NOTICE, IRQ 47 CHANGE_NOTICE_D — PORTD Input Change Interrupt
33 CHANGE_NOTICE, IRQ 48 CHANGE_NOTICE_E — PORTE Input Change Interrupt
33 CHANGE_NOTICE, IRQ 49 CHANGE_NOTICE_F — PORTF Input Change Interrupt
33 CHANGE_NOTICE, IRQ 50 CHANGE_NOTICE_G — PORTG Input Change Interrupt
34 PMP, IRQ 51 PMP — Parallel Master Port
34 PMP, IRQ 52 PMP_ERROR
35 SPI_2, IRQ 53 SPI2_ERR — SPI2 Fault
35 SPI_2, IRQ 54 SPI2_RX
35 SPI_2, IRQ 55 SPI2_TX
36 UART_2, IRQ 56 UART2_ERR — UART2 Error
36 UART_2, IRQ 57 UART2_RX
36 UART_2, IRQ 58 UART2_TX
37 I2C_2, IRQ 59 I2C2_BUS — I2C2 Bus Collision Event
37 I2C_2, IRQ 60 I2C2_SLAVE — I2C2 Slave Event
37 I2C_2, IRQ 61 I2C2_MASTER — I2C2 Master Event
38 UART_3, IRQ 62 UART3_ERR — UART3 Error
38 UART_3, IRQ 63 UART3_RX
38 UART_3, IRQ 64 UART3_TX
39 UART_4, IRQ 65 UART4_ERR — UART4 Error
39 UART_4, IRQ 66 UART4_RX
39 UART_4, IRQ 67 UART4_TX
40 UART_5, IRQ 68 UART5_ERR — UART5 Error
40 UART_5, IRQ 69 UART5_RX
40 UART_5, IRQ 70 UART5_TX
41 CTMU, IRQ 71 CTMU — CTMU Event
42 DMA_0, IRQ 72 DMA0 — DMA Channel 0
43 DMA_1, IRQ 73 DMA1 — DMA Channel 1
44 DMA_2, IRQ 74 DMA2 — DMA Channel 2
45 DMA_3, IRQ 75 DMA3 — DMA Channel 3
46 COMPARATOR_3, IRQ 76 COMPARATOR_3
47 CAN_1, IRQ 77 CAN1
48 SPI_3, IRQ 78 SPI3_ERR — SPI3 Fault
48 SPI_3, IRQ 79 SPI3_RX
48 SPI_3, IRQ 80 SPI3_TX
49 SPI_4, IRQ 81 SPI4_ERR — SPI4 Fault
49 SPI_4, IRQ 82 SPI4_RX
49 SPI_4, IRQ 83 SPI4_TX

## Notices in the file
Copyright (c) 2019 Microchip Technology Inc.
SPDX-License-Identifier: Apache-2.0
Licensed under the Apache License, Version 2.0 (the "License");
you may not use this file except in compliance with the License.
You may obtain a copy of the License at
http://www.apache.org/licenses/LICENSE-2.0
Unless required by applicable law or agreed to in writing, software
distributed under the License is distributed on an "AS IS" BASIS,
WITHOUT WARRANTIES OR CONDITIONS OF ANY KIND, either express or implied.
See the License for the specific language governing permissions and
limitations under the License.
