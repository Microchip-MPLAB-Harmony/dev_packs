# SAM9X75D2G register map
Vendor: Microchip
Architecture arm32bit. Special function registers and configuration words.
Registers are 32-bit, read-write, reset 0x0 unless marked. A register's access mark holds for its fields unless they carry their own. Addresses are absolute, and some are shared; only a register's first bit layout is shown; lines under a group give offsets from that group; [hi:lo] are bit positions; {n}, {i} and the like mark numbered series; 'fields as' and 'values as' point back to an identical list; <NAME> marks a mode.

## Further device data
pins=1: GND; 2: PC30/FLEXCOM3_IO7/P94; 3: PC2/ISC_D2/TIOA3/P66/LVDS_A0M; 4: PC4/ISC_D4/TCLK3/P68/LVDS_A1M; 5: PC6/ISC_D6/TIOB4/P70/LVDS_A2M; 6: PC10/ISC_D10/PWM0/P74/LVDS_CLK1M; 7: PC12/ISC_PCK/TIOA5/P76/LVDS_A3M; 8: PB19/QSCK/FLEXCOM12_IO2/P51; 9: PB17/QIO7/FLEXCOM12_IO0/I2SMCC_DOUT0/P49; 10: PB16/QIO6/FLEXCOM11_IO1/I2SMCC_DIN0/P48; 11: GND; 12: GND; 13: VSS; 14: VDD; 15: VSSQ; 16: PC28/FLEXCOM1_IO3/P92; 17: GND; 18: PC3/ISC_D3/TIOB3/P67/LVDS_A0P; 19: PC5/ISC_D5/TIOA4/P69/LVDS_A1P; 20: PC7/ISC_D7/TCLK4/P71/LVDS_A2P; 21: PC11/ISC_D11/PWM1/P75/LVDS_CLK1P; 22: PC13/ISC_VSYNC/TIOB5/P77/LVDS_A3P; 23: PB21/QIO0/FLEXCOM12_IO4/P53; 24: PB24/QIO3/FLEXCOM9_IO4/P56; 25: PB20/QCS/FLEXCOM12_IO3/P52; 26: VSS; 27: VSS; 28: VDD; 29: VSSQ; 30: VDD; 31: PC24/FLEXCOM3_IO4/P88; 32: PC26/FLEXCOM3_IO2/P90; 33: GND; 34: PC25/FLEXCOM3_IO3/P89; 35: PC27/FLEXCOM1_IO4/P91; 36: VDDIOP; 37: PB15/QIO5/FLEXCOM11_IO0/I2SMCC_WS/P47; 38: PB23/QIO2/FLEXCOM9_IO3/P55; 39: GND; 40: PB18/QDQS/ADTRG/FLEXCOM12_IO1/IRQ/P50; 41: PB26/QIO4/I2SMCC_CK/P58; 42: VDDQSPI; 43: VSS; 44: VDD; 45: VSSQ; 46: VDD; 47: PD5/NCS0/FLEXCOM11_IO4/P101; 48: PC20/FLEXCOM10_IO4/PWM2/P84; 49: PC22/FLEXCOM3_IO0/P86; 50: PC21/PWM3/P85; 51: GND; 52: PC29/FLEXCOM1_IO2/P93; 53: GND; 54: PC31/FIQ/PCK1/P95; 55: PB25/QINT/I2SMCC_MCK/P57; 56: VDDLVDS; 57: PB22/QIO1/FLEXCOM9_IO2/P54; 58: DDR; 59: GND; 60: VDD; 61: VSSQ; 62: VDD; 63: PD10/NANDDAT4/NRD/P106; 64: PB8/GRXCK/FLEXCOM6_IO3/P40; 65: PC16/ISC_FIELD/FLEXCOM10_IO0/P80; 66: PC18/FLEXCOM10_IO2/PWM0/P82; 67: PC15/ISC_MCK/PCK0/P79; 68: PC23/FLEXCOM3_IO1/P87; 69: GND; 70: GND; 71: VDDOUT; 72: VDD; 73: VDD; 74: VSSQ; 75: VSS; 76: DDR; 77: PD14/NWAIT/NANDRDY/P110; 78: PB14/GTX1/PWM3/P46; 79: PC14/ISC_HSYNC/TCLK5/P78; 80: VDDMIPI; 81: GND; 82: GND; 83: GND; 84: VDDCORE; 85: VSSQ; 86: VSSQ; 87: VDD; 88: GND; 89: VDD; 90: PB6/GTXCK/GREFCK/FLEXCOM0_IO7/P38; 91: VDD; 92: PC8/ISC_D8/FLEXCOM9_IO0/P72; 93: PC0/ISC_D0/FLEXCOM7_IO0/P64; 94: PC19/FLEXCOM10_IO3/PWM1/P83; 95: PC17/FLEXCOM1_IO7/FLEXCOM10_IO1/P81; 96: GND; 97: VDDCORE; 98: VSSQ; 99: VDD; 100: VDD; 101: PD3/A22/NANDCLE/FLEXCOM11_IO2/P99; 102: PB0/GRX2/FLEXCOM2_IO4/GRXER/P32; 103: PA8/FLEXCOM0_IO2/SDMMC1_DAT3/P8; 104: MIPI; 105: MIPI; 106: PC9/ISC_D9/FLEXCOM9_IO1/P73; 107: PC1/ISC_D1/FLEXCOM7_IO1/P65; 108: MIPI; 109: GND; 110: GND; 111: GND; 112: DDR; 113: PD1/NANDWE/FLEXCOM7_IO3/P97; 114: PD8/NANDDAT2/A19/P104; 115: PB2/G125CK/FLEXCOM2_IO2/P34; 116: PA0/SDMMC0_DAT0/P0; 117: MIPI; 118: MIPI; 119: VDDIN; 120: GNDIN; 121: GND; 122: GND; 123: GND; 124: GND; 125: VDDIOM; 126: PB4/GTX2/FLEXCOM8_IO0/P36; 127: PA4/SDMMC0_DAT2/P4; 128: MIPI; 129: MIPI; 130: MIPI; 131: MIPI; 132: HHSRTUNE; 133: VDDIOM; 134: GND; 135: GND; 136: GND; 137: VDDIOM; 138: PD12/NANDDAT6/A0/NBS0/P108; 139: PB10/GMDC/PCK0/FLEXCOM8_IO2/P42; 140: PA2/SDMMC0_CK/P2; 141: XIN; 142: XOUT; 143: MIPI; 144: MIPI; 145: PA29/FLEXCOM1_IO1/CANRX1/P29/AD5; 146: VDDCORE; 147: GND; 148: PA5/SDMMC0_DAT3/P5; 149: PA11/FLEXCOM4_IO2/SDMMC1_CK/P11; 150: PB1/GRX3/FLEXCOM2_IO3/P33; 151: PB12/GRX1/PWM1/FLEXCOM8_IO4/P44; 152: PA6/FLEXCOM0_IO4/SDMMC1_DAT1/P6; 153: VDDOUT; 154: VDDCORE; 155: GND; 156: VDDCORE; 157: AUDIO; 158: GND; 159: VDDCORE; 160: VDDCORE; 161: GND; 162: GND; 163: GND; 164: VDDNF; 165: PA10/FLEXCOM4_IO0/SDMMC1_CMD/P10; 166: HHSDPB; 167: HHSDMB; 168: HHSDPC; 169: PA26/DRXD/CANRX0/P26/AD2; 170: VDDCORE; 171: GND; 172: GND; 173: PD0/NANDOE/FLEXCOM7_IO2/P96; 174: GND; 175: GND; 176: PD11/NANDDAT5/NWR0/NWE/P107; 177: PB5/GTX3/FLEXCOM8_IO1/P37; 178: PB13/GTX0/PWM2/P45; 179: PA19/TCLK1/TF/CLASSD_L1/P19; 180: HHSDPA; 181: HHSDMA; 182: HHSDMC; 183: GND; 184: NRST; 185: GNDANA; 186: VDDIOM; 187: PD13/NANDDAT7/NWR1/NBS1/P109; 188: TST; 189: PD4/NCS2/NANDCS/FLEXCOM11_IO3/P100; 190: PD2/A21/NANDALE/FLEXCOM7_IO4/P98; 191: GND; 192: PD6/NANDDAT0/A1/P102; 193: GND; 194: PD7/NANDDAT1/A12/P103; 195: PA3/SDMMC0_DAT1/P3; 196: PA17/TIOA2/FLEXCOM5_IO2/CLASSD_R2/P17; 197: PA31/FLEXCOM0_IO1/FLEXCOM4_IO5/GTSUCOMP/P31/AD7; 198: PA25/FLEXCOM6_IO1/FLEXCOM5_IO5/P25/AD1; 199: GND; 200: PA24/FLEXCOM6_IO0/FLEXCOM5_IO6/P24/AD0; 201: PA12/FLEXCOM4_IO3/FLEXCOM5_IO4/P12; 202: VDDANA; 203: GND; 204: PB3/GCRSDV/GRXCTL/FLEXCOM4_IO6/P35; 205: VDDIOP; 206: GND; 207: PD9/NANDDAT3/A20/P105; 208: VDDIOP; 209: PB7/GTXEN/GTXCTL/FLEXCOM6_IO2/P39; 210: PB9/GMDIO/PCK1/FLEXCOM6_IO4/P41; 211: GND; 212: PA21/TIOB0/RD/CLASSD_L3/P21; 213: PA18/TCLK0/TK/CLASSD_L0/P18; 214: PA27/DTXD/CANTX0/P27/AD3; 215: VDDBU; 216: PA30/FLEXCOM0_IO0/FLEXCOM5_IO4/FLEXCOM4_IO4/P30/AD6; 217: PA28/FLEXCOM1_IO0/CANTX1/P28/AD4; 218: PA14/FLEXCOM2_IO1/FLEXCOM5_IO3/FLEXCOM4_IO5/P14; 219: PA7/FLEXCOM0_IO3/SDMMC1_DAT2/P7; 220: PB11/GRX0/PWM0/FLEXCOM8_IO3/P43; 221: PA1/SDMMC0_CMD/P1; 222: PA15/TIOA0/FLEXCOM5_IO1/CLASSD_R0/P15; 223: PA9/FLEXCOM4_IO1/SDMMC1_DAT0/P9; 224: TDI; 225: WKUP0; 226: RTCK; 227: GND; 228: TDO; 229: GND; 230: ADVREFN; 231: ADVREFP; 232: XOUT32; 233: XIN32; 234: PA20/TCLK2/TD/CLASSD_L2/P20; 235: PA16/TIOA1/FLEXCOM5_IO0/CLASSD_R1/P16; 236: PA23/TIOB2/RF/FLEXCOM2_IO7/P23; 237: PA22/TIOB1/RK/CLASSD_R3/P22; 238: PA13/FLEXCOM2_IO0/FLEXCOM4_IO4/P13; 239: TCK; 240: SHDN; 241: TMS; 242: JTAGSEL; 243: GND, interrupts=0 EXT_FIQ — Advanced Interrupt Controller; 1 SYSC — Logical-OR interrupt of PMC, WDT, PIT, RSTC, RTT, RTC; 2 PIOA — Parallel I/O Controller A; 3 PIOB — Parallel I/O Controller B; 4 PIOC — Parallel I/O Controller C; 5 FLEXCOM0 — Flexcom 0; 6 FLEXCOM1 — Flexcom 1; 7 FLEXCOM2 — Flexcom 2; 8 FLEXCOM3 — Flexcom 3; 9 FLEXCOM6 — Flexcom 6; 10 FLEXCOM7 — Flexcom 7; 11 FLEXCOM8 — Flexcom 8; 12 SDMMC0 — Secure Data Memory Card Controller 0; 13 FLEXCOM4 — Flexcom 4; 14 FLEXCOM5 — Flexcom 5; 15 FLEXCOM9 — Flexcom 9; 16 FLEXCOM10 — Flexcom 10; 17 TC0 — TC 0,1,2; 18 PWM — Pulse Width Modulation Controller; 19 ADC — ADC Controller; 20 XDMAC — Extended DMA Controller; 21 MATRIX — Matrix; 22 UHPHS — USB Host High Speed; 23 UDPHS — USB Device High Speed; 24 GMAC — Gigabit Ethernet MAC; 25 XLCDC — LCD Controller; 26 SDMMC1 — Secure Data Memory Card Controller 1; 28 SSC — Synchronous Serial Controller; 29 MCAN0_INT0 — Master CAN 0; 30 MCAN1_INT0 — Master CAN 1; 31 EXT_IRQ — Advanced Interrupt Controller; 32 FLEXCOM11 — Flexcom 11; 33 FLEXCOM12 — Flexcom 12; 34 I2SMCC — I2S Multi Channel Controller; 35 QSPI — Quad I/O SPI Controller; 36 GFX2D — 2D Graphic Controller; 37 PIT64B0 — 64-b Timer 0; 38 TRNG — True Random Number Generator; 39 AES — Advanced Encryption Standard; 40 TDES — Triple Data Encryption Standard; 41 SHA — Secure Hash Algorithm; 42 CLASSD — CLASS D Controller; 43 ISC — Camera Interface; 44 PIOD — Parallel I/O Controller D; 45 TC1 — TC 3,4,5; 46 OTPC — OTP Controller; 47 DBGU — DBGU; 48 ECC — logical-OR interrupt of PMECC and PMERRLOC; 49 MC — logical-OR interrupt of MPDDRC and SMC; 52 CSI2DC — CSI to Demultiplexer Controller; 53 CSI — Camera Serial Interface 2 4-Lanes; 54 DSI — Display Serial Interface 4-Lanes; 55 MIPIPHY — MIPI DPHY interface; 56 LVDSC — Display Serial Interface between XLCDC and LVDS interface; 57 LVDSPHY — LVDS PHY; 58 PIT64B1 — 64-b Timer 1; 60 GMAC_Q1 — GMAC Queue 1 Interrupt signal toggled on a DMA write to the first word of each DMA data buffer associated with queue 1; 61 GMAC_Q2 — GMAC Queue 2 Interrupt signal toggled on a DMA write to the first word of each DMA data buffer associated with queue 2; 62 GMAC_Q3 — GMAC Queue 3 Interrupt signal toggled on a DMA write to the first word of each DMA data buffer associated with queue 3; 63 GMAC_Q4 — GMAC Queue 4 Interrupt signal toggled on a DMA write to the first word of each DMA data buffer associated with queue 4; 64 GMAC_Q5 — GMAC Queue 5 Interrupt signal toggled on a DMA write to the first word of each DMA data buffer associated with queue 5; 65 GMAC_EMAC — Gigabit Ethernet MAC - Express MAC; 66 GMAC_MMSL — Gigabit Ethernet MAC - Mac Merge SubLayer; 67 GMAC_TSU — Gigabit Ethernet MAC - Time Stamp Unit; 68 MCAN0_INT1 — Master CAN 0 interrupt 1; 69 MCAN1_INT1 — Master CAN 1 interrupt 1
