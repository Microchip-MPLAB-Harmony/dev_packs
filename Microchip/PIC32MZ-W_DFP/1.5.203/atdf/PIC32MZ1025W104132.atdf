# PIC32MZ1025W104132 device description
Architecture: MIPS; Family: PIC32MZW; Series: PIC32MZW
Parameters: __MPU_PRESENT=1 (MPU present or not), __VTOR_PRESENT=0 (Vector Table Offset Register present or not), __INT_PRIO_LEVELS=7 (Number of interrupt priority levels), __INT_SUBPRIO_LEVELS=4 (Number of interrupt subpriority levels), __INT_NUM_SHADOW_SETS=7 (Number of interrupt shadow register sets), __FPU_PRESENT=1 (FPU present or not), __FPU_DP=0 (Double Precision FPU implemented or not), __ICACHE_PRESENT=1 (Instruction Cache present or not), __DCACHE_PRESENT=1 (Data Cache present or not), __ITCM_PRESENT=0 (Instruction TCM present or not), __DTCM_PRESENT=0 (Data TCM present or not), LITTLE_ENDIAN=1 (Little endian used or not), __ARCH_ARM=0 (ARM architecture or not), __POSC_DEF_FREQ=40000000 (Primary Oscillator Input Default Frequency), __SOSC_DEF_FREQ=32768 (Secondary Oscillator Input Default Frequency), __SYS_DEF_FREQ=200000000 (System Clock Default Frequency), __FRC_DEF_FREQ=8000000 (FRC Default Frequency), __REFCLKI_DEF_FREQ=8000000 (REFCLKI Pin Input Default Frequency), __PB1_DEF_FREQ=100000000 (Peripheral Bus 1 Default Clock Frequency), __PB2_DEF_FREQ=100000000 (Peripheral Bus 2 Default Clock Frequency), __PB3_DEF_FREQ=100000000 (Peripheral Bus 3 Default Clock Frequency), __PB4_DEF_FREQ=100000000 (Peripheral Bus 4 Default Clock Frequency), __PB5_DEF_FREQ=100000000 (Peripheral Bus 5 Default Clock Frequency), __PB6_DEF_FREQ=200000000 (Peripheral Bus 6 Default Clock Frequency), __REFCLK1_DEF_FREQ=200000000 (Reference Clock 1 Default Frequency), __REFCLK2_DEF_FREQ=200000000 (Reference Clock 2 Default Frequency), __REFCLK3_DEF_FREQ=200000000 (Reference Clock 3 Default Frequency), __REFCLK4_DEF_FREQ=200000000 (Reference Clock 4 Default Frequency), __NUM_DMA_CHANNELS=8 (Number of DMA Channels)
Programming and debug interfaces: JTAG, SWD
Registers are 32-bit, read-write, no defined reset value unless marked. A register's access mark holds for its fields unless they carry their own. Offsets are from the block's base; lines under a group give offsets from that group; [hi:lo] are bit positions; {n}, {i} and the like mark numbered series; 'fields as' and 'values as' point back to an identical list; <NAME> marks a mode.

## Ordering variants
PIC32MZ1025W104132: DQFN132, up to 250 MHz, -40 to +85 C, 3.0 to 3.6 V

## Memory
base space: start 0 size 0x100000000, little endian
  0x1FC55EBC altCodeProtect size 0x4
  0x1FC55E88 altConfig size 0x2c
  0x1FC00000 lowerbootalias size 0x10000
  0x1FC16000 otpmemory size 0x1000
  0x10000000 code size 0x100000
  0x1FC55FBC codeProtect size 0x4
  0x1FC55F88 config size 0x2c
  0xffffffff devid size 0x0
  0xff300000 emulation size 0x100000
  0x0 kseg0_data_mem size 0x40000
  0x1f803000 wcmDataMem size 0x2000
  0x1F900000 crypto1SCM size 0x2000
  0x1F902000 crypto1UCM size 0x2000
  0x1F800000 configSfr0 size 0x70
  0x1F800070 configSfr1 size 0x490
  0x1F800500 periph_pb1a size 0x2b00
  0x1f80fe00 periph_pb1b size 0x5100
  0x1F820000 periph_pb2 size 0x20000
  0x1F840000 periph_pb3 size 0x20000
  0x1F870000 periph_pb4 size 0x10000
  0x1F8C0000 periph_indep_a size 0x26000
  0x1F920000 periph_indep_b size 0x20000

## Peripheral instances (address, pins/pin function, parameters)
ADCHS at ADCHS0 0x1f821000 in periph_pb2
BA414E at 0x1f900000 in crypto1SCM
BA414E_PK at 0x1f920000 in periph_indep_b
CAN1 at CAN 0x1f822000 in periph_pb2
CAN2 at CAN 0x1f823000 in periph_pb2
CFG at 0x1f800000 in configSfr0
CRU at 0x1f801200 in periph_pb1a
RCON at 0x1f801200 in periph_pb1a
CRYPTO at 0x1f8e4000 in periph_indep_a
CVD at 0x1f824000 in periph_pb2
DMAC at 0x1f811000 in periph_pb1b
DMT at 0x1f800a00 in periph_pb1a
DSCTRL at 0x1f871000 in periph_pb4
ETH at 0x1f843000 in periph_pb3
FUSECONFIG at 0x0
GPIO at 0x1f820000 in periph_pb2
I2C1 at I2C 0x1f820400 in periph_pb2
I2C2
ICAP1 at ICAP 0x1f841000 in periph_pb3
  parameters: TMR_SRC_0=0 (Timer 3), TMR_SRC_1=1 (Timer 2), TMR_ALTERNATE_SRC_0=0 (Timer 5), TMR_ALTERNATE_SRC_1=1 (Timer 4)
ICAP2
  parameters: TMR_SRC_0=0 (Timer 3), TMR_SRC_1=1 (Timer 2), TMR_ALTERNATE_SRC_0=0 (Timer 5), TMR_ALTERNATE_SRC_1=1 (Timer 4)
ICAP3
  parameters: TMR_SRC_0=0 (Timer 3), TMR_SRC_1=1 (Timer 2), TMR_ALTERNATE_SRC_0=0 (Timer 7), TMR_ALTERNATE_SRC_1=1 (Timer 6)
ICAP4
  parameters: TMR_SRC_0=0 (Timer 3), TMR_SRC_1=1 (Timer 2), TMR_ALTERNATE_SRC_0=0 (Timer 7), TMR_ALTERNATE_SRC_1=1 (Timer 6)
INT at 0x1f810000 in periph_pb1b
JTAG at 0x1f812000 in periph_pb1b
LVD at 0x1f801400 in periph_pb1a
NVM at 0x1f800600 in periph_pb1a
  parameters: PAGE_SIZE=4096, ROW_SIZE=1024
OCMP1 at OCMP 0x1f842000 in periph_pb3
  parameters: TMR_SRC_0=0 (Timer 2), TMR_SRC_1=1 (Timer 3), TMR_ALTERNATE_SRC_0=0 (Timer 4), TMR_ALTERNATE_SRC_1=1 (Timer 5)
OCMP2
  parameters: TMR_SRC_0=0 (Timer 2), TMR_SRC_1=1 (Timer 3), TMR_ALTERNATE_SRC_0=0 (Timer 4), TMR_ALTERNATE_SRC_1=1 (Timer 5)
OCMP3
  parameters: TMR_SRC_0=0 (Timer 2), TMR_SRC_1=1 (Timer 3), TMR_ALTERNATE_SRC_0=0 (Timer 6), TMR_ALTERNATE_SRC_1=1 (Timer 7)
OCMP4
  parameters: TMR_SRC_0=0 (Timer 2), TMR_SRC_1=1 (Timer 3), TMR_ALTERNATE_SRC_0=0 (Timer 6), TMR_ALTERNATE_SRC_1=1 (Timer 7)
PCACHE at 0x1f812400 in periph_pb1b
PMU at 0x1f813e00 in periph_pb1b
PPS at 0x1f801800 in periph_pb1a
PTG at 0x1f801c00 in periph_pb1a
RNG at 0x1f8e5000 in periph_indep_a
RTCC at 0x1f870000 in periph_pb4
SPI1 at SPI 0x1f840c00 in periph_pb3
SPI2
SQI1 at SQI 0x1f8e1000 in periph_indep_a
TMR1 at 0x1f802000 in periph_pb1a
TMR2 at TMR 0x1f802200 in periph_pb1a
TMR{n} (n=3..7)
UART3 at UART 0x1f801600 in periph_pb1a
UART1
UART2
USB1 at USB 0x1f844000 in periph_pb3
WDT at 0x1f800800 in periph_pb1a

## Interrupts
0 CORE_TIMER
1 CORE_SOFTWARE_0
2 CORE_SOFTWARE_1
3 EXTERNAL_0 — Ext INT 0
4 TIMER_1
5 INPUT_CAPTURE_1_ERROR
6 INPUT_CAPTURE_1
7 OUTPUT_COMPARE_1
8 EXTERNAL_1 — Ext INT 1
9 TIMER_2
10 INPUT_CAPTURE_2_ERROR
11 INPUT_CAPTURE_2
12 OUTPUT_COMPARE_2
13 EXTERNAL_2 — Ext INT 2
14 TIMER_3
15 INPUT_CAPTURE_3_ERROR
16 INPUT_CAPTURE_3
17 OUTPUT_COMPARE_3
18 EXTERNAL_3 — Ext INT 3
19 TIMER_4
20 INPUT_CAPTURE_4_ERROR
21 INPUT_CAPTURE_4
22 OUTPUT_COMPARE_4
23 EXTERNAL_4 — Ext INT 4
24 TIMER_5
30 FLASH_CONTROL — Flash Control Event
31 PREFETCH — Prefetch Module SEC Event
32 PFW_CRC — PFW CRC event
33 RTCC — REAL_TIME_CLOCK
34 USB — USB_1
35 SPI1_FAULT
36 SPI1_RX — SPI_1_RECEIVE
37 SPI1_TX — SPI_1_TRANSFER
38 UART1_FAULT
39 UART1_RX — UART_1_RECEIVE
40 UART1_TX — UART_1_TRANSFER
41 I2C1_BUS — I2C_1_BUS_COLLISION_EVENT
42 I2C1_SLAVE — I2C_1_SLAVE_EVENT
43 I2C1_MASTER — I2C_1_MASTER_EVENT
44 CHANGE_NOTICE_A — PORT_A_INPUT_CHANGE_INTERRUPT
45 CHANGE_NOTICE_B — PORT_B_INPUT_CHANGE_INTERRUPT
46 CHANGE_NOTICE_C — PORT_C_INPUT_CHANGE_INTERRUPT
47 CHANGE_NOTICE_K — PORT_D_INPUT_CHANGE_INTERRUPT
53 SPI2_FAULT
54 SPI2_RX — SPI 2 Receive Done
55 SPI2_TX — SPI 2 Transfer Done
56 UART2_FAULT — UART 2 Error
57 UART2_RX — UART 2 Receiver
58 UART2_TX — UART 2 Transmitter
59 I2C2_BUS — I2C 2 Bus Collision Event
60 I2C2_SLAVE — I2C 2 Slave Event
61 I2C2_MASTER — I2C 2 Master Event
62 UART3_FAULT
63 UART3_RX — UART_3_RECEIVE
64 UART3_TX — UART_3_TRANSFER
{n+68} DMA{n} (n=0..7) — DMA Channel {n}
76 TIMER_6
80 TIMER_7
83 RFSMC — WiFi SMC Event
84 RFMAC — WiFi MAC Event
85 CTR1_EVENT
86 RFTM0 — WiFi Timer 0 Event
87 RFTM1 — WiFi Timer 1 Event
88 RFTM2 — WiFi Timer 2 Event
89 RFTM3 — WiFi Timer 3 Event
90 CTR1_TRG — CTR1 Trig out event
91 RFWCOE — WiFi WCOE Event
92 ADC — ADC global
94 ADC_DC1 — ADC Digital Comparator 1
95 ADC_DC2 — ADC Digital Comparator 2
96 ADC_DF1 — ADC Digital Filter 1
97 ADC_DF2 — ADC Digital Filter 2
100 ADC_FAULT — ADC Fault Interrupt
101 ADC_EOS — ADC EO Scan
102 ADC_ARDY — ADC Analog Ready
103 ADC_URDY — ADC Update Rdy after Suspend
104 ADC_DMA — ADC 1st Class Buffer Transfer
{n+106} ADC_DATA{n} (n=0..23) — ADC A Data #{n}
142 CAN1 — CAN Combined Interrupt
143 CAN2_RX — CAN2 Receive Interrupt
144 CAN2_TX — CAN2 Transmit Interrupt
145 CAN2_MISC — CAN2 Misc Interrupt
150 SQI1 — SQI Event Completion
152 PTG0_STEP — PTG Step Complete
153 PTG0_WDT — PTG Watchdog Timeout
154 PTG0_TRG0 — PTG Int. Trigger 0
155 PTG0_TRG1 — PTG Int. Trigger 1
156 PTG0_TRG2 — PTG Int. Trigger 2
157 PTG0_TRG3 — PTG Int. Trigger 3
162 CORE_PERF_COUNT — Core perform. counter event
163 CORE_FAST_DEBUG_CHAN — Fast Debug Channel Event
164 CRYPTO — Crypto Engine Event
165 ETHERNET
166 CRYPTO1 — Asymmetric Crypto Engine End Event
167 CRYPTO1_FAULT — Asymmetric Crypto Engine Error Event
168 CVD_EVENT

## Notices in the file
Copyright (c) 2019 Microchip Technology Inc.
SPDX-License-Identifier: Apache-2.0
Licensed under the Apache License, Version 2.0 (the "License");
you may not use this file except in compliance with the License.
You may obtain a copy of the License at
http://www.apache.org/licenses/LICENSE-2.0
Unless required by applicable law or agreed to in writing, software
distributed under the License is distributed on an "AS IS" BASIS,
WITHOUT WARRANTIES OR CONDITIONS OF ANY KIND, either express or implied.
See the License for the specific language governing permissions and
limitations under the License.
