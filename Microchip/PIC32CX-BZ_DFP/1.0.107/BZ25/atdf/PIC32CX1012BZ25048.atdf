# PIC32CX1012BZ25048 device description
Architecture: CORTEX-M4; Family: PIC32CX; Series: BZ25
Parameters: LITTLE_ENDIAN=1, NUM_IRQ=40, __CM4_REV=0x0001, __DEBUG_LVL=3, __FPU_PRESENT=1, __MPU_PRESENT=1, __NVIC_PRIO_BITS=3, __TRACE_LVL=2, __VTOR_PRESENT=1, __Vendor_SysTickConfig=0, __ARCH_ARM=1 (ARM architecture or not), __POSC_DEF_FREQ=16000000 (Primary Oscillator Input Default Frequency), __RFPLL_DEF_FREQ=96000000 (RFPLL Default Frequency), __SOSC_DEF_FREQ=32768 (Secondary Oscillator Input Default Frequency), __SYS_DEF_FREQ=64000000 (System Clock Default Frequency), __FRC_DEF_FREQ=8000000 (FRC Default Frequency), __REFCLKI_DEF_FREQ=8000000 (REFCLKI Pin Input Default Frequency), __PB1_DEF_FREQ=64000000 (Peripheral Bus 1 Default Clock Frequency), __PB2_DEF_FREQ=64000000 (Peripheral Bus 2 Default Clock Frequency), __PB3_DEF_FREQ=6400000 (Peripheral Bus 3 Default Clock Frequency), __REFCLK1_DEF_FREQ=64000000 (Reference Clock 1 Default Frequency), __REFCLK2_DEF_FREQ=64000000 (Reference Clock 2 Default Frequency), __REFCLK3_DEF_FREQ=64000000 (Reference Clock 3 Default Frequency), __REFCLK4_DEF_FREQ=64000000 (Reference Clock 4 Default Frequency), __REFCLK5_DEF_FREQ=64000000 (Reference Clock 5 Default Frequency), __REFCLK6_DEF_FREQ=64000000 (Reference Clock 6 Default Frequency), __NUM_DMA_CHANNELS=16 (Number of DMA Channels)
Programming and debug interfaces: SWD
Registers are 32-bit, read-write, reset 0x0 unless marked. A register's access mark holds for its fields unless they carry their own. Offsets are from the block's base; lines under a group give offsets from that group; [hi:lo] are bit positions; {n}, {i} and the like mark numbered series; 'fields as' and 'values as' point back to an identical list; <NAME> marks a mode.

## Ordering variants
PIC32CX1012BZ25048: QFN48, up to 64 MHz, -40 to 105 C, 1.90 to 3.60 V

## Memory
base space: start 0 size 0x100000000, little endian
  0x03000000 CMCC size 0x1000000 io, rw
  0x3000000 CMCC_DATARAM size 0x1000 io, rw
  0x3001000 CMCC_TAGRAM size 0x400 io, rw
  0x3002000 CMCC_VALIDRAM size 0x40 io, rw
  0x20000000 HSRAM size 0x20000 ram, rw, executable
  0x20000000 HSRAM_ETB size 0x8000 ram, rw, executable
  0x20000000 HSRAM_RET1 size 0x8000 ram, rw, executable
  0x40000000 PBA size 0x1000000 io, rw
  0x41000000 PBB size 0x1000000 io, rw
  0x42000000 PBC size 0x1000000 io, rw
  0x44000000 PB_PIC size 0x20000 io, rw
  0x44014000 BKUPRAM size 0x2000 ram, rw
  0x01000000 FLASH size 0x100000 flash, rw, executable, page 4096
  0xE0000000 PPB size 0x100000 io, rw
  0x04000000 QSPI size 0x1000000 other, rw, executable, external
  0xE000E000 SCS size 0x00001000 io, rw
  0x00000000 BOOT_FLASH size 0x5E00 flash, rw, executable
fuses space: start 0x00000000 size 0x20000000, little endian

## Peripheral instances (address, pins/pin function, parameters)
AC at 0x42001C00
  pins: AIN0 PB02; AIN1 PB03; AIN2 PB00; AIN3 PB01; CMP0 PA02; CMP1 PA01 or PA06
  parameters: COMPCTRL_MUXNEG_OPAMP=7, GCLK_ID=20, IMPLEMENTS_VDBLR=0, NUM_CMP=2, PAIRS=1, SPEED_LEVELS=2, INSTANCE_ID=71, LOAD_CALIB=0
ADCHS at 0x44001400
  pins: AIN0 PB04; AIN1 PB05; AIN2 PB06; AIN3 PB07; AIN4 PB00; AIN5 PB01; AIN6 PB02; AIN7 PB03; ANN0 PB06
  parameters: AIN_8=8 (BandGap Reference (internal AN8)), AIN_9=9 (IVref 1.2V (internal AN9)), AIN_10=10 (VBAT/2 (internal AN10)), AIN_11=11 (CTMU Temperature Sensor (internal AN11))
AES at 0x42000400
  parameters: DMAC_ID_RD=42 (DMA DATA Read trigger), DMAC_ID_WR=41 (DMA DATA Write trigger), FOUR_BYTE_OPERATION=1 (Byte Operation), GCM=1, KEYLEN=2 (Key Length), INSTANCE_ID=65
BLE at 0x41012000
BTZBSYS at 0x41014000
CCL at 0x42001800
  pins: IN0 PA03/1 set 1 or PA07/2 set 1 or PA11/3 set 1 or PB00/4 set 1 or PB04/5 set 1 or PB08/6 set 1 or PB12/7 set 1 or PA02/8 set 1 or PA06/9 set 1 or PA10/10 set 1 or PA14/11 set 1 or PB03/12 set 1 or PB07/13 set 1 or PB11/14 set 1 or PA09/15 set 1; IN1 PA04/1 set 2 or PA08/2 set 2 or PA12/3 set 2 or PB01/4 set 2 or PB05/5 set 2 or PB09/6 set 2 or PB13/7 set 2 or PA03/8 set 2 or PA07/9 set 2 or PA11/10 set 2 or PB00/11 set 2 or PB04/12 set 2 or PB08/13 set 2 or PB12/14 set 2 or PA00/15 set 2; IN2 PA05/1 set 3 or PA09/2 set 3 or PA13/3 set 3 or PB02/4 set 3 or PB06/5 set 3 or PB10/6 set 3 or PA00/7 set 3 or PA04/8 set 3 or PA08/9 set 3 or PA12/10 set 3 or PB01/11 set 3 or PB05/12 set 3 or PB09/13 set 3 or PB13/14 set 3 or PA01/15 set 3; IN3 PA03/1 set 1 or PA07/2 set 1 or PA11/3 set 1 or PB00/4 set 1 or PB04/5 set 1 or PB08/6 set 1 or PB12/7 set 1 or PA02/8 set 1 or PA06/9 set 1 or PA10/10 set 1 or PA14/11 set 1 or PB03/12 set 1 or PB07/13 set 1 or PB11/14 set 1 or PA09/15 set 1; IN4 PA04/1 set 2 or PA08/2 set 2 or PA12/3 set 2 or PB01/4 set 2 or PB05/5 set 2 or PB09/6 set 2 or PB13/7 set 2 or PA03/8 set 2 or PA07/9 set 2 or PA11/10 set 2 or PB00/11 set 2 or PB04/12 set 2 or PB08/13 set 2 or PB12/14 set 2 or PA00/15 set 2; IN5 PA05/1 set 3 or PA09/2 set 3 or PA13/3 set 3 or PB02/4 set 3 or PB06/5 set 3 or PB10/6 set 3 or PA00/7 set 3 or PA04/8 set 3 or PA08/9 set 3 or PA12/10 set 3 or PB01/11 set 3 or PB05/12 set 3 or PB09/13 set 3 or PB13/14 set 3 or PA01/15 set 3; OUT0 PA00/28 set 3 or PA01/28 set 3 or PA03/28 set 3 or PA04/28 set 3 or PA05/28 set 3 or PA08/28 set 3 or PA09/28 set 3 or PA13/28 set 3 or PB01/28 set 3 or PB02/28 set 3 or PB05/28 set 3 or PB06/28 set 3 or PB09/28 set 3 or PB10/28 set 3 or PB13/28 set 3; OUT1 PA01/28 set 4 or PA02/28 set 4 or PA04/28 set 4 or PA05/28 set 4 or PA06/28 set 4 or PA08/28 set 4 or PA09/28 set 4 or PA10/28 set 4 or PA13/28 set 4 or PA14/28 set 4 or PB02/28 set 4 or PB03/28 set 4 or PB06/28 set 4 or PB07/28 set 4 or PB10/28 set 4 or PB11/28 set 4
  parameters: GCLK_ID=0, LUT_NUM=2, SEQ_NUM=2, INSTANCE_ID=70
CFG at 0x44000000
CMCC at 0x41002000
  parameters: INSTANCE_ID=33
CRU at 0x44000a00
RCON at 0x44000a00
DMAC at 0x41004000
  parameters: BURST=1, CH_BITS=5, CH_NUM=16, EVIN_NUM=8, EVOUT_NUM=4, FIFO_SIZE=16, LVL_BITS=2, LVL_NUM=4, QOSCTRL_D_RESETVALUE=2, QOSCTRL_F_RESETVALUE=2, QOSCTRL_WRB_RESETVALUE=2, TRIG_BITS=7, TRIG_NUM=85, INSTANCE_ID=34, CHANNEL0_INT_SRC=6 (DMA Channel 0 Interrupt), CHANNEL1_INT_SRC=6 (DMA Channel 1 Interrupt), CHANNEL2_INT_SRC=6 (DMA Channel 2 Interrupt), CHANNEL3_INT_SRC=6 (DMA Channel 3 Interrupt), CHANNEL{n}_INT_SRC=7 (DMA Channel {n} Interrupt) (n=4..15)
DMT at 0x44000E00
DSCON at 0x42011000
  parameters: INSTANCE_ID=79
DSU at 0x41000000
  parameters: DMAC_ID_DCC0=2, DMAC_ID_DCC1=3, INSTANCE_ID=32
EIC at 0x40000800
  pins: EXTINT0 PA03/1 set 1 or PA07/2 set 1 or PA11/3 set 1 or PB00/4 set 1 or PB04/5 set 1 or PB08/6 set 1 or PB12/7 set 1 or PA02/8 set 1 or PA06/9 set 1 or PA10/10 set 1 or PA14/11 set 1 or PB03/12 set 1 or PB07/13 set 1 or PB11/14 set 1 or PA09/15 set 1; EXTINT1 PA04/1 set 2 or PA08/2 set 2 or PA12/3 set 2 or PB01/4 set 2 or PB05/5 set 2 or PB09/6 set 2 or PB13/7 set 2 or PA03/8 set 2 or PA07/9 set 2 or PA11/10 set 2 or PB00/11 set 2 or PB04/12 set 2 or PB08/13 set 2 or PB12/14 set 2 or PA00/15 set 2; EXTINT2 PA05/1 set 3 or PA09/2 set 3 or PA13/3 set 3 or PB02/4 set 3 or PB06/5 set 3 or PB10/6 set 3 or PA00/7 set 3 or PA04/8 set 3 or PA08/9 set 3 or PA12/10 set 3 or PB01/11 set 3 or PB05/12 set 3 or PB09/13 set 3 or PB13/14 set 3 or PA01/15 set 3; EXTINT3 PA06/1 set 4 or PA10/2 set 4 or PA14/3 set 4 or PB03/4 set 4 or PB07/5 set 4 or PB11/6 set 4 or PA01/7 set 4 or PA05/8 set 4 or PA09/9 set 4 or PA13/10 set 4 or PB02/11 set 4 or PB06/12 set 4 or PB10/13 set 4 or PA08/14 set 4 or PA02/15 set 4; NMI PA06/1 set 4 or PA10/2 set 4 or PA14/3 set 4 or PB03/4 set 4 or PB07/5 set 4 or PB11/6 set 4 or PA01/7 set 4 or PA05/8 set 4 or PA09/9 set 4 or PA13/10 set 4 or PB02/11 set 4 or PB06/12 set 4 or PB10/13 set 4 or PA08/14 set 4 or PA02/15 set 4
  parameters: EXTINT_NUM=4, GCLK_ID=0, NUMBER_OF_CONFIG_REGS=2, NUMBER_OF_DPRESCALER_REGS=2, NUMBER_OF_INTERRUPTS=4, INSTANCE_ID=2
EVSYS at 0x41006000
  parameters: ASYNCHRONOUS_CHANNELS=0xFFFFF000, CHANNELS=32 (Total Number of Channels), CHANNELS_BITS=5 (Number of bits to select Channel), EXTEVT_NUM=0 (Number of External Event Generators), GCLK_ID_{n}={n+8} (Index of Generic Clock {n}) (n=0..11), GENERATORS=69 (Total Number of Event Generators), GENERATORS_BITS=7 (Number of bits to select Event Generator), SYNCH_NUM=12 (Number of Synchronous Channels), SYNCH_NUM_BITS=4 (Number of bits to select Synchronous Channels), USERS=52 (Total Number of Event Users), USERS_BITS=6 (Number of bits to select Event User), INSTANCE_ID=35
NVM at 0x44000600
  parameters: PAGE_SIZE=4096, ROW_SIZE=1024
FREQM at 0x40000400
  parameters: GCLK_ID_MSR=2, GCLK_ID_REF=1, INSTANCE_ID=1
FUSES at USER_FUSES 0x00045E80 in fuses
GPIOA at 0x44002200 (GPIO)
  pins: RA{n} pa{n} (n=0..10); RA13 pa13; RA14 pa14; IOCA{n} pa{n} (n=0..10); IOCA13 pa13; IOCA14 pa14
GPIOB at 0x44002300 (GPIO)
  pins: RB{n} pb{n} (n=0..13); IOCB{n} pb{n} (n=0..13)
HMATRIX at 0x42002400 (HMATRIXB)
  parameters: MASTER_NUM=8, MASTER_CM4_S=0, MASTER_CMCC=1, MASTER_PICOP_MEM=2, MASTER_PICOP_IO=3, MASTER_DMAC_DTWR=4, MASTER_DMAC_DTRD=5, MASTER_ICM=6, MASTER_DSU=7, SLAVE_NUM=14, SLAVE_FLASH=0, SLAVE_FLASH_ALT=1, SLAVE_SEEPROM=2, SLAVE_RAMCM4S=3, SLAVE_RAMPPPDSU=4, SLAVE_RAMDMAWR=5, SLAVE_RAMDMACICM=6, SLAVE_HPB0=7, SLAVE_HPB1=8, SLAVE_HPB2=9, SLAVE_HPB3=10, SLAVE_SDHC0=12, SLAVE_QSPI=14, SLAVE_BKUPRAM=15, INSTANCE_ID=73
ICM at 0x42002C00
  parameters: INSTANCE_ID=75
PAC at 0x40000000
  parameters: HPB_NUM=4, INSTANCE_ID=0
PCHE at 0x44012400
PFW at 0x44000800
PMU at 0x44013E00
  pins: INT0 PB04
PPS at 0x44001000
  pins: RPA{n} PA{n:02} (n=0..10); RPA13 PA13; RPA14 PA14; RPB{n} PB{n:02} (n=0..13)
PUKCC
  parameters: RAM_ADDR_SIZE=12, ROM_ADDR_SIZE=16, INSTANCE_ID=76
QSPI at 0x42000000
  pins: QSPI_CS PB10; QSPI_DATA0 PB12; QSPI_DATA1 PB13; QSPI_DATA2 PA00; QSPI_DATA3 PA01; QSPI_SCK PB11
  parameters: DMAC_ID_RX=43, DMAC_ID_TX=44, HADDR_MSB=23, OCMS=1, INSTANCE_ID=64
RAMECC at 0x41008000
  parameters: RAMADDR_BITS=13, RAMBANK_NUM=4, INSTANCE_ID=36
RTC at 0x42010000
  pins: RTC_EVENT PB13/RTCC; RTC_IN0 PA03/RTCC; RTC_IN0_ALT PA09/RTCC; RTC_IN1 PA02/RTCC; RTC_IN2 PA01/RTCC; RTC_IN3 PA00/RTCC; RTC_OUT PA01/RTCC; RTC_OUT_ALT PA10/RTCC
  parameters: DMAC_ID_TIMESTAMP=1, GPR_NUM=4, NUM_OF_ALARMS=2, NUM_OF_BKREGS=8, NUM_OF_COMP16=4, NUM_OF_COMP32=2, NUM_OF_TAMPERS=5, PER_NUM=8, INSTANCE_ID=78
SERCOM0 at 0x40000c00 (SERCOM)
  pins: SERCOM0_PAD0 PA05; SERCOM0_PAD1 PA06; SERCOM0_PAD2 PA03; SERCOM0_PAD3 PA04
  parameters: CLK_REDUCTION=1, DLY_COMPENSATION=1, DMA=1, DMAC_ID_RX=4, DMAC_ID_TX=5, FIFO_DEPTH_POWER=1, GCLK_ID_CORE=3, INT_MSB=6, PMSB=3, RETENTION_SUPPORT=0, SE_CNT=1, SPI=1, SPI_HW_SS_CTRL=1, SPI_ICSPACE_EXT=1, SPI_OZMO=0, SPI_WAKE_ON_SSL=1, TTBIT_EXTENSION=1, TWIM=1, TWIS=1, TWIS_AUTO_ACK=1, TWIS_GROUP_CMD=1, TWIS_SDASETUP_CNT_SIZE=8, TWIS_SDASETUP_SIZE=4, TWIS_SUDAT=1, TWI_FASTMP=1, TWI_HSMODE=1, TWI_SCLSM_MODE=1, TWI_SMB_TIMEOUTS=1, TWI_TENBIT_ADR=1, USART=1, USART_AUTOBAUD=1, USART_COLDET=1, USART_FLOW_CTRL=1, USART_FRAC_BAUD=1, USART_IRDA=1, USART_ISO7816=1, USART_LIN_MASTER=1, USART_RS485=1, USART_SAMPA_EXT=1, USART_SAMPR_EXT=1, INSTANCE_ID=3
SERCOM1 at 0x40001000 (SERCOM)
  pins: SERCOM1_PAD0 PA07; SERCOM1_PAD1 PA08; SERCOM1_PAD2 PA09; SERCOM1_PAD3 PA10
  parameters: CLK_REDUCTION=1, DLY_COMPENSATION=1, DMA=1, DMAC_ID_RX=6, DMAC_ID_TX=7, FIFO_DEPTH_POWER=1, GCLK_ID_CORE=3, INT_MSB=6, PMSB=3, RETENTION_SUPPORT=0, SE_CNT=1, SPI=1, SPI_HW_SS_CTRL=1, SPI_ICSPACE_EXT=1, SPI_OZMO=0, SPI_WAKE_ON_SSL=1, TTBIT_EXTENSION=1, TWIM=1, TWIS=1, TWIS_AUTO_ACK=1, TWIS_GROUP_CMD=1, TWIS_SDASETUP_CNT_SIZE=8, TWIS_SDASETUP_SIZE=4, TWIS_SUDAT=1, TWI_FASTMP=1, TWI_HSMODE=1, TWI_SCLSM_MODE=1, TWI_SMB_TIMEOUTS=1, TWI_TENBIT_ADR=1, USART=1, USART_AUTOBAUD=1, USART_COLDET=1, USART_FLOW_CTRL=1, USART_FRAC_BAUD=1, USART_IRDA=1, USART_ISO7816=1, USART_LIN_MASTER=1, USART_RS485=1, USART_SAMPA_EXT=1, USART_SAMPR_EXT=1, INSTANCE_ID=4
SERCOM2 at 0x42000c00 (SERCOM)
  pins: SERCOM2_PAD0 PA13; SERCOM2_PAD1 PA14
  parameters: CLK_REDUCTION=1, DLY_COMPENSATION=1, DMA=1, DMAC_ID_RX=8, DMAC_ID_TX=9, FIFO_DEPTH_POWER=1, GCLK_ID_CORE=4, INT_MSB=6, PMSB=3, RETENTION_SUPPORT=0, SE_CNT=1, SPI=1, SPI_HW_SS_CTRL=1, SPI_ICSPACE_EXT=1, SPI_OZMO=0, SPI_WAKE_ON_SSL=1, TTBIT_EXTENSION=1, TWIM=1, TWIS=1, TWIS_AUTO_ACK=1, TWIS_GROUP_CMD=1, TWIS_SDASETUP_CNT_SIZE=8, TWIS_SDASETUP_SIZE=4, TWIS_SUDAT=1, TWI_FASTMP=1, TWI_HSMODE=1, TWI_SCLSM_MODE=1, TWI_SMB_TIMEOUTS=1, TWI_TENBIT_ADR=1, USART=1, USART_AUTOBAUD=1, USART_COLDET=1, USART_FLOW_CTRL=1, USART_FRAC_BAUD=1, USART_IRDA=1, USART_ISO7816=1, USART_LIN_MASTER=1, USART_RS485=1, USART_SAMPA_EXT=1, USART_SAMPR_EXT=1, INSTANCE_ID=67
SERCOM3 at 0x42001000 (SERCOM)
  parameters: CLK_REDUCTION=1, DLY_COMPENSATION=1, DMA=1, DMAC_ID_RX=10, DMAC_ID_TX=11, FIFO_DEPTH_POWER=1, GCLK_ID_CORE=4, INT_MSB=6, PMSB=3, RETENTION_SUPPORT=0, SE_CNT=1, SPI=1, SPI_HW_SS_CTRL=1, SPI_ICSPACE_EXT=1, SPI_OZMO=0, SPI_WAKE_ON_SSL=1, TTBIT_EXTENSION=1, TWIM=1, TWIS=1, TWIS_AUTO_ACK=1, TWIS_GROUP_CMD=1, TWIS_SDASETUP_CNT_SIZE=8, TWIS_SDASETUP_SIZE=4, TWIS_SUDAT=1, TWI_FASTMP=1, TWI_HSMODE=1, TWI_SCLSM_MODE=1, TWI_SMB_TIMEOUTS=1, TWI_TENBIT_ADR=1, USART=1, USART_AUTOBAUD=1, USART_COLDET=1, USART_FLOW_CTRL=1, USART_FRAC_BAUD=1, USART_IRDA=1, USART_ISO7816=1, USART_LIN_MASTER=1, USART_RS485=1, USART_SAMPA_EXT=1, USART_SAMPR_EXT=1, INSTANCE_ID=68
TC0 at 0x40001400 (TC)
  parameters: CC_NUM=2, DMAC_ID_OVF=29, DMAC_ID_MC_0=30, DMAC_ID_MC_1=31, EXT=0, GCLK_ID=22, MASTER_SLAVE_MODE=1, OW_NUM=2, INSTANCE_ID=5
TC1 at 0x40001800 (TC)
  parameters: CC_NUM=2, DMAC_ID_OVF=32, DMAC_ID_MC_0=33, DMAC_ID_MC_1=34, EXT=0, GCLK_ID=23, MASTER_SLAVE_MODE=2, OW_NUM=2, INSTANCE_ID=6
TC2 at 0x40001C00 (TC)
  parameters: CC_NUM=2, DMAC_ID_OVF=35, DMAC_ID_MC_0=36, DMAC_ID_MC_1=37, EXT=0, GCLK_ID=6, MASTER_SLAVE_MODE=1, OW_NUM=2, INSTANCE_ID=7
TC3 at 0x40002000 (TC)
  parameters: CC_NUM=2, DMAC_ID_OVF=38, DMAC_ID_MC_0=39, DMAC_ID_MC_1=40, EXT=0, GCLK_ID=6, MASTER_SLAVE_MODE=2, OW_NUM=2, INSTANCE_ID=8
TCC0 at 0x40002400 (TCC)
  parameters: CC_NUM=6, DITHERING=1, DMAC_ID_OVF=12, DMAC_ID_MC_{n}={n+13} (n=0..5), DTI=1, EXT=31, GCLK_ID=21, MASTER_SLAVE_MODE=1, OTMX=1, OW_NUM=8, PG=1, SIZE=24, SWAP=1, INSTANCE_ID=9
TCC1 at 0x40002800 (TCC)
  parameters: CC_NUM=4, DITHERING=1, DMAC_ID_OVF=19, DMAC_ID_MC_{n}={n+20} (n=0..5), DTI=1, EXT=31, GCLK_ID=5, MASTER_SLAVE_MODE=2, OTMX=1, OW_NUM=8, PG=1, SIZE=24, SWAP=1, INSTANCE_ID=10
TCC2 at 0x40002c00 (TCC)
  parameters: CC_NUM=3, DITHERING=0, DMAC_ID_OVF=26, DMAC_ID_MC_0=27, DMAC_ID_MC_1=28, DTI=0, EXT=1, GCLK_ID=5, MASTER_SLAVE_MODE=0, OTMX=1, OW_NUM=3, PG=0, SIZE=16, SWAP=0, INSTANCE_ID=11
TRNG at 0x42002800
  parameters: INSTANCE_ID=74
WDT at 0x44000500
CoreDebug at 0xE000EDF0
DWT at 0xE0001000
ETM at 0xE0041000
FPU at 0xE000EF30
ITM at 0xE0000000
MPU at 0xE000ED90
NVIC at 0xE000E100
  parameters: NUM_IRQ=40 (Number of interrupt requests), __NVIC_PRIO_BITS=3 (Number of NVIC interrupt priority bits)
SysTick at 0xE000E010
SystemControl at 0xE000E000
TPI at 0xE0040000
  pins: TRD0 PB05; TRD1 PB06; TRD2 PB07; TRD3 PB04; TRCLK PA07
  parameters: GCLK_ID_TRACE=7
ZIGBEE at 0x41010000
ARB at 0x41011000

## Interrupts
-15 Reset — Reset Vector, invoked on Power up and warm reset
-14 NonMaskableInt — Non maskable Interrupt, cannot be stopped or preempted
-13 HardFault — Hard Fault, all classes of Fault
-12 MemoryManagement — Memory Management, MPU mismatch, including Access Violation and No Match
-11 BusFault — Bus Fault, Pre-Fetch-, Memory Access Fault, other address/memory related Fault
-10 UsageFault — Usage Fault, i.e. Undef Instruction, Illegal State Transition
-5 SVCall — System Service Call via SVC instruction
-4 DebugMonitor
-2 PendSV — Pendable request for system service
-1 SysTick — System Tick Timer
0 RTC — Real Time Counter
1 EIC — External Interrupt Controller
2 FREQM — Frequency Meter
3 FLASH_CONTROL (NVM) — Non-Volatile Memory
4 CHANGE_NOTICE_A (GPIOA) — PORT_A_INPUT_CHANGE_INTERRUPT
5 CHANGE_NOTICE_B (GPIOB) — PORT_B_INPUT_CHANGE_INTERRUPT
6 DMAC_0_3 (DMAC) — DMA Channel 0..3
7 DMAC_4_15 (DMAC) — DMA Channel 4..X
8 EVSYS_0_3 (EVSYS) — Event System Channel 0..3
9 EVSYS_4_11 (EVSYS) — Event System Channel 4..X
10 PAC — Peripheral Access Controller
11 RAMECC — RAM Error Correction Code
12 SERCOM0 — Serial Communication Interface 0
13 SERCOM1 — Serial Communication Interface 1
14 SERCOM2 — Serial Communication Interface 2
15 SERCOM3 — Serial Communication Interface 3
16 TCC0 — Timer/Counter for Control Applications 0
17 TCC1 — Timer/Counter for Control Applications 1
18 TCC2 — Timer/Counter for Control Applications 2
19 TC0 — Timer/Counter 0
20 TC1 — Timer/Counter 1
21 TC2 — Timer/Counter 2
22 TC3 — Timer/Counter 3
23 ADCHS — Analog-to-Digital Converter
24 AC — Analog Comparators
25 AES — Advanced Encryption Standard
26 TRNG — True Random Generator
27 ICM — Integrity Check Monitor
28 PUKCC — Public-Key Cryptography Controller
29 QSPI — Quad SPI interface
30 ZB_INT0 (ZIGBEE) — ZIGBEE
31 BT_INT0 (BLE) — Bluetooth 0
32 BT_INT1 (BLE) — Bluetooth 0
33 ARBITER (ARB) — Radio Arbiter
34 ADC_FAULT (ADCHS) — ADC Fault Interrupt
35 ADC_EOS (ADCHS) — ADC EOS Interrupt
36 ADC_BGVR_RDY (ADCHS) — ADC BGVR Ready
37 CLKI_WAKEUP_NMI (BLE) — Bluetooth WAKEUP
38 BT_LC (BLE) — Bluetooth LC
39 BT_RC (BLE) — Bluetooth RC

## Event generators
{n+1} RTC_PER_{n} (n=0..7), {n+9} RTC_CMP_{n} (n=0..3), 13 RTC_TAMPER, 14 RTC_OVF, {n+15} EIC_EXTINT_{n} (n=0..3), {n+19} DMAC_CH_{n} (n=0..3), 23 PAC_ACCERR, {9n+24} TCC{n}_OVF (n=0..2), {9n+25} TCC{n}_TRG (n=0..2), {9n+26} TCC{n}_CNT (n=0..2), {n+27} TCC0_MC_{n} (n=0..5), {n+36} TCC1_MCX_{n} (n=0..5), 45 TCC2_MCX_0, 46 TCC2_MCX_1, {3n+47} TC{n}_OVF (n=0..3), {3n+48} TC{n}_MCX_0 (n=0..3), {3n+49} TC{n}_MCX_1 (n=0..3), 59 ADC_RESRDY, 62 AC_COMP_0, 63 AC_COMP_1, 64 AC_WIN_0, 65 TRNG_READY, 66 CCL_LUTOUT_0, 67 CCL_LUTOUT_1, 68 ZB_TX_TS_ACT, 69 ZB_RX_TS_ACT

## Event users
0 RTC_TAMPER, {n+1} DMAC_CH_{n} (n=0..7), 9 CM4_TRACE_START, 10 CM4_TRACE_STOP, 11 CM4_TRACE_TRIG, {8n+12} TCC{n}_EV_0 (n=0..2), {8n+13} TCC{n}_EV_1 (n=0..2), {n+14} TCC0_MC_{n} (n=0..5), {n+22} TCC1_MC_{n} (n=0..5), 30 TCC2_MC_0, 31 TCC2_MC_1, {n+32} TC{n}_EVU (n=0..3), {n+31} ADC_TRIG_{n} (n=5..16), 48 AC_SOC_0, 49 AC_SOC_1, 50 CCL_LUTIN_0, 51 CCL_LUTIN_1

## Properties
SIGNATURES: JTAGID=0x09B8F053, DSU_DID=0x00009B8F

## Pinouts (pin number, pad)
QFN48: 1 PMU_BK_LX, 2 VPMU_VDD, 3 PMU_MDLO_OUT, 4 PA00, 5 PA01, 6 PA02, 7 PA05, 8 VDD, 9 PA06, 10 PA07, 11 PA08, 12 PA09, 13 PA10, 14 PB12, 15 PB13, 16 PA13, 17 PA14, 18 VDDCORE, 19 BUCK_CLDO, 20 EXT48K, 21 BUCK_BB, 22 X0_N, 23 XO_P, 24 BUCK_PLL, 25 BUCK_LPA, 26 LPA_OUT, 27 MPA_OUT, 28 BUCK_MPA, 29 NMCLR, 30 PB00, 31 PB01, 32 PB02, 33 PB03, 34 PB04, 35 PB05, 36 AVDD, 37 PB06, 38 PB07, 39 VDD, 40 PB09, 41 PB08, 42 PA04, 43 PB10, 44 PB11, 45 PA11, 46 PA12, 47 PA03, 48 PMU_VDDIO

## Notices in the file
Copyright (c) 2017 Microchip Technology Inc.
SPDX-License-Identifier: Apache-2.0
Licensed under the Apache License, Version 2.0 (the "License"); you may
not use this file except in compliance with the License.
You may obtain a copy of the Licence at
http://www.apache.org/licenses/LICENSE-2.0
Unless required by applicable law or agreed to in writing, software
distributed under the License is distributed on an AS IS BASIS, WITHOUT
WARRANTIES OR CONDITIONS OF ANY KIND, either express or implied.
See the License for the specific language governing permissions and
limitations under the License.
