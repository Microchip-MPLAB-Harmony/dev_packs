# LAN9255ZMX019 register map
Vendor: Microchip
Architecture arm32bit. Special function registers and configuration words.
Registers are 32-bit, read-write, reset 0x0 unless marked. A register's access mark holds for its fields unless they carry their own. Addresses are absolute, and some are shared; only a register's first bit layout is shown; lines under a group give offsets from that group; [hi:lo] are bit positions; {n}, {i} and the like mark numbered series; 'fields as' and 'values as' point back to an identical list; <NAME> marks a mode.

## Further device data
pins=1: OSCO; 2: PB03/EXTINT3/AIN15/X21/Y21/PAD1/VBAT; 3: PA00/EXTINT0/PAD0/WO0/XIN32; 4: OSCVDD12; 5: PA01/EXTINT1/PAD1/WO1/XOUT32; 6: OSCVSS; 7: VDD33; 8: PA02/EXTINT2/AIN0/VOUT0/IN2; 9: PA03/EXTINT3/AIN1/X0/Y0/VREFA; 10: PB04/EXTINT4/X22/Y22/AIN6; 11: PB05/EXTINT5/X23/Y23/AIN7; 12: VDDCR1; 13: REG_EN; 14: CLK25_EN; 15: GNDANA; 16: VDDANA; 17: ERRLED_LEDPOL4; 18: WAIT_ACK; 19: PB06/EXTINT6/X24/Y24/AIN8/IN6; 20: PB07/EXTINT7/X25/Y25/AIN9/IN7; 21: RSTN; 22: PB08/EXTINT8/AIN2/X1/Y1/AIN0/PAD0/WO0/IN8; 23: PB09/EXTINT9/AIN3/X2/Y2/AIN1/PAD1/WO1/OUT2; 24: SIO2; 25: PA04/EXTINT4/AIN0/AIN4/X3/Y3/VREFB/PAD0/WO0/IN0; 26: SIO1; 27: PA05/EXTINT5/AIN1/AIN5/VOUT1/PAD1/WO1/IN1; 28: PA06/EXTINT6/AIN2/AIN6/X4/Y4/VREFC/PAD2/WO0/SDCD/IN2; 29: VDDIO1_L; 30: PA07/EXTINT7/AIN3/AIN7/X5/Y5/PAD3/WO1/SDWP/OUT0; 31: GPIO8; 32: GPIO7; 33: PA08/NMI/AIN8/X6/Y6/AIN2/PAD0/PAD1/WO0/WO0/WO4/DATA0/SDCMD/MCK0/IN3; 34: PA09/EXTINT9/AIN9/X7/Y7/AIN3/PAD1/PAD0/WO1/WO1/WO5/DATA1/SDDAT0/FS0/IN4; 35: PA10/EXTINT10/AIN10/X8/Y8/PAD2/PAD2/WO0/WO2/WO6/DATA2/SDDAT1/SCK0/IO4/IN5; 36: PA11/EXTINT11/AIN11/X9/Y9/PAD3/PAD3/WO1/WO3/WO7/DATA3/SDDAT2/SDO/IO5/OUT1; 37: VDDIOB; 38: SIO0; 39: SYNC1_LATCH1; 40: PB10/EXTINT10/PAD2/WO0/WO4/WO0/SCK/SDDAT3/SDI/IO4/IN11; 41: SPICLK; 42: PB11/EXTINT11/PAD3/WO1/WO5/WO1/CS/SDCK/FS1/IO5/OUT1; 43: PB12/EXTINT12/X26/Y26/PAD0/WO0/WO0/WO0/SDCD/SCK1/IO6; 44: PB13/EXTINT13/X27/Y27/PAD1/WO1/WO1/WO1/SDWP/MCK1/IO7; 45: VDDIO2_L; 46: PB14/EXTINT14/X28/Y28/PAD2/WO0/WO0/WO2/DATA8/GMDC/IO0/IN9; 47: PB15/EXTINT15/X29/Y29/PAD3/WO1/WO1/WO3/DATA9/GMDIO/IO1/IN10; 48: NC; 49: GPIO6; 50: GPIO5; 51: GPIO4; 52: VDDCR2; 53: EEEMULSPI2; 54: GPIO11; 55: GPIO12; 56: GPIO13; 57: GPIO10; 58: GPIO14; 59: GPIO15; 60: VDDIO3_L; 61: PA12/EXTINT12/PAD0/PAD1/WO0/WO6/WO2/SDCD/DEN1/GRX1/CMP0; 62: PA13/EXTINT13/PAD1/PAD0/WO1/WO7/WO3/SDWP/DEN2/GRX0/CMP1; 63: PA14/EXTINT14/PAD2/PAD2/WO0/WO0/WO2/CLK/GTXCK/IO0/XIN0; 64: PA15/EXTINT15/PAD3/PAD3/WO1/WO1/WO3/GRXER/IO1/XOUT0; 65: VDDIO1_S; 66: GPIO9; 67: PA16/EXTINT0/X10/Y10/PAD0/PAD1/WO0/WO0/WO4/DATA0/GCRS/GRXDV/IO2/IN0; 68: PA17/EXTINT1/X11/Y11/PAD1/PAD0/WO1/WO1/WO5/DATA1/GTXEN/IO3/IN1; 69: PA18/EXTINT2/X12/Y12/PAD2/PAD2/WO0/WO2/WO6/DATA2/GTX0/CMP0/IN2; 70: SYNC0_LATCH0; 71: SIO3; 72: GPIO0; 73: PA19/EXTINT3/X13/Y13/PAD3/PAD3/WO1/WO3/WO7/DATA3/GTX1/CMP1/OUT0; 74: VDDIO5_L; 75: VMARGIN; 76: VDDCR3; 77: PB16/EXTINT0/PAD0/WO0/WO4/SCK0/IO2/IN11; 78: GPIO1; 79: PB17/EXTINT1/PAD1/WO1/WO5/MCK0/IO3/OUT3; 80: GPIO2; 81: TESTMODE; 82: EESDA; 83: EESCL; 84: PA20/EXTINT4/X14/Y14/PAD2/PAD2/WO4/WO0/FS0/DATA4/GMDC; 85: NC; 86: NC; 87: PA21/EXTINT5/X15/Y15/PAD3/PAD3/WO5/WO1/SDO/DATA5/GMDIO; 88: IRQ; 89: RUNLED_E2PSIZE; 90: LINKACTLED1_CHIPMODE1; 91: PA22/EXTINT6/X16/Y16/PAD0/PAD1/WO0/WO6/WO2/SDI/DATA6/IN6; 92: PA23/EXTINT7/X17/Y17/PAD1/PAD0/WO1/WO7/WO3/SOF_1KHZ/FS1/DATA7/IN7; 93: PA24/EXTINT8/PAD2/PAD2/WO0/WO2/QDI0/DM/IN8; 94: VDDIO4_L; 95: LINKACTLED0_CHIPMODE0; 96: PA25/EXTINT9/PAD3/PAD3/WO1/QDI1/DP/OUT2; 97: VDDIO2_S; 98: PB22/EXTINT6/PAD2/PAD2/QDI2/SOF_1KHZ/IO0/IN0/XIN1; 99: PB23/EXTINT7/PAD3/PAD3/QDI0/IO1/OUT0/XOUT1; 100: GPIO3; 101: SPICS; 102: VDD33TXRX1; 103: TXNA; 104: TXPA; 105: RXNA; 106: RXPA; 107: PA27/EXTINT11/X18/Y18/IO1; 108: RESET_N; 109: VDDCORE; 110: VDD12TX1; 111: RBIAS; 112: VDD33BIAS; 113: VDD12TX2; 114: VSW; 115: RXPB; 116: RXNB; 117: VDDIO3_S; 118: TXPB; 119: TXNB; 120: PA30/EXTINT14/X19/Y19/PAD2/WO0/IO0/IN3; 121: PA31/EXTINT15/PAD3/WO1/OUT1; 122: PB30/EXTINT14/PAD1/WO0/WO0/WO6; 123: PB31/EXTINT15/PAD0/WO1/WO1/WO7; 124: VDD33TXRX2; 125: PB00/EXTINT0/AIN12/X30/Y30/PAD2/IN1/IN0; 126: PB01/EXTINT1/AIN13/X31/Y31/PAD3/IN2/OUT/OUT0; 127: PB02/EXTINT2/AIN14/X20/Y20/PAD0/WO2/OUT0/IN1/OUT1; 128: OSCI, interrupts=-15 Reset — Reset Vector, invoked on Power up and warm reset; -14 NonMaskableInt — Non maskable Interrupt, cannot be stopped or preempted; -13 HardFault — Hard Fault, all classes of Fault; -12 MemoryManagement — Memory Management, MPU mismatch, including Access Violation and No Match; -11 BusFault — Bus Fault, Pre-Fetch-, Memory Access Fault, other address/memory related Fault; -10 UsageFault — Usage Fault, i.e. Undef Instruction, Illegal State Transition; -5 SVCall — System Service Call via SVC instruction; -4 DebugMonitor — Debug Monitor; -2 PendSV — Pendable request for system service; -1 SysTick — System Tick Timer; 0 PM — Power Manager; 1 MCLK — Main Clock; 2 OSCCTRL_XOSC0 — External Oscillator 0; 3 OSCCTRL_XOSC1 — External Oscillator 1; 4 OSCCTRL_DFLL — Digital Frequency Locked Loop; 5 OSCCTRL_DPLL0 — Digital Phase Locked Loop 0; 6 OSCCTRL_DPLL1 — Digital Phase Locked Loop 1; 7 OSC32KCTRL — 32Khz Oscillator Controller; 8 SUPC_OTHER — Suppyly controller; 9 SUPC_BODDET — Brown Out Detection; 10 WDT — Watch Dog Timer; 11 RTC — Real Time Counter; 12 EIC_EXTINT_0 — EIC Channel 0; 13 EIC_EXTINT_1 — EIC Channel 1; 14 EIC_EXTINT_2 — EIC Channel 2; 15 EIC_EXTINT_3 — EIC Channel 3; 16 EIC_EXTINT_4 — EIC Channel 4; 17 EIC_EXTINT_5 — EIC Channel 5; 18 EIC_EXTINT_6 — EIC Channel 6; 19 EIC_EXTINT_7 — EIC Channel 7; 20 EIC_EXTINT_8 — EIC Channel 8; 21 EIC_EXTINT_9 — EIC Channel 9; 22 EIC_EXTINT_10 — EIC Channel 10; 23 EIC_EXTINT_11 — EIC Channel 11; 24 EIC_EXTINT_12 — EIC Channel 12; 25 EIC_EXTINT_13 — EIC Channel 13; 26 EIC_EXTINT_14 — EIC Channel 14; 27 EIC_EXTINT_15 — EIC Channel 15; 28 FREQM — Frequency Meter; 29 NVMCTRL_0 — Non-Volatile Memory Controller; 30 NVMCTRL_1 — NVMCTRL SmartEEPROM Interrupts; 31 DMAC_0 — DMA Channel 0; 32 DMAC_1 — DMA Channel 1; 33 DMAC_2 — DMA Channel 2; 34 DMAC_3 — DMA Channel 3; 35 DMAC_OTHER — DMA Channel 4..X; 36 EVSYS_0 — Event System Channel 0; 37 EVSYS_1 — Event System Channel 1; 38 EVSYS_2 — Event System Channel 2; 39 EVSYS_3 — Event System Channel 3; 40 EVSYS_OTHER — Event System Channel 4..X; 41 PAC — Peripheral Access Controller; 45 RAMECC — RAM Error Correction Code; 46 SERCOM0_0 — Serial Communication Interface 0; 47 SERCOM0_1 — Serial Communication Interface 0; 48 SERCOM0_2 — Serial Communication Interface 0; 49 SERCOM0_OTHER — Serial Communication Interface 0; 50 SERCOM1_0 — Serial Communication Interface 1; 51 SERCOM1_1 — Serial Communication Interface 1; 52 SERCOM1_2 — Serial Communication Interface 1; 53 SERCOM1_OTHER — Serial Communication Interface 1; 54 SERCOM2_0 — Serial Communication Interface 2; 55 SERCOM2_1 — Serial Communication Interface 2; 56 SERCOM2_2 — Serial Communication Interface 2; 57 SERCOM2_OTHER — Serial Communication Interface 2; 58 SERCOM3_0 — Serial Communication Interface 3; 59 SERCOM3_1 — Serial Communication Interface 3; 60 SERCOM3_2 — Serial Communication Interface 3; 61 SERCOM3_OTHER — Serial Communication Interface 3; 62 SERCOM4_0 — Serial Communication Interface 4; 63 SERCOM4_1 — Serial Communication Interface 4; 64 SERCOM4_2 — Serial Communication Interface 4; 65 SERCOM4_OTHER — Serial Communication Interface 4; 66 SERCOM5_0 — Serial Communication Interface 5; 67 SERCOM5_1 — Serial Communication Interface 5; 68 SERCOM5_2 — Serial Communication Interface 5; 69 SERCOM5_OTHER — Serial Communication Interface 5; 80 USB_OTHER — Universal Serial Bus; 81 USB_SOF_HSOF — USB Start of Frame; 82 USB_TRCPT0 — USB Transfer Complete 0; 83 USB_TRCPT1 — USB Transfer Complete 1; 84 GMAC — Ethernet MAC; 85 TCC0_OTHER — Timer Counter Control 0; 86 TCC0_MC0 — TCC Match/Compare 0; 87 TCC0_MC1 — TCC Match/Compare 1; 88 TCC0_MC2 — TCC Match/Compare 2; 89 TCC0_MC3 — TCC Match/Compare 3; 90 TCC0_MC4 — TCC Match/Compare 4; 91 TCC0_MC5 — TCC Match/Compare 5; 92 TCC1_OTHER — Timer Counter Control 1; 93 TCC1_MC0 — TCC Match/Compare 0; 94 TCC1_MC1 — TCC Match/Compare 1; 95 TCC1_MC2 — TCC Match/Compare 2; 96 TCC1_MC3 — TCC Match/Compare 3; 97 TCC2_OTHER — Timer Counter Control 2; 98 TCC2_MC0 — TCC Match/Compare 0; 99 TCC2_MC1 — TCC Match/Compare 1; 100 TCC2_MC2 — TCC Match/Compare 2; 101 TCC3_OTHER — Timer Counter Control 3; 102 TCC3_MC0 — TCC Match/Compare 0; 103 TCC3_MC1 — TCC Match/Compare 1; 104 TCC4_OTHER — Timer Counter Control 4; 105 TCC4_MC0 — TCC Match/Compare 0; 106 TCC4_MC1 — TCC Match/Compare 1; 107 TC0 — Timer Counter 0; 108 TC1 — Timer Counter 1; 109 TC2 — Timer Counter 2; 110 TC3 — Timer Counter 3; 111 TC4 — Timer Counter 4; 112 TC5 — Timer Counter 5; 115 PDEC_OTHER — Position Decoder; 116 PDEC_MC0 — PDEC Match/Compare 0; 117 PDEC_MC1 — PDEC Match Compare 1; 118 ADC0_OTHER — Analog To Digital Converter 0; 119 ADC0_RESRDY — ADC0 Result Ready; 120 ADC1_OTHER — Analog To Digital Converter 1; 121 ADC1_RESRDY — ADC1 Result Ready; 122 AC — Analog Comparator; 123 DAC_OTHER — Digital to Analog Converter; 124 DAC_EMPTY_0 — DAC Buffer 0 Empty; 125 DAC_EMPTY_1 — DAC Buffer 1 Empty; 126 DAC_RESRDY_0 — DAC Filter 0 Result Ready; 127 DAC_RESRDY_1 — DAC Filter 1 Result Ready; 128 I2S — Inter-IC Sound Interface; 129 PCC — Parallel Capture Controller; 130 AES — Advanced Encryption Standard; 131 TRNG — True Random Generator; 132 ICM — Integrity Check Monitor; 133 PUKCC — Public-Key Cryptography Controller; 134 QSPI — Quad SPI interface; 135 SDHC0 — SD/MMC Host Controller 0
