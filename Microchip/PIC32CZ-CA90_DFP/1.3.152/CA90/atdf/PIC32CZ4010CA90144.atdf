# PIC32CZ4010CA90144 device description
Architecture: CORTEX-M7; Family: PIC32C; Series: PIC32CZCA90
Parameters: GCLK_ID_TRACE=63 (Index of Generic Clock), NUM_IRQ=222 (Number of Interrupt Requests), __CM7_REV=0x0101 (Cortex-M7 Revision), __DCACHE_PRESENT=1 (DCACHE present or not), __DEBUG_LVL=1 (Debug Level), __DTCM_PRESENT=1 (DTCM present or not), __ETM_LVL=1 (Extended Trace Level), __FPU_DP=1 (FPU double-precision or not), __FPU_PRESENT=1 (FPU present or not), __ICACHE_PRESENT=1 (ICACHE present or not), __ITCM_PRESENT=1 (ITCM present or not), __MPU_PRESENT=1 (MPU present or not), __MPU_REGIONS=8 (Number of MPU regions), __NVIC_PRIO_BITS=3 (Number of NVIC Priority bits), __TRACE_LVL=1 (Trace Level), __VTOR_PRESENT=1 (VTOR present or not), __Vendor_SysTickConfig=0 (Set to 1 if different SysTick Config is used), POWER_DOMAIN=PD_CORE_SW, __ARCH_ARM=1, __ARCH_ARM_CORTEX_M=1
Programming and debug interfaces: JTAG, SWD
Registers are 32-bit, read-write, reset 0x0 unless marked. A register's access mark holds for its fields unless they carry their own. Offsets are from the block's base; lines under a group give offsets from that group; [hi:lo] are bit positions; {n}, {i} and the like mark numbered series; 'fields as' and 'values as' point back to an identical list; <NAME> marks a mode.

## Ordering variants
PIC32CZ4010CA90144-I/LUX: BGA144, pinout PIC32CZCA144B, up to 300 MHz, -40 to 85 C, 1.66 to 3.66 V
PIC32CZ4010CA90144-V/LUX: BGA144, pinout PIC32CZCA144B, up to 300 MHz, -40 to 105 C, 1.66 to 3.66 V
PIC32CZ4010CA90144-E/LUX: BGA144, pinout PIC32CZCA144B, up to 200 MHz, -40 to 125 C, 1.66 to 3.66 V
PIC32CZ4010CA90144-I/BAD: DRQFN144, pinout PIC32CZCA144DR, up to 300 MHz, -40 to 85 C, 1.66 to 3.66 V
PIC32CZ4010CA90144-V/BAD: DRQFN144, pinout PIC32CZCA144DR, up to 300 MHz, -40 to 105 C, 1.66 to 3.66 V
PIC32CZ4010CA90144-E/BAD: DRQFN144, pinout PIC32CZCA144DR, up to 200 MHz, -40 to 125 C, 1.66 to 3.66 V
PIC32CZ4010CA90144-I/8YX: LQFP144, pinout PIC32CZCA144, up to 300 MHz, -40 to 85 C, 1.66 to 3.66 V
PIC32CZ4010CA90144-V/8YX: LQFP144, pinout PIC32CZCA144, up to 300 MHz, -40 to 105 C, 1.66 to 3.66 V
PIC32CZ4010CA90144-E/8YX: LQFP144, pinout PIC32CZCA144, up to 200 MHz, -40 to 125 C, 1.66 to 3.66 V

## Memory
base space: start 0 size 0x100000000, little endian
  0x00000000 ITCM size 0x20000 ram, rw, executable
  0x4000000 PRM_ROM size 0x8000 rom, ro, executable
  0x8000000 FCR_BFM size 0x20000 flash, rw, executable, page 4096
  0xA000000 FCR_CFM_USERCFG1 size 0x1000 flash, rw, page 4096
  0xA001000 FCR_CFM_USEROTP1 size 0x1000 user_signatures, rw, page 4096
  0xA002000 FCR_CFM_BOOTCFG1 size 0x1000 flash, rw, page 4096
  0xA004000 FCR_CFM_DALCFG size 0x1000 flash, rw, page 4096
  0xA007000 FCR_CFM_CALOTP size 0x1000 other, ro, page 4096
  0xA008000 FCR_CFM_USERCFG2 size 0x1000 flash, rw, page 4096
  0xA009000 FCR_CFM_USEROTP2 size 0x1000 user_signatures, rw, page 4096
  0xA00A000 FCR_CFM_BOOTCFG2 size 0x1000 flash, rw, page 4096
  0x0A00C000 FCR_CFM_HSMCFG0 size 0x1000 flash, rw, page 4096
  0x0A00D000 FCR_CFM_HSMCFG1 size 0x1000 flash, rw, page 4096
  0x0A00E000 FCR_CFM_HSMCFG2 size 0x1000 flash, rw, page 4096
  0x0A00F000 FCR_CFM_HSMCFG3 size 0x1000 flash, rw, page 4096
  0xC000000 FCR_PFM size 0x400000 flash, rw, executable, page 4096
  0x20000000 DTCM size 0x20000 ram, rw, executable
  0x20020000 FLEXRAM size 0x100000 ram, rw, executable
  0x44000000 APBA size 0x800000 io, rw
  0x44800000 APBB size 0x800000 io, rw
  0x45000000 APBC size 0x800000 io, rw
  0x45800000 APBD size 0x800000 io, rw
  0x46000000 APBE size 0x800000 io, rw
  0x46800000 APBF size 0x800000 io, rw
  0x4F008000 SQI0_SFR size 0x1000 io, rw
  0x4F009000 SQI1_SFR size 0x1000 io, rw
  0x4F010000 USBHS0_SFR size 0x2000 io, rw
  0x4F012000 USBHS1_SFR size 0x2000 io, rw
  0x4F018000 HSM_SFR size 0x400 io, rw
  0x80000000 SQI0_XIP size 0x10000000 ram, rw, executable, external
  0x90000000 SQI1_XIP size 0x10000000 ram, rw, executable, external
  0xE0000000 PPB size 0x20000000 io, rw
  0xE00FE000 CM7H_ROM_TABLE size 0x100 rom, ro, executable

## Notices in the file
Copyright (c) 2021 Microchip Technology Inc.
SPDX-License-Identifier: Apache-2.0
Licensed under the Apache License, Version 2.0 (the "License");
you may not use this file except in compliance with the License.
You may obtain a copy of the License at
http://www.apache.org/licenses/LICENSE-2.0
Unless required by applicable law or agreed to in writing, software
distributed under the License is distributed on an "AS IS" BASIS,
WITHOUT WARRANTIES OR CONDITIONS OF ANY KIND, either express or implied.
See the License for the specific language governing permissions and
limitations under the License.
