# SAM9X75 register map
Vendor: Microchip
Architecture arm32bit. Special function registers and configuration words.
Registers are 32-bit, read-write, reset 0x0 unless marked. A register's access mark holds for its fields unless they carry their own. Addresses are absolute, and some are shared; only a register's first bit layout is shown; lines under a group give offsets from that group; [hi:lo] are bit positions; {n}, {i} and the like mark numbered series; 'fields as' and 'values as' point back to an identical list; <NAME> marks a mode.

## Further device data
pins=1: GND; 2: PC8/ISC_D8/FLEXCOM9_IO0/P72; 3: PC20/FLEXCOM10_IO4/PWM2/P84; 4: PC24/FLEXCOM3_IO4/P88; 5: PC28/FLEXCOM1_IO3/P92; 6: PC2/ISC_D2/TIOA3/P66/LVDS_A0M; 7: PC4/ISC_D4/TCLK3/P68/LVDS_A1M; 8: PC6/ISC_D6/TIOB4/P70/LVDS_A2M; 9: PC10/ISC_D10/PWM0/P74/LVDS_CLK1M; 10: PC12/ISC_PCK/TIOA5/P76/LVDS_A3M; 11: PB17/QIO7/FLEXCOM12_IO0/I2SMCC_DOUT0/P49; 12: PB25/QINT/I2SMCC_MCK/P57; 13: D15; 14: D12; 15: NDQS1; 16: GND; 17: MIPI; 18: MIPI; 19: PC18/FLEXCOM10_IO2/PWM0/P82; 20: PC22/FLEXCOM3_IO0/P86; 21: PC26/FLEXCOM3_IO2/P90; 22: PC3/ISC_D3/TIOB3/P67/LVDS_A0P; 23: PC5/ISC_D5/TIOA4/P69/LVDS_A1P; 24: PC7/ISC_D7/TCLK4/P71/LVDS_A2P; 25: PC11/ISC_D11/PWM1/P75/LVDS_CLK1P; 26: PC13/ISC_VSYNC/TIOB5/P77/LVDS_A3P; 27: PB19/QSCK/FLEXCOM12_IO2/P51; 28: PB23/QIO2/FLEXCOM9_IO3/P55; 29: D13; 30: D14; 31: DQS1; 32: D11; 33: MIPI; 34: MIPI; 35: GND; 36: PC14/ISC_HSYNC/TCLK5/P78; 37: PC16/ISC_FIELD/FLEXCOM10_IO0/P80; 38: PC23/FLEXCOM3_IO1/P87; 39: GND; 40: PC30/FLEXCOM3_IO7/P94; 41: PB15/QIO5/FLEXCOM11_IO0/I2SMCC_WS/P47; 42: GND; 43: PB21/QIO0/FLEXCOM12_IO4/P53; 44: PB24/QIO3/FLEXCOM9_IO4/P56; 45: VDDQSPI; 46: GND; 47: DQM1; 48: D8; 49: MIPI; 50: MIPI; 51: PC0/ISC_D0/FLEXCOM7_IO0/P64; 52: PC15/ISC_MCK/PCK0/P79; 53: VDDCORE; 54: PC9/ISC_D9/FLEXCOM9_IO1/P73; 55: VDDIOP; 56: PC29/FLEXCOM1_IO2/P93; 57: PB16/QIO6/FLEXCOM11_IO1/I2SMCC_DIN0/P48; 58: VDDLVDS; 59: PB20/QCS/FLEXCOM12_IO3/P52; 60: PB26/QIO4/I2SMCC_CK/P58; 61: D10; 62: D9; 63: D6; 64: D1; 65: MIPI; 66: MIPI; 67: PC21/PWM3/P85; 68: PC19/FLEXCOM10_IO3/PWM1/P83; 69: VDDCORE; 70: PC25/FLEXCOM3_IO3/P89; 71: GND; 72: PC27/FLEXCOM1_IO4/P91; 73: PB18/QDQS/ADTRG/FLEXCOM12_IO1/IRQ/P50; 74: GND; 75: PB22/QIO1/FLEXCOM9_IO2/P54; 76: VDDIOM; 77: D5; 78: D3; 79: D2; 80: D4; 81: MIPI; 82: MIPI; 83: PC1/ISC_D1/FLEXCOM7_IO1/P65; 84: PC17/FLEXCOM1_IO7/FLEXCOM10_IO1/P81; 85: NRST; 86: VDDCORE; 87: VDDOUT; 88: PC31/FIQ/PCK1/P95; 89: VDDCORE; 90: D7; 91: DQS0; 92: NDQS0; 93: DQM0; 94: DDR; 95: XIN; 96: XOUT; 97: GND; 98: VDDIN; 99: GND; 100: VDDMIPI; 101: GND; 102: VDDIOM; 103: GND; 104: D0; 105: A18/BA2; 106: SDCKE; 107: HHSDMA; 108: HHSDPA; 109: PA15/TIOA0/FLEXCOM5_IO1/CLASSD_R0/P15; 110: TDI; 111: TCK; 112: MIPI; 113: GND; 114: GND; 115: DDR; 116: SDWE; 117: RAS; 118: CAS; 119: A15; 120: NCS1; 121: HHSDMB; 122: HHSDPB; 123: PA21/TIOB0/RD/CLASSD_L3/P21; 124: PA18/TCLK0/TK/CLASSD_L0/P18; 125: AUDIO; 126: SHDN; 127: GND; 128: TST; 129: RESETN; 130: SDA10; 131: SDCKN; 132: SDCK; 133: A14; 134: A17/BA1; 135: HHSDMC; 136: HHSDPC; 137: GND; 138: VDDIN; 139: GNDANA; 140: HHSRTUNE; 141: GND; 142: VDDIOM; 143: GND; 144: A5; 145: A7; 146: A8; 147: PA30/FLEXCOM0_IO0/FLEXCOM5_IO4/FLEXCOM4_IO4/P30/AD6; 148: PA27/DTXD/CANTX0/P27/AD3; 149: PA26/DRXD/CANRX0/P26/AD2; 150: PA29/FLEXCOM1_IO1/CANRX1/P29/AD5; 151: WKUP0; 152: VDDANA; 153: GND; 154: PB11/GRX0/PWM0/FLEXCOM8_IO3/P43; 155: VDDCORE; 156: A16/BA0; 157: A2; 158: A4; 159: A3; 160: A6; 161: PA25/FLEXCOM6_IO1/FLEXCOM5_IO5/P25/AD1; 162: PA31/FLEXCOM0_IO1/FLEXCOM4_IO5/GTSUCOMP/P31/AD7; 163: PA24/FLEXCOM6_IO0/FLEXCOM5_IO6/P24/AD0; 164: PA28/FLEXCOM1_IO0/CANTX1/P28/AD4; 165: VDDBU; 166: PA20/TCLK2/TD/CLASSD_L2/P20; 167: GND; 168: PA11/FLEXCOM4_IO2/SDMMC1_CK/P11; 169: PB7/GTXEN/GTXCTL/FLEXCOM6_IO2/P39; 170: GND; 171: PD11/NANDDAT5/NWR0/NWE/P107; 172: VDDIOM; 173: A11; 174: A9; 175: A10; 176: A13; 177: ADVREFN; 178: ADVREFP; 179: PA5/SDMMC0_DAT3/P5; 180: VDDBU; 181: PA13/FLEXCOM2_IO0/FLEXCOM4_IO4/P13; 182: PA16/TIOA1/FLEXCOM5_IO0/CLASSD_R1/P16; 183: VDDIOP; 184: PA1/SDMMC0_CMD/P1; 185: PB5/GTX3/FLEXCOM8_IO1/P37; 186: VDDIOP; 187: PB1/GRX3/FLEXCOM2_IO3/P33; 188: PD9/NANDDAT3/A20/P105; 189: VDDNF; 190: PD5/NCS0/FLEXCOM11_IO4/P101; 191: PD4/NCS2/NANDCS/FLEXCOM11_IO3/P100; 192: PD1/NANDWE/FLEXCOM7_IO3/P97; 193: JTAGSEL; 194: TMS; 195: GND; 196: PA9/FLEXCOM4_IO1/SDMMC1_DAT0/P9; 197: PA7/FLEXCOM0_IO3/SDMMC1_DAT2/P7; 198: PA3/SDMMC0_DAT1/P3; 199: GND; 200: PB9/GMDIO/PCK1/FLEXCOM6_IO4/P41; 201: PB13/GTX0/PWM2/P45; 202: GND; 203: PD13/NANDDAT7/NWR1/NBS1/P109; 204: PD7/NANDDAT1/A12/P103; 205: PD8/NANDDAT2/A19/P104; 206: GND; 207: PD2/A21/NANDALE/FLEXCOM7_IO4/P98; 208: PD3/A22/NANDCLE/FLEXCOM11_IO2/P99; 209: XOUT32; 210: XIN32; 211: RTCK; 212: PA23/TIOB2/RF/FLEXCOM2_IO7/P23; 213: PA17/TIOA2/FLEXCOM5_IO2/CLASSD_R2/P17; 214: PA12/FLEXCOM4_IO3/FLEXCOM5_IO4/P12; 215: PA10/FLEXCOM4_IO0/SDMMC1_CMD/P10; 216: PA4/SDMMC0_DAT2/P4; 217: PB14/GTX1/PWM3/P46; 218: PB10/GMDC/PCK0/FLEXCOM8_IO2/P42; 219: PB6/GTXCK/GREFCK/FLEXCOM0_IO7/P38; 220: PB2/G125CK/FLEXCOM2_IO2/P34; 221: PB0/GRX2/FLEXCOM2_IO4/GRXER/P32; 222: PD10/NANDDAT4/NRD/P106; 223: PD6/NANDDAT0/A1/P102; 224: PD0/NANDOE/FLEXCOM7_IO2/P96; 225: GND; 226: TDO; 227: PA22/TIOB1/RK/CLASSD_R3/P22; 228: PA19/TCLK1/TF/CLASSD_L1/P19; 229: PA14/FLEXCOM2_IO1/FLEXCOM5_IO3/FLEXCOM4_IO5/P14; 230: PA8/FLEXCOM0_IO2/SDMMC1_DAT3/P8; 231: PA6/FLEXCOM0_IO4/SDMMC1_DAT1/P6; 232: PA2/SDMMC0_CK/P2; 233: PA0/SDMMC0_DAT0/P0; 234: PB3/GCRSDV/GRXCTL/FLEXCOM4_IO6/P35; 235: PB12/GRX1/PWM1/FLEXCOM8_IO4/P44; 236: PB8/GRXCK/FLEXCOM6_IO3/P40; 237: PB4/GTX2/FLEXCOM8_IO0/P36; 238: PD12/NANDDAT6/A0/NBS0/P108; 239: PD14/NWAIT/NANDRDY/P110; 240: GND, interrupts=0 EXT_FIQ — Advanced Interrupt Controller; 1 SYSC — Logical-OR interrupt of PMC, WDT, PIT, RSTC, RTT, RTC; 2 PIOA — Parallel I/O Controller A; 3 PIOB — Parallel I/O Controller B; 4 PIOC — Parallel I/O Controller C; 5 FLEXCOM0 — Flexcom 0; 6 FLEXCOM1 — Flexcom 1; 7 FLEXCOM2 — Flexcom 2; 8 FLEXCOM3 — Flexcom 3; 9 FLEXCOM6 — Flexcom 6; 10 FLEXCOM7 — Flexcom 7; 11 FLEXCOM8 — Flexcom 8; 12 SDMMC0 — Secure Data Memory Card Controller 0; 13 FLEXCOM4 — Flexcom 4; 14 FLEXCOM5 — Flexcom 5; 15 FLEXCOM9 — Flexcom 9; 16 FLEXCOM10 — Flexcom 10; 17 TC0 — TC 0,1,2; 18 PWM — Pulse Width Modulation Controller; 19 ADC — ADC Controller; 20 XDMAC — Extended DMA Controller; 21 MATRIX — Matrix; 22 UHPHS — USB Host High Speed; 23 UDPHS — USB Device High Speed; 24 GMAC — Gigabit Ethernet MAC; 25 XLCDC — LCD Controller; 26 SDMMC1 — Secure Data Memory Card Controller 1; 28 SSC — Synchronous Serial Controller; 29 MCAN0_INT0 — Master CAN 0; 30 MCAN1_INT0 — Master CAN 1; 31 EXT_IRQ — Advanced Interrupt Controller; 32 FLEXCOM11 — Flexcom 11; 33 FLEXCOM12 — Flexcom 12; 34 I2SMCC — I2S Multi Channel Controller; 35 QSPI — Quad I/O SPI Controller; 36 GFX2D — 2D Graphic Controller; 37 PIT64B0 — 64-b Timer 0; 38 TRNG — True Random Number Generator; 39 AES — Advanced Encryption Standard; 40 TDES — Triple Data Encryption Standard; 41 SHA — Secure Hash Algorithm; 42 CLASSD — CLASS D Controller; 43 ISC — Camera Interface; 44 PIOD — Parallel I/O Controller D; 45 TC1 — TC 3,4,5; 46 OTPC — OTP Controller; 47 DBGU — DBGU; 48 ECC — logical-OR interrupt of PMECC and PMERRLOC; 49 MC — logical-OR interrupt of MPDDRC and SMC; 52 CSI2DC — CSI to Demultiplexer Controller; 53 CSI — Camera Serial Interface 2 4-Lanes; 54 DSI — Display Serial Interface 4-Lanes; 55 MIPIPHY — MIPI DPHY interface; 56 LVDSC — Display Serial Interface between XLCDC and LVDS interface; 57 LVDSPHY — LVDS PHY; 58 PIT64B1 — 64-b Timer 1; 60 GMAC_Q1 — GMAC Queue 1 Interrupt signal toggled on a DMA write to the first word of each DMA data buffer associated with queue 1; 61 GMAC_Q2 — GMAC Queue 2 Interrupt signal toggled on a DMA write to the first word of each DMA data buffer associated with queue 2; 62 GMAC_Q3 — GMAC Queue 3 Interrupt signal toggled on a DMA write to the first word of each DMA data buffer associated with queue 3; 63 GMAC_Q4 — GMAC Queue 4 Interrupt signal toggled on a DMA write to the first word of each DMA data buffer associated with queue 4; 64 GMAC_Q5 — GMAC Queue 5 Interrupt signal toggled on a DMA write to the first word of each DMA data buffer associated with queue 5; 65 GMAC_EMAC — Gigabit Ethernet MAC - Express MAC; 66 GMAC_MMSL — Gigabit Ethernet MAC - Mac Merge SubLayer; 67 GMAC_TSU — Gigabit Ethernet MAC - Time Stamp Unit; 68 MCAN0_INT1 — Master CAN 0 interrupt 1; 69 MCAN1_INT1 — Master CAN 1 interrupt 1
