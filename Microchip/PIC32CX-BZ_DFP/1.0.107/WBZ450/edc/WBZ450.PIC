# WBZ450 register map
Vendor: Microchip
Architecture arm32bit. Special function registers and configuration words.
Registers are 32-bit, read-write, reset 0x0 unless marked. A register's access mark holds for its fields unless they carry their own. Addresses are absolute, and some are shared; only a register's first bit layout is shown; lines under a group give offsets from that group; [hi:lo] are bit positions; {n}, {i} and the like mark numbered series; 'fields as' and 'values as' point back to an identical list; <NAME> marks a mode.

## Further device data
pins=1: GND; 2: NMCLR; 3: PB00/AIN2/AIN4/RPB0/IN1/IN4/EXTINT1/IN0/IN3/EXTINT0; 4: AVDD; 5: GND; 6: PA04/RPA4/IN1/IN4/EXTINT1/OUT0/OUT1/IN2/IN5/EXTINT2/SERCOM0_PAD3; 7: PA03/RPA3/IN0/IN3/EXTINT0/OUT0/IN1/IN4/EXTINT1/RTC_IN0/SERCOM0_PAD2; 8: GND; 9: PB05/AIN1/RPB5/TRD0/IN2/IN5/EXTINT2/OUT0/IN1/IN4/EXTINT1; 10: PB01/AIN3/AIN5/RPB1/IN2/IN5/EXTINT2/OUT0/IN1/IN4/EXTINT1; 11: PB04/AIN0/INT0/RPB4/TRD3/IN1/IN4/EXTINT1/IN0/IN3/EXTINT0; 12: PB06/AIN2/ANN0/RPB6/TRD1/EXTINT3/NMI/OUT0/OUT1/IN2/IN5/EXTINT2; 13: PB08/RPB8/IN1/IN4/EXTINT1/IN0/IN3/EXTINT0; 14: PB09/RPB9/IN2/IN5/EXTINT2/OUT0/IN1/IN4/EXTINT1; 15: PB07/AIN3/RPB7/TRD2/IN0/IN3/EXTINT0/OUT1/EXTINT3/NMI; 16: VDD; 17: VDD; 18: GND; 19: PA05/RPA5/IN2/IN5/EXTINT2/OUT0/OUT1/EXTINT3/NMI/SERCOM0_PAD0; 20: PA06/CMP1/RPA6/EXTINT3/NMI/OUT1/IN0/IN3/EXTINT0/SERCOM0_PAD1; 21: GND; 22: PA09/RPA9/IN0/IN3/EXTINT0/IN2/IN5/EXTINT2/OUT0/OUT1/EXTINT3/NMI/RTC_IN0_ALT/SERCOM1_PAD2; 23: PA10/RPA10/IN0/IN3/EXTINT0/EXTINT3/NMI/OUT1/RTC_OUT_ALT/SERCOM1_PAD3; 24: PA08/RPA8/EXTINT3/NMI/IN1/IN4/EXTINT1/OUT0/OUT1/IN2/IN5/EXTINT2/SERCOM1_PAD1; 25: PA07/RPA7/TRCLK/IN0/IN3/EXTINT0/IN1/IN4/EXTINT1/SERCOM1_PAD0; 26: NC; 27: GND; 28: NC; 29: NC; 30: NC, interrupts=-15 Reset — Reset Vector, invoked on Power up and warm reset; -14 NonMaskableInt — Non maskable Interrupt, cannot be stopped or preempted; -13 HardFault — Hard Fault, all classes of Fault; -12 MemoryManagement — Memory Management, MPU mismatch, including Access Violation and No Match; -11 BusFault — Bus Fault, Pre-Fetch-, Memory Access Fault, other address/memory related Fault; -10 UsageFault — Usage Fault, i.e. Undef Instruction, Illegal State Transition; -5 SVCall — System Service Call via SVC instruction; -4 DebugMonitor — Debug Monitor; -2 PendSV — Pendable request for system service; -1 SysTick — System Tick Timer; 0 RTC — Real Time Counter; 1 EIC — External Interrupt Controller; 2 FREQM — Frequency Meter; 3 FLASH_CONTROL — Non-Volatile Memory; 4 CHANGE_NOTICE_A — PORT_A_INPUT_CHANGE_INTERRUPT; 5 CHANGE_NOTICE_B — PORT_B_INPUT_CHANGE_INTERRUPT; 6 DMAC_0_3 — DMA Channel 0..3; 7 DMAC_4_15 — DMA Channel 4..X; 8 EVSYS_0_3 — Event System Channel 0..3; 9 EVSYS_4_11 — Event System Channel 4..X; 10 PAC — Peripheral Access Controller; 11 RAMECC — RAM Error Correction Code; 12 SERCOM0 — Serial Communication Interface 0; 13 SERCOM1 — Serial Communication Interface 1; 16 TCC0 — Timer/Counter for Control Applications 0; 17 TCC1 — Timer/Counter for Control Applications 1; 18 TCC2 — Timer/Counter for Control Applications 2; 19 TC0 — Timer/Counter 0; 20 TC1 — Timer/Counter 1; 21 TC2 — Timer/Counter 2; 22 TC3 — Timer/Counter 3; 23 ADCHS — Analog-to-Digital Converter; 25 AES — Advanced Encryption Standard; 26 TRNG — True Random Generator; 27 ICM — Integrity Check Monitor; 28 PUKCC — Public-Key Cryptography Controller; 29 QSPI — Quad SPI interface; 30 ZB_INT0 — ZIGBEE; 31 BT_INT0 — Bluetooth 0; 32 BT_INT1 — Bluetooth 0; 33 ARBITER — Radio Arbiter; 34 ADC_FAULT — ADC Fault Interrupt; 35 ADC_EOS — ADC EOS Interrupt; 36 ADC_BGVR_RDY — ADC BGVR Ready; 37 CLKI_WAKEUP_NMI — Bluetooth WAKEUP; 38 BT_LC — Bluetooth LC; 39 BT_RC — Bluetooth RC
