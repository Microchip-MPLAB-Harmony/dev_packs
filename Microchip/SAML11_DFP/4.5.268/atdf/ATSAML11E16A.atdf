# ATSAML11E16A device description
Architecture: CORTEX-M23; Family: SAML; Series: SAML11
Parameters: NUM_IRQ=45 (Number of interrupt request lines), __ARMv8MBL_REV=0x0000 (Cortex-M23 Core Revision), __BKPT_NUM=4 (Number of FPB breakpoint comparators), __ETM_PRESENT=0 (ETM present or not), __FPU_PRESENT=0 (FPU present or not), __MPU_NS_REGIONS=4 (Number of MPU_NS regions), __MPU_PRESENT=1 (MPU present or not), __MPU_S_REGIONS=4 (Number of MPU_S regions), __MTB_PRESENT=0 (MTB present or not), __NVIC_PRIO_BITS=2 (Number of Bits used for Priority Levels), __SAU_PRESENT=0 (SAU present or not), __SEC_ENABLED=1 (TrustZone-M enabled or not), __SYST_NUM=2 (Number of SysTick instances), __VTOR_PRESENT=1 (Vector Table Offset Register present or not), __Vendor_SysTickConfig=0 (Set to 1 if different SysTick Config is used), __WPT_NUM=2 (Number of DWT watchpoint comparators), __ARCH_ARM=1, __ARCH_ARM_CORTEX_M=1
Programming and debug interfaces: SWD
Registers are 32-bit, read-write, reset 0x0 unless marked. A register's access mark holds for its fields unless they carry their own. Offsets are from the block's base; lines under a group give offsets from that group; [hi:lo] are bit positions; {n}, {i} and the like mark numbered series; 'fields as' and 'values as' point back to an identical list; <NAME> marks a mode.

## Ordering variants
ATSAML11E16A-MU: QFN32, pinout SAML1xE, up to 32 MHz, -40 to 85 C, 1.62 to 3.63 V
ATSAML11E16A-MF: QFN32, pinout SAML1xE, up to 32 MHz, -40 to 125 C, 1.62 to 3.63 V
ATSAML11E16A-AU: TQFP32, pinout SAML1xE, up to 32 MHz, -40 to 85 C, 1.62 to 3.63 V
ATSAML11E16A-AF: TQFP32, pinout SAML1xE, up to 32 MHz, -40 to 125 C, 1.62 to 3.63 V
ATSAML11E16A-UU: WLCSP32, pinout SAML1xEU, up to 32 MHz, -40 to 85 C, 1.62 to 3.63 V

## Memory
base space: start 0 size 0x100000000, little endian
  0x00000000 FLASH size 0x10000 flash, rw, executable, page 64
  0x00806000 AUX size 0x100 fuses, rw, page 64
  0x0080C000 BOCOR size 0x100 fuses, rw, page 64
  0x00400000 DATAFLASH size 0x800 flash, rw, page 64
  0x00806020 SW_CALIB size 0x8 fuses, ro
  0x00806038 TEMP_LOG size 0x8 fuses, ro
  0x00804000 USER_PAGE size 0x100 user_page, rw, page 64
  0x20000000 HSRAM size 0x4000 ram, rw, executable
  0x40000000 APBA size 0x8000 io, rw
  0x41000000 APBB size 0x10000 io, rw
  0x42000000 APBC size 0x4000 io, rw
  0xE0000000 PPB size 0x100000 io, rw
  0xE000E000 SCS size 0x00001000 io, rw
  0x40000000 PERIPHERALS size 0x20000000 io, rw
fuses space: start 0x00000000 size 0x20000000, little endian

## Peripheral instances (address, pins/pin function, parameters)
AC at 0x40003400
  pins: AIN0 PA04/B; AIN1 PA05/B; AIN2 PA06/B; AIN3 PA07/B; CMP0 PA18/H; CMP1 PA19/H
  parameters: GCLK_ID=17 (Index of Generic Clock), NUM_CMP=2 (Number of comparators), PAIRS=1 (Number of pairs of comparators), INSTANCE_ID=13
ADC at 0x42001C00
  pins: AIN{n} PA{n+2:02}/B (n=0..9); VREFP PA04/B
  parameters: DMAC_ID_RESRDY=19 (index of DMA RESRDY trigger), EXTCHANNEL_MSB=9 (Number of external channels), GCLK_ID=16 (index of Generic Clock), INT_CH30=1 (Select OPAMP or CTAT on Channel 30), MASTER_SLAVE_MODE=0 (ADC Master/Slave Mode), INSTANCE_ID=71, LOAD_CALIB=1 (CALIB register to be loaded from NVM)
CCL at 0x42002C00
  pins: IN0 PA04/I or PA16/I; IN1 PA05/I or PA17/I; IN2 PA06/I or PA18/I; IN3 PA08/I or PA30/I; IN4 PA09/I; IN5 PA10/I; OUT0 PA07/I or PA19/I; OUT1 PA11/I or PA31/I
  parameters: GCLK_ID=20 (GCLK index for CCL), LUT_NUM=2 (Number of LUT in a CCL), SEQ_NUM=1 (Number of SEQ in a CCL), INSTANCE_ID=75
DAC at 0x42002000
  pins: VOUT PA02/B; VREFP PA03/B
  parameters: DMAC_ID_EMPTY=20 (Index of DMA EMPTY trigger), GCLK_ID=18, INSTANCE_ID=72
DMAC at 0x41006000
  parameters: CH_BITS=3 (Number of bits to select channel), CH_NUM=8 (Number of channels), EVIN_NUM=4 (Number of input events), EVOUT_NUM=4 (Number of output events), LVL_BITS=2 (Number of bit to select level priority), LVL_NUM=4 (Enable priority level number), QOSCTRL_D_RESETVALUE=2 (QOS dmac ahb interface reset value), QOSCTRL_F_RESETVALUE=2 (QOS dmac fetch interface reset value), QOSCTRL_WRB_RESETVALUE=2 (QOS dmac write back interface reset value), TRIG_BITS=5 (Number of bits to select trigger source), TRIG_NUM=24 (Number of peripheral triggers), CHANNEL{n}_INT_SRC={n+11} (DMA Channel {n} Interrupt) (n=0..4), CHANNEL5_INT_SRC=15 (DMA Channel 5 Interrupt), CHANNEL6_INT_SRC=15 (DMA Channel 6 Interrupt), CHANNEL7_INT_SRC=15 (DMA Channel 7 Interrupt), INSTANCE_ID=35
DSU at 0x41002000, DSU_EXT 0x41002100
  parameters: DMAC_ID_DCC0=2 (DMAC ID for DCC0 register), DMAC_ID_DCC1=3 (DMAC ID for DCC1 register), INSTANCE_ID=33
EIC at 0x40002800, EIC_SEC 0x40002A00
  pins: EXTINT0 PA09/A or PA19/A or PA00/A; EXTINT1 PA10/A or PA22/A or PA01/A; EXTINT2 PA02/A or PA11/A or PA23/A; EXTINT3 PA03/A or PA14/A or PA24/A; EXTINT4 PA04/A or PA15/A or PA25/A; EXTINT5 PA05/A or PA16/A or PA27/A; EXTINT6 PA06/A or PA17/A or PA30/A; EXTINT7 PA07/A or PA18/A or PA31/A; NMI PA08/A
  parameters: EXTINT_NUM=8 (Number of external interrupts), GCLK_ID=3 (Generic Clock index), NUMBER_OF_CONFIG_REGS=1 (Number of CONFIG registers), NUMBER_OF_DPRESCALER_REGS=1 (Number of DPRESCALER registers), NUMBER_OF_INTERRUPTS=8 (Number of external interrupts (obsolete)), SECURE_IMPLEMENTED=1 (Security Configuration implemented?), INSTANCE_ID=10
EVSYS at 0x42000000, EVSYS_SEC 0x42000200
  parameters: ASYNCHRONOUS_CHANNELS=0x000000F0 (Mask of Only Asynchronous Channels), CHANNELS=8 (Number of Channels), CHANNELS_BITS=3 (Number of bits to select Channel), GCLK_ID_0=6 (Index of Generic Clock 0), GCLK_ID_1=7 (Index of Generic Clock 1), GCLK_ID_2=8 (Index of Generic Clock 2), GCLK_ID_3=9 (Index of Generic Clock 3), GENERATORS=49 (Total Number of Event Generators), GENERATORS_BITS=6 (Number of bits to select Event Generator), SECURE_IMPLEMENTED=1 (Secure Channels/Users supported?), SYNCH_NUM=4 (Number of Synchronous Channels), SYNCH_NUM_BITS=2 (Number of bits to select Synchronous Channels), USERS=23 (Total Number of Event Users), USERS_BITS=5 (Number of bits to select Event User), USERS_GROUPS=1 (Number of 32-user groups), INSTANCE_ID=64
FREQM at 0x40002C00
  parameters: GCLK_ID_MSR=4 (Index of measure generic clock), GCLK_ID_REF=5 (Index of reference generic clock), INSTANCE_ID=11
GCLK at 0x40001C00
  pins: IO0 PA30/H or PA14/H or PA27/H; IO1 PA23/H or PA15/H; IO2 PA16/H or PA22/H; IO3 PA11/H or PA17/H; IO4 PA10/H
  parameters: GENDIV_BITS=16, GEN_BITS=3, GEN_NUM=5 (Number of Generic Clock Generators), GEN_NUM_MSB=4 (Number of Generic Clock Generators - 1), GEN_SOURCE_NUM_MSB=7 (Number of Generic Clock Sources - 1), NUM=21 (Number of Generic Clock Users), SOURCE_BITS=3, SOURCE_NUM=8 (Number of Generic Clock Sources), INSTANCE_ID=7
IDAU at 0x41000000
  parameters: CRYA_AES_DECRYPT_T=0x02001908 (crya_aes_decryp_t function address), CRYA_AES_ENCRYPT_T=0x02001904 (crya_aes_encryp_t function address), CRYA_GF_MULT128=0x0200190C (crya_gf_mult128 function address), CRYA_SHA_PROCESS=0x02001900 (crya_sha_process function address), GRANULARITY_ANSC=0x20 (Application Non-Secure Callable region granularity), GRANULARITY_AS=0x100 (Application Secure region granularity), GRANULARITY_BNSC=0x20 (Boot Flash Non-Secure Callable region granularity), GRANULARITY_BOOTPROT=0x100 (BOOTPROT region granularity), GRANULARITY_BS=0x100 (Boot Flash Secure region granularity), GRANULARITY_DS=0x100 (DS region granularity), GRANULARITY_RS=0x80 (RAM Secure region granularity), REGION_ANS=0x06 (Flash Non-Secure APPLICATION region number), REGION_ANSC=0x05 (Flash Non-Secure Callable APPLICATION region number), REGION_AS=0x04 (Flash Secure APPLICATION region number), REGION_BNS=0x03 (Flash Non-Secure BOOT region number), REGION_BNSC=0x02 (Flash Non-Secure Callable BOOT region number), REGION_BOOTROM=0x09 (Boot ROM region number), REGION_BS=0x01 (Flash Secure BOOT region number), REGION_DNS=0x08 (Non-Secure DATA Flash region number), REGION_DS=0x07 (Secure DATA Flash region number), REGION_IOBUS=0x00 (IOBUS region number (invalid)), REGION_OTHER=0x00 (Others region number (invalid)), REGION_PERIPHERALS=0x00 (Peripherals region number (invalid)), REGION_RNS=0x0B (Non-Secure SRAM region number), REGION_RS=0x0A (Secure SRAM region number), INSTANCE_ID=32
MCLK at 0x40000800
  parameters: MCLK_CLK_APB_NUM=3, SYSTEM_CLOCK=4000000 (System Clock Frequency at Reset), INSTANCE_ID=2
  clocks: AHB APBA bit 0, APBB bit 1, APBC bit 2, DMAC bit 3, DSU bit 4, PAC bit 6, NVMCTRL bit 7, TRAM bit 12
NVMCTRL at 0x41004000, NVMCTRL_SEC 0x41005000
  pins: MARGIN VMARGIN
  parameters: DATAFLASH_PAGES=32, PMSB=3, PSZ_BITS=6, ROW_PAGES=4, SECURE_IMPLEMENTED=1 (Security Configuration implemented?), FLASH_SIZE=65536, PAGE_SIZE=64, PAGES=1024, PAGES_PR_REGION=64, PSM_0_FRMFW_FWS_1_MAX_FREQ=12000000, PSM_0_FRMLP_FWS_0_MAX_FREQ=18000000, PSM_0_FRMLP_FWS_1_MAX_FREQ=36000000, PSM_0_FRMHS_FWS_0_MAX_FREQ=25000000, PSM_0_FRMHS_FWS_1_MAX_FREQ=50000000, PSM_1_FRMFW_FWS_1_MAX_FREQ=12000000, PSM_1_FRMLP_FWS_0_MAX_FREQ=8000000, PSM_1_FRMLP_FWS_1_MAX_FREQ=12000000, INSTANCE_ID=34
FUSES at BOCOR_FUSES 0x0080C000 in fuses, SW_CALIB_FUSES 0x00806020 in fuses, TEMP_LOG_FUSES 0x00806038 in fuses, USER_FUSES 0x00804000 in fuses
OPAMP at 0x42003000
  pins: OANEG0 PA02/B; OANEG1 PA00/B; OANEG2 PA03/B; OAOUT0 PA07/B; OAOUT2 PA04/B; OAPOS0 PA06/B; OAPOS1 PA01/B; OAPOS2 PA05/B
  parameters: INSTANCE_ID=76, NUM_OPAMPS=3 (Number of op amps)
OSCCTRL at 0x40001000
  pins: XIN PA14/XIN; XOUT PA15/XOUT
  parameters: GCLK_ID_DFLLULP=2 (Index of Generic Clock for DFLLULP), GCLK_ID_DPLL=0 (Index of Generic Clock for DPLL), GCLK_ID_DPLL32K=1 (Index of Generic Clock for DPLL 32K), CFD_VERSION=0x112, DFLLULP_VERSION=0x100, FDPLL_VERSION=0x213, OSC16M_VERSION=0x102, XOSC_VERSION=0x210, INSTANCE_ID=4
OSC32KCTRL at 0x40001400
  pins: XIN32 PA00/XIN32; XOUT32 PA01/XOUT32
  parameters: OSC32K_COARSE_CALIB_MSB=0, INSTANCE_ID=5
PAC at 0x40000000, PAC_SEC 0x40000200
  parameters: APB_NUM=3 (Number of bridges AHB/APB), SECURE_IMPLEMENTED=1 (Security Configuration implemented?), INSTANCE_ID=0
PM at 0x40000400
  pins: RESET_N RESET_N
  parameters: BIAS_RAM_HS=1 (one if RAM HS can be back biased), HAS_IDLE2_SLEEP_AS_IDLE=1 (IDLE2 Sleep mode is called IDLE), HAS_BBIASTR_BIT=1 (one if RAM HS can be back biased), HAS_DPGPDSW_BIT=1 (one if RAM HS can be back biased), PD_NUM=1 (Number of switchable Power Domain), HAS_PLCFG=1 (Performance Level Configuration supported), HAS_PDCFG_BIT=1 (PDCFG bit is present), HAS_PWCFG=1 (PWCFG register is present), HAS_OFF_SLEEP=1 (OFF Sleep mode supported), INSTANCE_ID=1
PORT at 0x40003000, PORT_SEC 0x40003200, PORT_IOBUS 0x60000000, PORT_IOBUS_SEC 0x60000200
  pins: P{n} PA{n:02} (n=0..11); P14 PA14; P15 PA15; P16 PA16; P17 PA17; P18 PA18; P19 PA19; P22 PA22; P23 PA23; P24 PA24; P25 PA25; P27 PA27; P30 PA30; P31 PA31
  parameters: BITS=32, DRVSTR=1 (DRVSTR supported), EV_NUM=4, GROUPS=1, MSB=31, ODRAIN=0 (ODRAIN supported), PPP_IMPLEMENTED=0 (IOBUS2 implemented?), SECURE_IMPLEMENTED=1 (Secure I/Os supported?), SLEWLIM=0 (SLEWLIM supported), INSTANCE_ID=12
PTC at 0x42002400
  pins: DRV0 PA00/F; DRV1 PA01/F; DRV2 PA02/F; DRV3 PA03/F; DRV4 PA05/F; DRV5 PA06/F; DRV6 PA08/F; DRV7 PA09/F; DRV8 PA10/F; DRV9 PA11/F; DRV10 PA14/F; DRV11 PA15/F; DRV12 PA16/F; DRV13 PA17/F; DRV14 PA18/F; DRV15 PA19/F; DRV16 PA22/F; DRV17 PA23/F; DRV18 PA30/F; DRV19 PA31/F; ECI0 PA03/B; ECI1 PA04/B; ECI2 PA05/B; ECI3 PA06/B; X0 PA00/B; Y0 PA00/B; X1 PA01/B; Y1 PA01/B; X2 PA02/B; Y2 PA02/B; X3 PA03/B; Y3 PA03/B; X4 PA05/B; Y4 PA05/B; X5 PA06/B; Y5 PA06/B; X6 PA08/B; Y6 PA08/B; X7 PA09/B; Y7 PA09/B; X8 PA10/B; Y8 PA10/B; X9 PA11/B; Y9 PA11/B; X10 PA14/B; Y10 PA14/B; X11 PA15/B; Y11 PA15/B; X12 PA16/B; Y12 PA16/B; X13 PA17/B; Y13 PA17/B; X14 PA18/B; Y14 PA18/B; X15 PA19/B; Y15 PA19/B; X16 PA22/B; Y16 PA22/B; X17 PA23/B; Y17 PA23/B; X18 PA30/B; Y18 PA30/B; X19 PA31/B; Y19 PA31/B
  parameters: DMAC_ID_EOC=21 (Index of DMA EOC trigger), DMAC_ID_SEQ=22 (Index of DMA SEQ trigger), DMAC_ID_WCOMP=23 (Index of DMA WCOMP trigger), GCLK_ID=19 (Index of Generic Clock), LINES_MSB=19, LINES_NUM=20 (Number of PTC lines), INSTANCE_ID=73
RSTC at 0x40000C00
  parameters: BACKUP_IMPLEMENTED=0, NUMBER_OF_EXTWAKE=0 (number of external wakeup line), INSTANCE_ID=3
RTC at 0x40002400
  pins: IN0 PA08/G; IN1 PA09/G; IN2 PA16/G; IN3 PA17/G; OUT0 PA18/G; OUT1 PA19/G; OUT2 PA22/G; OUT3 PA23/G
  parameters: DMAC_ID_TIMESTAMP=1 (DMA RTC timestamp trigger), GPR_NUM=2 (Number of General-Purpose Registers), NUM_OF_ALARMS=1 (Number of Alarms), NUM_OF_BKREGS=0 (Number of Backup Registers), NUM_OF_COMP16=2 (Number of 16-bit Comparators), NUM_OF_COMP32=1 (Number of 32-bit Comparators), NUM_OF_TAMPERS=4 (Number of Tamper Inputs), PER_NUM=8 (Number of Periodic Intervals), INSTANCE_ID=9
SERCOM0 at 0x42000400 (SERCOM)
  pins: PAD0 PA04/D or PA16/D or PA22/C; PAD1 PA05/D or PA17/D or PA23/C; PAD2 PA06/D or PA14/D or PA18/D or PA24/C or PA02/D; PAD3 PA07/D or PA15/D or PA19/D or PA25/C or PA03/D
  parameters: DMAC_ID_RX=4 (Index of DMA RX trigger), DMAC_ID_TX=5 (Index of DMA TX trigger), FIFO_DEPTH_POWER=1 (Rx Fifo depth = 2^FIFO_DEPTH_POWER), GCLK_ID_CORE=11, GCLK_ID_SLOW=10, INT_MSB=6, PMSB=3, SPI=1 (SPI mode implemented?), SPI_TX_READY_INT_SRC=22 (SPI TX READY Interrupt), SPI_TX_COMPLETE_INT_SRC=23 (SPI TX COMPLETE Interrupt), SPI_RX_INT_SRC=24 (SPI RX Interrupt), SPI_ERROR_INT_SRC=25 (SPI ERROR Interrupt), TWIM=1 (TWI Master mode implemented?), TWIS=1 (TWI Slave mode implemented?), TWI_HSMODE=1 (TWI HighSpeed mode implemented?), I2C_0_INT_SRC=22 (I2C 0 Interrupt), I2C_1_INT_SRC=23 (I2C 1 Interrupt), I2C_2_INT_SRC=24 (I2C 2 Interrupt), I2C_3_INT_SRC=25 (I2C 3 Interrupt), USART=1 (USART mode implemented?), USART_AUTOBAUD=0 (USART AUTOBAUD mode implemented?), USART_ISO7816=0 (USART ISO7816 mode implemented?), USART_LIN_MASTER=0 (USART LIN Master mode implemented?), USART_RS485=0 (USART RS485 mode implemented?), USART_TX_READY_INT_SRC=22 (USART TX READY Interrupt), USART_TX_COMPLETE_INT_SRC=23 (USART TX COMPLETE Interrupt), USART_RX_INT_SRC=24 (USART RX Interrupt), USART_ERROR_INT_SRC=25 (USART ERROR Interrupt), INSTANCE_ID=65
SERCOM1 at 0x42000800 (SERCOM)
  pins: PAD0 PA16/C or PA08/C or PA00/D; PAD1 PA17/C or PA09/C or PA01/D; PAD2 PA18/C or PA10/C or PA30/D; PAD3 PA19/C or PA11/C or PA31/D
  parameters: DMAC_ID_RX=6 (Index of DMA RX trigger), DMAC_ID_TX=7 (Index of DMA TX trigger), FIFO_DEPTH_POWER=2 (Rx Fifo depth = 2^FIFO_DEPTH_POWER), GCLK_ID_CORE=12, GCLK_ID_SLOW=10, INT_MSB=6, PMSB=3, SPI=1 (SPI mode implemented?), SPI_TX_READY_INT_SRC=26 (SPI TX READY Interrupt), SPI_TX_COMPLETE_INT_SRC=27 (SPI TX COMPLETE Interrupt), SPI_RX_INT_SRC=28 (SPI RX Interrupt), SPI_ERROR_INT_SRC=29 (SPI ERROR Interrupt), TWIM=1 (TWI Master mode implemented?), TWIS=1 (TWI Slave mode implemented?), TWI_HSMODE=0 (TWI HighSpeed mode implemented?), I2C_0_INT_SRC=26 (I2C 0 Interrupt), I2C_1_INT_SRC=27 (I2C 1 Interrupt), I2C_2_INT_SRC=28 (I2C 2 Interrupt), I2C_3_INT_SRC=29 (I2C 3 Interrupt), USART=1 (USART mode implemented?), USART_AUTOBAUD=0 (USART AUTOBAUD mode implemented?), USART_ISO7816=0 (USART ISO7816 mode implemented?), USART_LIN_MASTER=0 (USART LIN Master mode implemented?), USART_RS485=0 (USART RS485 mode implemented?), USART_TX_READY_INT_SRC=26 (USART TX READY Interrupt), USART_TX_COMPLETE_INT_SRC=27 (USART TX COMPLETE Interrupt), USART_RX_INT_SRC=28 (USART RX Interrupt), USART_ERROR_INT_SRC=29 (USART ERROR Interrupt), INSTANCE_ID=66
SERCOM2 at 0x42000C00 (SERCOM)
  pins: PAD0 PA08/D or PA22/D; PAD1 PA09/D or PA23/D; PAD2 PA10/D or PA24/D or PA14/C; PAD3 PA11/D or PA25/D or PA15/C
  parameters: DMAC_ID_RX=8 (Index of DMA RX trigger), DMAC_ID_TX=9 (Index of DMA TX trigger), FIFO_DEPTH_POWER=1 (Rx Fifo depth = 2^FIFO_DEPTH_POWER), GCLK_ID_CORE=13, GCLK_ID_SLOW=10, INT_MSB=6, PMSB=3, SPI=1 (SPI mode implemented?), SPI_TX_READY_INT_SRC=30 (SPI TX READY Interrupt), SPI_TX_COMPLETE_INT_SRC=31 (SPI TX COMPLETE Interrupt), SPI_RX_INT_SRC=32 (SPI RX Interrupt), SPI_ERROR_INT_SRC=33 (SPI ERROR Interrupt), TWIM=0 (TWI Master mode implemented?), TWIS=0 (TWI Slave mode implemented?), TWI_HSMODE=0 (TWI HighSpeed mode implemented?), I2C_0_INT_SRC=30 (I2C 0 Interrupt), I2C_1_INT_SRC=31 (I2C 1 Interrupt), I2C_2_INT_SRC=32 (I2C 2 Interrupt), I2C_3_INT_SRC=33 (I2C 3 Interrupt), USART=1 (USART mode implemented?), USART_AUTOBAUD=1 (USART AUTOBAUD mode implemented?), USART_ISO7816=1 (USART ISO7816 mode implemented?), USART_LIN_MASTER=0 (USART LIN Master mode implemented?), USART_RS485=1 (USART RS485 mode implemented?), USART_TX_READY_INT_SRC=30 (USART TX READY Interrupt), USART_TX_COMPLETE_INT_SRC=31 (USART TX COMPLETE Interrupt), USART_RX_INT_SRC=32 (USART RX Interrupt), USART_ERROR_INT_SRC=33 (USART ERROR Interrupt), INSTANCE_ID=67
SUPC at 0x40001800
  parameters: BOD33_CALIB_MSB=5, INSTANCE_ID=6, HAS_STDBYPL0_BIT=1 (STDBYPL0 bit is present), HAS_LPEFF_BIT=1 (LPEFF bit is present), HAS_SEL_BIT=1 (SEL bit is present), HAS_BOD33_REG_NAME=1 (Name of BOD register is BOD33), HAS_VREFSEL_BIT=1 (VREFSEL bit is present)
TC0 at 0x42001000 (TC)
  pins: WO0 PA04/E or PA14/E or PA22/E; WO1 PA05/E or PA15/E or PA23/E
  parameters: CC_NUM=2, DMAC_ID_OVF=10 (Indexes of DMA Overflow trigger), DMAC_ID_MC0=11 (Indexes of DMA Match/Compare0 trigger), DMAC_ID_MC1=12 (Indexes of DMA Match/Compare1 trigger), EXT=1 (Coding of implemented extended features (keep 0 value)), GCLK_ID=14 (Index of Generic Clock), MASTER_SLAVE_MODE=1 (TC type 0 : NA, 1 : Master, 2 : Slave), OW_NUM=2 (Number of Output Waveforms), INSTANCE_ID=68
TC1 at 0x42001400 (TC)
  pins: WO0 PA06/E or PA24/E or PA30/E; WO1 PA07/E or PA25/E or PA31/E
  parameters: CC_NUM=2, DMAC_ID_OVF=13 (Indexes of DMA Overflow trigger), DMAC_ID_MC0=14 (Indexes of DMA Match/Compare0 trigger), DMAC_ID_MC1=15 (Indexes of DMA Match/Compare1 trigger), EXT=1 (Coding of implemented extended features (keep 0 value)), GCLK_ID=14 (Index of Generic Clock), MASTER_SLAVE_MODE=2 (TC type 0 : NA, 1 : Master, 2 : Slave), OW_NUM=2 (Number of Output Waveforms), INSTANCE_ID=69
TC2 at 0x42001800 (TC)
  pins: WO0 PA00/E or PA18/E; WO1 PA01/E or PA19/E
  parameters: CC_NUM=2, DMAC_ID_OVF=16 (Indexes of DMA Overflow trigger), DMAC_ID_MC0=17 (Indexes of DMA Match/Compare0 trigger), DMAC_ID_MC1=18 (Indexes of DMA Match/Compare1 trigger), EXT=1 (Coding of implemented extended features (keep 0 value)), GCLK_ID=15 (Index of Generic Clock), MASTER_SLAVE_MODE=0 (TC type 0 : NA, 1 : Master, 2 : Slave), OW_NUM=2 (Number of Output Waveforms), INSTANCE_ID=70
TRAM at 0x42003400
  parameters: INSTANCE_ID=77
TRNG at 0x42002800
  parameters: INSTANCE_ID=74
WDT at 0x40002000
  parameters: INSTANCE_ID=8
CoreDebug at 0xE000EDF0
CoreDebug_NS at 0xE002EDF0 (CoreDebug)
DIB at 0xE000EFB0
DIB_NS at 0xE002EFB0 (DIB)
DWT at 0xE0001000
  parameters: __WPT_NUM=2 (Number of DWT watchpoint comparators)
FPB at 0xE0002000
  parameters: __BKPT_NUM=4 (Number of FPB breakpoint comparators)
ICB at 0xE000E000
ICB_NS at 0xE002E000 (ICB)
MPU at 0xE000ED90
  parameters: __MPU_S_REGIONS=4 (Number of MPU_S regions)
MPU_NS at 0xE002ED90 (MPU)
  parameters: __MPU_NS_REGIONS=4 (Number of MPU_NS regions)
NVIC at 0xE000E100
NVIC_NS at 0xE002E100 (NVIC)
SCB at 0xE000ED00
SCB_NS at 0xE002ED00 (SCB)
SysTick at 0xE000E010
SysTick_NS at 0xE002E010 (SysTick)

## Interrupts
-15 Reset — Reset Vector, invoked on Power up and warm reset
-14 NonMaskableInt — Non maskable Interrupt, cannot be stopped or preempted
-13 HardFault — Hard Fault, all classes of Fault
-5 SVCall — System Service Call via SVC instruction
-2 PendSV — Pendable request for system service
-1 SysTick — System Tick Timer
0 SYSTEM (MCLK OSCCTRL OSC32KCTRL PM SUPC) — System peripherals shared interrupt
1 WDT — Watchdog Timer
2 RTC — Real Time Counter
3 EIC_EXTINT_0 (EIC) — External Channel 0
4 EIC_EXTINT_1 (EIC) — External Channel 1
5 EIC_EXTINT_2 (EIC) — External Channel 2
6 EIC_EXTINT_3 (EIC) — External Channel 3
7 EIC_OTHER (EIC) — External Channel 4/5/6/7
8 FREQM — Frequency Meter
9 NVMCTRL — Non-Volatile Memory Controller
10 PORT — Port Non-Secure Check
11 DMAC_0 (DMAC) — DMA Channel 0
12 DMAC_1 (DMAC) — DMA Channel 1
13 DMAC_2 (DMAC) — DMA Channel 2
14 DMAC_3 (DMAC) — DMA Channel 3
15 DMAC_OTHER (DMAC) — DMA Channel 4..X
16 EVSYS_0 (EVSYS) — Event System Channel 0
17 EVSYS_1 (EVSYS) — Event System Channel 1
18 EVSYS_2 (EVSYS) — Event System Channel 2
19 EVSYS_3 (EVSYS) — Event System Channel 3
20 EVSYS_NSCHK (EVSYS) — Event System Non-Secure Check
21 PAC — Peripheral Access Controller
22 SERCOM0_0 (SERCOM0) — Serial Communication Interface 0
23 SERCOM0_1 (SERCOM0) — Serial Communication Interface 0
24 SERCOM0_2 (SERCOM0) — Serial Communication Interface 0
25 SERCOM0_OTHER (SERCOM0) — Serial Communication Interface 0
26 SERCOM1_0 (SERCOM1) — Serial Communication Interface 1
27 SERCOM1_1 (SERCOM1) — Serial Communication Interface 1
28 SERCOM1_2 (SERCOM1) — Serial Communication Interface 1
29 SERCOM1_OTHER (SERCOM1) — Serial Communication Interface 1
30 SERCOM2_0 (SERCOM2) — Serial Communication Interface 2
31 SERCOM2_1 (SERCOM2) — Serial Communication Interface 2
32 SERCOM2_2 (SERCOM2) — Serial Communication Interface 2
33 SERCOM2_OTHER (SERCOM2) — Serial Communication Interface 2
34 TC0 — Timer Counter 0
35 TC1 — Timer Counter 1
36 TC2 — Timer Counter 2
37 ADC_OTHER (ADC) — Analog To Digital Converter
38 ADC_RESRDY (ADC) — ADC Result Ready
39 AC — Analog Comparator
40 DAC_UNDERRUN_A (DAC) — Digital to Analog Converter
41 DAC_EMPTY (DAC) — DAC Buffer 0 Empty
42 PTC — Peripheral Touch Controller
43 TRNG — True Random Generator
44 TRAM — Trust Ram

## Event generators
1 OSCCTRL_CLKFAIL, 2 OSC32KCTRL_CLKFAIL, 3 SUPC_BOD33DET, {n+4} RTC_PER_{n} (n=0..7), 12 RTC_ALARM_0, 12 RTC_CMP_0, 13 RTC_CMP_1, 14 RTC_TAMPER, 15 RTC_OVF, 16 RTC_PERD, {n+17} EIC_EXTINT_{n} (n=0..7), {n+25} DMAC_CH_{n} (n=0..3), {3n+29} TC{n}_OVF (n=0..2), {3n+30} TC{n}_MC_0 (n=0..2), {3n+31} TC{n}_MC_1 (n=0..2), 38 ADC_RESRDY, 39 ADC_WINMON, 40 AC_COMP_0, 41 AC_COMP_1, 42 AC_WIN_0, 43 DAC_EMPTY, 44 PTC_EOC, 45 PTC_WCOMP, 46 TRNG_DATARDY, 47 CCL_LUT_0, 48 CCL_LUT_1, 49 PAC_ERR

## Event users
0 OSCCTRL_TUNE, 1 RTC_TAMPEVT, 2 NVMCTRL_AUTOW, {n+3} PORT_EV_{n} (n=0..3), {n+7} DMAC_CH_{n} (n=0..3), {n+11} TC{n}_EVU (n=0..2), 14 ADC_START, 15 ADC_FLUSH, 16 AC_SOC_0, 17 AC_SOC_1, 18 DAC_START, 19 PTC_STCONV, 20 PTC_DSEQR, 21 CCL_LUT_0, 22 CCL_LUT_1

## Properties
SIGNATURES: DSU_DID=0x20830000

## Pinouts (pin number, pad)
SAML1xE: 1 PA00, 2 PA01, 3 PA02, 4 PA03, 5 PA04, 6 PA05, 7 PA06, 8 PA07, 9 VDDANA, 10 GND, 11 PA08, 12 PA09, 13 PA10, 14 PA11, 15 PA14, 16 PA15, 17 PA16, 18 PA17, 19 PA18, 20 PA19, 21 PA22, 22 PA23, 23 PA24, 24 PA25, 25 PA27, 26 RESET_N, 27 VDDCORE, 28 GND, 29 VSW, 30 VDDIO, 31 PA30, 32 PA31
SAML1xEU: A2 PA00, A3 PA01, A4 PA02, A5 PA05, B1 VDDIO, B2 PA30, B3 PA03, B4 PA04, B5 PA07, B6 VDDANA, C1 VSW, C2 RESET_N, C3 PA31, C4 PA06, C5 PA10, C6 GNDIO, D1 GNDIO, D2 PA27, D3 PA16, D4 PA08, D5 PA11, D6 PA09, E1 VDDCORE, E2 PA25, E3 PA19, E4 PA18, E5 PA15, E6 PA14, F2 PA24, F3 PA23, F4 PA22, F5 PA17

## Notices in the file
Copyright (c) 2019 Microchip Technology Inc.
SPDX-License-Identifier: Apache-2.0
Licensed under the Apache License, Version 2.0 (the "License");
you may not use this file except in compliance with the License.
You may obtain a copy of the License at
http://www.apache.org/licenses/LICENSE-2.0
Unless required by applicable law or agreed to in writing, software
distributed under the License is distributed on an "AS IS" BASIS,
WITHOUT WARRANTIES OR CONDITIONS OF ANY KIND, either express or implied.
See the License for the specific language governing permissions and
limitations under the License.
