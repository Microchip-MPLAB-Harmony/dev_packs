# PIC32MX460F512L register map
Vendor: Microchip
Architecture 32xxxx. Special function registers and configuration words.
Registers are 32-bit, read-write, reset 0x0 unless marked. A register's access mark holds for its fields unless they carry their own. Addresses are absolute, and some are shared; only a register's first bit layout is shown; lines under a group give offsets from that group; [hi:lo] are bit positions; {n}, {i} and the like mark numbered series; 'fields as' and 'values as' point back to an identical list; <NAME> marks a mode.

## Further device data
pins=1: RG15; 2: VDD; 3: RE5/PMD5; 4: RE6/PMD6; 5: RE7/PMD7; 6: RC1/T2CK; 7: RC2/T3CK; 8: RC3/T4CK; 9: RC4/SDI1/T5CK; 10: RG6/CN8/PMA5/SCK2; 11: RG7/CN9/PMA4/SDI2; 12: RG8/CN10/PMA3/SDO2; 13: MCLR; 14: RG9/CN11/PMA2/SS2; 15: VSS; 16: VDD; 17: RA0/TMS; 18: RE8/INT1; 19: RE9/INT2; 20: RB5/CN7/VBUSON/C1IN+/AN5; 21: RB4/CN6/C1IN-/AN4; 22: RB3/CN5/C2IN+/AN3; 23: RB2/CN4/C2IN-/AN2; 24: RB1/CN3/AN1/PGEC1; 25: RB0/CN2/AN0/PGED1; 26: RB6/OCFA/AN6/PGEC2; 27: RB7/AN7/PGED2; 28: RA9/PMA7/VREF-; 29: RA10/PMA6/VREF+; 30: AVDD; 31: AVSS; 32: RB8/C1OUT/AN8; 33: RB9/C2OUT/AN9; 34: RB10/PMA13/CVREFOUT/AN10; 35: RB11/PMA12/AN11; 36: VSS; 37: VDD; 38: RA1/TCK; 39: RF13/U2RTS; 40: RF12/U2CTS; 41: RB12/PMA11/AN12; 42: RB13/PMA10/AN13; 43: RB14/PMA1/PMALH/AN14; 44: RB15/CN12/PMA0/PMALL/OCFB/AN15; 45: VSS; 46: VDD; 47: RD14/CN20/U1CTS; 48: RD15/CN21/U1RTS; 49: RF4/CN17/PMA9/U2RX; 50: RF5/CN18/PMA8/U2TX; 51: RF3/USBID; 52: RF2/U1RX; 53: RF8/U1TX; 54: VBUS; 55: VUSB3V3; 56: RG3/D-; 57: RG2/D+; 58: RA2/SCL2; 59: RA3/SDA2; 60: RA4/TDI; 61: RA5/TDO; 62: VDD; 63: RC12/CLKI/OSC1; 64: RC15/CLKO/OSC2; 65: VSS; 66: RA14/INT3/SCL1; 67: RA15/INT4/SDA1; 68: RD8/IC1/RTCC; 69: RD9/IC2/SS1; 70: RD10/PMA15/PMCS2/IC3/SCK1; 71: RD11/PMA14/PMCS1/IC4; 72: RD0/INT0/OC1/SDO1; 73: RC13/CN1/SOSCI; 74: RC14/CN0/T1CK/SOSCO; 75: VSS; 76: RD1/OC2; 77: RD2/OC3; 78: RD3/OC4; 79: RD12/PMD12/IC5; 80: RD13/CN19/PMD13; 81: RD4/CN13/PMWR/OC5; 82: RD5/CN14/PMRD; 83: RD6/CN15/PMD14; 84: RD7/CN16/PMD15; 85: VCORE/VCAP; 86: ENVREG; 87: RF0/PMD11; 88: RF1/PMD10; 89: RG1/PMD9; 90: RG0/PMD8; 91: RA6/TRCLK; 92: RA7/TRD3; 93: RE0/PMD0; 94: RE1/PMD1; 95: RG14/TRD2; 96: RG12/TRD1; 97: RG13/TRD0; 98: RE2/PMD2; 99: RE3/PMD3; 100: RE4/PMD4; 101: NC; 102: NC; 103: NC; 104: NC; 105: VSS; 106: NC; 107: NC; 108: VSS; 109: NC; 110: VSS; 111: VSS; 112: NC; 113: VSS; 114: VDD; 115: NC; 116: VDD; 117: NC; 118: NC; 119: NC; 120: NC; 121: VDD, interrupts=0 CORE_TIMER — Core Timer; 1 CORE_SOFTWARE_0 — Core Software 0; 2 CORE_SOFTWARE_1 — Core Software 1; 3 EXTERNAL_0 — Ext INT 0; 7 EXTERNAL_1 — Ext INT 1; 11 EXTERNAL_2 — Ext INT 2; 15 EXTERNAL_3 — Ext INT 3; 19 EXTERNAL_4 — Ext INT 4; 4 TIMER_1 — Timer1; 8 TIMER_2 — Timer2; 12 TIMER_3 — Timer3; 16 TIMER_4 — Timer4; 20 TIMER_5 — Timer5; 26 CHANGE_NOTICE — Change Notice; 5 INPUT_CAPTURE_1 — Input Capture 1; 9 INPUT_CAPTURE_2 — Input Capture 2; 13 INPUT_CAPTURE_3 — Input Capture 3; 17 INPUT_CAPTURE_4 — Input Capture 4; 21 INPUT_CAPTURE_5 — Input Capture 5; 6 OUTPUT_COMPARE_1 — Output Compare 1; 10 OUTPUT_COMPARE_2 — Output Compare 2; 14 OUTPUT_COMPARE_3 — Output Compare 3; 18 OUTPUT_COMPARE_4 — Output Compare 4; 22 OUTPUT_COMPARE_5 — Output Compare 5; 23 SPI_1 — SPI1; 24 UART_1 — UART 1; 25 I2C_1 — I2C 1; 31 SPI_2 — SPI 2; 32 UART_2 — UART 2; 33 I2C_2 — I2C 2; 29 COMPARATOR_1 — Comparator 1; 30 COMPARATOR_2 — Comparator 2; 27 ADC — ADC; 28 PMP — PMP; 34 FAIL_SAFE_MONITOR — Fail Safe Clock Monitor; 35 RTCC — Real Time Clock Calendar; 44 FCE — Flash Control Event; 36 DMA_0 — DMA Channel 0; 37 DMA_1 — DMA Channel 1; 38 DMA_2 — DMA Channel 2; 39 DMA_3 — DMA Channel 3; 45 USB_1 — USB Module 1
