# ATSAMG54N19 device description
Architecture: CORTEX-M4; Family: SAMG; Series: SAMG54
Parameters: __CM4_REV=0x0001 (CM4 Core Revision), __NVIC_PRIO_BITS=4 (Number of Bits used for Priority Levels), __Vendor_SysTickConfig=0 (Set to 1 if different SysTick Config is used), __MPU_PRESENT=1 (MPU present or not), __VTOR_PRESENT=1 (Vector Table Offset Register present or not), __FPU_PRESENT=1 (FPU present or not), LITTLE_ENDIAN=1, __ARCH_ARM=1, __ARCH_ARM_CORTEX_M=1, __DEVICE_IS_SAM=1
Programming and debug interfaces: JTAG, SWD
Registers are 32-bit, read-write, no defined reset value unless marked. A register's access mark holds for its fields unless they carry their own. Offsets are from the block's base; lines under a group give offsets from that group; [hi:lo] are bit positions; {n}, {i} and the like mark numbered series; 'fields as' and 'values as' point back to an identical list; <NAME> marks a mode.

## Ordering variants
ATSAMG54N19-AU: LQFP100, up to 96 MHz, -40 to +105 C, 1.62 to 3.6 V

## Memory
base space: start 0 size 0x100000000, little endian
  0x40000000 PERIPHERALS size 0x20000000 io
  0xE0000000 SYSTEM size 0x10000000 io
  0x00400000 IFLASH size 0x00080000 flash, page 512
  0x00800000 IROM size 0x00400000 rom
  0x20000000 IRAM size 0x00018000 ram
fuses space: start 0 size 1, little endian
lockbits space: start 0 size 0x8, little endian

## Peripheral instances (address, pins/pin function, parameters)
ADC at 0x40038000
  pins: ADTRG PA8/B; AD0 PA17/X1; AD1 PA18/X1; AD2 PA19/X1; AD3 PA20/X1; AD4 PB0/X1; AD5 PB1/X1; AD6 PB2/X1; WKUP12 PB2/X1; AD7 PB3/X1; WKUP13 PB3/X1
  parameters: DMAC_ID_RX=1, INSTANCE_ID=29, CLOCK_ID=29, TRGSEL_ADC_TRIG0=0x0 (External ADC Trigger Input (ADTRG pin)), TRGSEL_ADC_TRIG1=0x1 (TC0 Channel 0 Output (TIOA0)), TRGSEL_ADC_TRIG2=0x2 (TC0 Channel 1 Output (TIOA1)), TRGSEL_ADC_TRIG3=0x3 (TC0 Channel 2 Output (TIOA2)), TRGSEL_ADC_TRIG4=0x4 (RTCOUT0), TRGSEL_ADC_TRIG5=0x5 (RTTINC), SRCCLK_PERIPH_CLK=0x0 (MCK)
CHIPID at 0x400E0740
EFC at 0x400E0A00
  pins: ERASE PB12/X1
  parameters: FLASH_SIZE=524288, PAGE_SIZE=512, PAGES_PR_REGION=16, INSTANCE_ID=6
GPBR at 0x400E1490
ICE
  pins: TDI PB4/X1; TDO PB5/X1; TRACESWO PB5/X1; TMS PB6/X1; SWDIO PB6/X1; TCK PB7/X1; SWDCLK PB7/X1
I2SC0 at 0x40000000 (I2SC)
  pins: I2SC0_CK PA0/A; I2SC0_DI0 PA2/B; I2SC0_DO0 PA3/B or PA17/A; I2SC0_MCK PA4/B or PA18/A; I2SC0_WS PA1/A
  parameters: DMAC_ID_TX0=17, DMAC_ID_TX1=18, DMAC_ID_RX0=2, DMAC_ID_RX1=3, INSTANCE_ID=16, CLOCK_ID=16
I2SC1 at 0x40004000 (I2SC)
  pins: I2SC1_CK PA19/B; I2SC1_DI0 PA22/B; I2SC1_DO0 PA23/A; I2SC1_MCK PA24/A; I2SC1_WS PA20/B
  parameters: DMAC_ID_TX0=19, DMAC_ID_TX1=20, DMAC_ID_RX0=4, DMAC_ID_RX1=5, INSTANCE_ID=17, CLOCK_ID=17
MATRIX at 0x400E0200
MEM2MEM at 0x40028000
  parameters: DMAC_ID_RX=15, DMAC_ID_TX=27, INSTANCE_ID=15, CLOCK_ID=15
PDMIC0 at 0x4002C000 (PDMIC)
  pins: PDMIC0_CLK PA10/B; PDMIC0_DAT PA9/B
  parameters: DMAC_ID_RX=6, INSTANCE_ID=13, CLOCK_ID=13
PDMIC1 at 0x40030000 (PDMIC)
  parameters: DMAC_ID_RX=7, INSTANCE_ID=18, CLOCK_ID=18
PIOA at 0x400E0E00 (PIO)
  pins: P{n} PA{n} (n=0..24)
  parameters: INSTANCE_ID=11, CLOCK_ID=11
PIOB at 0x400E1000 (PIO)
  pins: P{n} PB{n-32} (n=32..44)
  parameters: INSTANCE_ID=12, CLOCK_ID=12
PMC at 0x400E0400
  pins: PCK0 PA6/B; PCK1 PA17/B or PA21/B; PCK2 PA18/B or PB3/B
  parameters: INSTANCE_ID=5, PLLA_MULA_MIN=24, PLLA_MULA_MAX=3000
RSTC at 0x400E1400
  parameters: INSTANCE_ID=1
RTC at 0x400E1460
  parameters: INSTANCE_ID=2
RTT at 0x400E1430
  parameters: INSTANCE_ID=3
SPI at 0x40008000
  pins: MISO PA12/A; MOSI PA13/A; NPCS0 PA11/A; NPCS1 PA5/B or PB2/B; SPCK PA14/A
  parameters: DMAC_ID_RX=13, DMAC_ID_TX=26, INSTANCE_ID=21, CLOCK_ID=21
SUPC at 0x400E1410
  pins: WKUP0 PA0/X1; WKUP1 PA1/X1; WKUP2 PA2/X1; WKUP3 PA23/X1; WKUP4 PA5/X1; WKUP5 PA8/X1; WKUP6 PA9/X1; WKUP7 PA16/X1; WKUP8 PA14/X1; WKUP9 PA21/X1; WKUP10 PA22/X1; WKUP11 PA24/X1; WKUP12 PB2/X1; WKUP13 PB3/X1; WKUP14 PB8/X1; WKUP15 PB9/X1
  parameters: INSTANCE_ID=0
TC0 at 0x40010000 (TC)
  pins: TCLK0 PA2/A; TCLK1 PA19/A; TCLK2 PA20/A; TIOA0 PA0/B; TIOA1 PA23/B; TIOA2 PA21/A; TIOB0 PA1/B; TIOB1 PA16/B; TIOB2 PA22/A
  parameters: DMAC_ID_RX=14, INSTANCE_ID_CHANNEL0=23, INSTANCE_ID_CHANNEL1=24, INSTANCE_ID_CHANNEL2=25, CLOCK_ID_CHANNEL0=23, CLOCK_ID_CHANNEL1=24, CLOCK_ID_CHANNEL2=25, TCCLKS_TIMER_CLOCK1=1 (MCK/2), TCCLKS_TIMER_CLOCK2=2 (MCK/8), TCCLKS_TIMER_CLOCK3=3 (MCK/32), TCCLKS_TIMER_CLOCK4=4 (MCK/128), TCCLKS_TIMER_CLOCK5=5 (SLCK), TCCLKS_XC0=6 (XC0), TCCLKS_XC1=7 (XC1), TCCLKS_XC2=8 (XC2), NUM_INTERRUPT_LINES=3, TIMER_WIDTH=16, QDEC_PRESENT=0
TC1 at 0x40014000 (TC)
  parameters: INSTANCE_ID_CHANNEL0=26, INSTANCE_ID_CHANNEL1=27, INSTANCE_ID_CHANNEL2=28, CLOCK_ID_CHANNEL0=26, CLOCK_ID_CHANNEL1=27, CLOCK_ID_CHANNEL2=28, TCCLKS_TIMER_CLOCK1=1 (MCK/2), TCCLKS_TIMER_CLOCK2=2 (MCK/8), TCCLKS_TIMER_CLOCK3=3 (MCK/32), TCCLKS_TIMER_CLOCK4=4 (MCK/128), TCCLKS_TIMER_CLOCK5=5 (SLCK), TCCLKS_XC0=6 (XC0), TCCLKS_XC1=7 (XC1), TCCLKS_XC2=8 (XC2), NUM_INTERRUPT_LINES=3, TIMER_WIDTH=16, QDEC_PRESENT=0
TWI1 at 0x4001C000 (TWI)
  pins: TWCK1 PB9/A or PB11/A; TWD1 PB8/A or PB10/A
  parameters: DMAC_ID_RX=12, DMAC_ID_TX=25, INSTANCE_ID=20, CLOCK_ID=20
TWI2 at 0x40040000 (TWI)
  pins: TWCK2 PB1/B or PB11/B; TWD2 PB0/B or PB10/B
  parameters: DMAC_ID_RX=11, DMAC_ID_TX=24, INSTANCE_ID=22, CLOCK_ID=22
TWI0 at 0x40018000 (TWIHS)
  pins: TWCK0 PA4/A; TWD0 PA3/A
  parameters: DMAC_ID_RX=0, DMAC_ID_TX=16, INSTANCE_ID=19, CLOCK_ID=19
UART0 at 0x400E0600 (UART)
  pins: URXD0 PA9/A; UTXD0 PA10/A
  parameters: DMAC_ID_RX=10, DMAC_ID_TX=23, INSTANCE_ID=8, CLOCK_ID=8
UART1 at 0x400E0800 (UART)
  pins: URXD1 PB2/A; UTXD1 PB3/A
  parameters: DMAC_ID_RX=9, DMAC_ID_TX=22, INSTANCE_ID=9, CLOCK_ID=9
USART at 0x40024000
  pins: CTS PA16/A; RTS PA15/A; RXD PA5/A; SCK PA15/B; TXD PA6/A
  parameters: DMAC_ID_RX=8, DMAC_ID_TX=21, INSTANCE_ID=14, CLOCK_ID=14, USCLKS_MCK=0 (MCK), USCLKS_DIV=1 (MCK/8), USCLKS_SCK=3 (SCK)
WDT at 0x400E1450
  parameters: INSTANCE_ID=4
FUSES at GPNVMBITS 0 in fuses
LOCKBIT at 0 in lockbits
SystemControl at 0xE000E000
SysTick at 0xE000E010
NVIC at 0xE000E100
MPU at 0xE000ED90

## Interrupts
-15 Reset — Reset Vector, invoked on Power up and warm reset
-14 NonMaskableInt — Non maskable Interrupt, cannot be stopped or preempted
-13 HardFault — Hard Fault, all classes of Fault
-12 MemoryManagement — Memory Management, MPU mismatch, including Access Violation and No Match
-11 BusFault — Bus Fault, Pre-Fetch-, Memory Access Fault, other address/memory related Fault
-10 UsageFault — Usage Fault, i.e. Undef Instruction, Illegal State Transition
-5 SVCall — System Service Call via SVC instruction
-4 DebugMonitor
-2 PendSV — Pendable request for system service
-1 SysTick — System Tick Timer
0 SUPC — Supply Controller
1 RSTC — Reset Controller
2 RTC — Real Time Clock
3 RTT — Real Time Timer
4 WDT — Watchdog Timer
5 PMC — Power Management Controller
6 EFC — Enhanced Flash Controller
8 UART0
9 UART1
11 PIOA — Parallel I/O Controller A
12 PIOB — Parallel I/O Controller B
13 PDMIC0 — PDM 0
14 USART
15 MEM2MEM
16 I2SC0
17 I2SC1
18 PDMIC1 — PDM 1
19 TWI0 — Two Wire Interface 0 HS
20 TWI1 — Two Wire Interface 1
21 SPI — Serial Peripheral Interface
22 TWI2 — Two Wire Interface 2
23 TC0 — Timer/Counter 0
24 TC1 (TC0) — Timer/Counter 1
25 TC2 (TC0) — Timer/Counter 2
26 TC3 (TC1) — Timer/Counter 3
27 TC4 (TC1) — Timer/Counter 4
28 TC5 (TC1) — Timer/Counter 5
29 ADC — Analog To Digital Converter

## Properties
SIGNATURES: JTAGID=0x05B3C03F, CHIPID_CIDR=0x247E0AEA, CHIPID_EXID=0x0
ELECTRICAL_CHARACTERISTICS: CHIP_FREQ_SLCK_RC_MIN=20000, CHIP_FREQ_SLCK_RC=32000 (Typical Slow Clock Internal RC frequency), CHIP_FREQ_SLCK_RC_MAX=44000, CHIP_FREQ_MAINCK_RC_8MHZ=8000000, CHIP_FREQ_MAINCK_RC_16MHZ=16000000, CHIP_FREQ_MAINCK_RC_24MHZ=24000000, CHIP_FREQ_CPU_MAX=96000000, CHIP_FREQ_XTAL_32K=32768, CHIP_FLASH_WRITE_WAIT_STATE=7 (Embedded Flash Write Wait State), CHIP_FREQ_FWS_0=12500000 (Maximum operating frequency when FWS is 0), CHIP_FREQ_FWS_1=25000000 (Maximum operating frequency when FWS is 1), CHIP_FREQ_FWS_2=38000000 (Maximum operating frequency when FWS is 2), CHIP_FREQ_FWS_3=51000000 (Maximum operating frequency when FWS is 3), CHIP_FREQ_FWS_4=64000000 (Maximum operating frequency when FWS is 4), CHIP_FREQ_FWS_5=76000000 (Maximum operating frequency when FWS is 5), CHIP_FREQ_FWS_6=88000000 (Maximum operating frequency when FWS is 6), CHIP_FREQ_FWS_7=96000000 (Maximum operating frequency when FWS is 7), CHIP_FREQ_FWS_NUMBER=8 (Number of FWS ranges)

## Pinouts (pin number, pad)
LQFP100: 11 PA0, 12 PA1, 90 PA2, 10 PA3, 9 PA4, 13 PA5, 28 PA6, 18 PA7, 19 PA8, 79 PA9, 72 PA10, 65 PA11, 64 PA12, 63 PA13, 62 PA14, 31 PA15, 30 PA16, 53 PA17, 54 PA18, 55 PA19, 56 PA20, 36 PA21, 35 PA22, 32 PA23, 86 PA24, 57 PB0, 58 PB1, 59 PB2, 60 PB3, 80 PB5, 84 PB6, 91 PB4, 85 PB7, 87 PB8, 88 PB9, 68 PB10, 69 PB11, 8 PB12, 1 NC, 2 NC, 3 NC, 4 NC, 5 VDDIO, 6 VDDIO, 7 NRST, 14 VDDIO, 15 VDDCORE, 16 VDDCORE, 17 TEST, 20 GND, 21 NC, 22 NC, 23 NC, 24 NC, 25 NC, 26 NC, 27 NC, 29 VDDIO, 33 NC, 34 NC, 37 VDDIO, 38 VDDIO, 39 GND, 40 GND, 41 GND, 42 GND, 43 GND, 44 VDDOUT, 45 VDDOUT, 46 VDDIO, 47 VDDIO, 48 VDDIO, 49 NC, 50 NC, 51 NC, 52 NC, 61 VDDIO, 66 VDDCORE, 67 VDDCORE, 70 GND, 71 GND, 73 NC, 74 NC, 75 NC, 76 NC, 77 NC, 78 NC, 81 GND, 82 GND, 83 GND, 89 VDDIO, 92 NC, 93 JTAGSEL, 94 VDDIO, 95 VDDIO, 96 NC, 97 NC, 98 NC, 99 NC, 100 NC

## Notices in the file
Copyright (c) 2017 Microchip Technology Inc.
SPDX-License-Identifier: Apache-2.0
Licensed under the Apache License, Version 2.0 (the "License");
you may not use this file except in compliance with the License.
You may obtain a copy of the License at
http://www.apache.org/licenses/LICENSE-2.0
Unless required by applicable law or agreed to in writing, software
distributed under the License is distributed on an "AS IS" BASIS,
WITHOUT WARRANTIES OR CONDITIONS OF ANY KIND, either express or implied.
See the License for the specific language governing permissions and
limitations under the License.
