# CEC1734_S0_2ZW register map
Vendor: Microchip Technology; Series: CEC; File version: 0
CPU: CM4 r1p0, little endian, MPU, FPU, 3 interrupt priority bits, 196 interrupts
Registers are 32-bit, read-write, reset 0x0 unless marked. A register's access mark holds for its fields unless they carry their own. Offsets are from the block's base; [hi:lo] are bit positions; {n}, {i} and the like mark numbered series.

## ENV_MON — Environmental Monitor Block
Base 0x40200600; register names take the prefix ENV_MON_
0x00 EXT1_TEMP 16-bit ro — External Diode 1 Temp Register
  [15:0] DIODE1_TEMP — External Diode 1 Temp Byte Register
0x02 INT_TEMP 16-bit ro — Internal Temp Register
  [15:0] INT_TEMP — Internal Temp Byte Register
{0x0+2i} EXT{i}_TEMP 16-bit ro (i=2..4) — External Diode {i} Temp Register
  [15:0] DIODE{i}_TEMP — External Diode {i} Temp Byte Register
0x0E VIN_VOLT 8-bit ro reset 0xFF — Stores the voltage Measured on VIN channel
{0x10+2i} EXT{i}A_TEMP 16-bit ro (i=1..3) — Stores the fractional and integer data for External Diode {i}A Register
  [15:0] DIODE{i}A_TEMP
0x18 EXT4A_TEMP 16-bit ro — Stores the fractional and integer data for External Diode 4A Register
  [15:0] DIODE4A_TEMP — Stores the fractional and integerdata for External Diode 4A Register
0x21 VCP_VOLT 8-bit ro reset 0xFF — Stores the VCP Voltage Monitor data
0x23 VTT_VOLT 8-bit ro reset 0xFF — Stores the VTT Voltage Monitor data
0x2B TEMP_CFG1 8-bit — Controls temp sensing for external diodes
0x2C TEMP_CFG2 8-bit — Controls temp sensing for external diodes
0x2D VOLT_CFG 8-bit — Controls Voltage sensing for external voltages
0x2E THEM_CFG 8-bit — Controls Thermistor or diodes Configuration
0x2F CNVR_CFG 8-bit — Controls Temperature Conversion for the temperature channels
0x30 AVG_EN 8-bit — Software Averaging Enable
0x38 BCOMP1_EN 8-bit — Configure Beta compensation settings for External Diode1
  [7:0] BCOMP1_EN — Beta compensation settings for External Diode1 Enable
0x39 BCOMP2_EN 8-bit reset 0x1F — Configure Beta compensation settings for External Diode2
  [7:0] BCOMP2_EN — Beta compensation settings for External Diode2 Enable
0x40 LCK_STRT 8-bit reset 0x1 — Lock Start Register
  [7:0] BCOMP2_EN — Enables the software lock and monitoring functionality
0x41 FLT_INTSTS 8-bit — Fault Interrupt Status Register
  [7:0] FLT_INTSTS — Stores the status of the External Diode Faults
0x42 FLT_TEMPSTS 8-bit — Fault temperature Status Register
  [7:0] FLT_TEMPSTS — Stores the status of the External Diode Faults
0x43 THRMTRP_STS 8-bit ro — ThermTrip Pin Status Register
  [7:0] THRMTRP_STS — Stores the pin state of the signals that affect the SYS_SHDN_n signal
0x44 INT_TEMP_STS 8-bit — Temperature of Internal Diode Register
  [7:0] TEMP_STS — Stores the status bits for the Internal Diode
0x45 VLT_INTSTS 8-bit — Volt Interrupt Status Register
  [7:0] VLTINTSTS — Stores the status bits for voltage inputs
0x46 VCP_LIMIT 16-bit
  [15:0] VCP_LIMIT — Limit for VCP Voltage Monitor
0x48 VTR_LIMIT 16-bit reset 0xFF00
  [15:0] VTR_LIMIT — Limit for VTR Voltage Monitor
0x4A VTT_LIMIT 16-bit reset 0xFF00
  [15:0] VTT_LIMIT — Limit for VTT Voltage Monitor
0x4C VIN_LIMIT 16-bit reset 0xFF00
  [15:0] VTT_LIMIT — Limit for VIN Voltage Monitor
0x4E EXT1_TMPLO_LMT 8-bit reset 0x81 — Low limit for External Diode 1 Register
  [7:0] TMPLO1_LIMIT
0x4F EXT1_TMPHI_LMT 8-bit reset 0x7F — High limit for External Diode 1 Register
  [7:0] TMPHI1_LIMIT
0x50 INT_TMPLO_LMT 8-bit reset 0x81 — Low limit for Internal Diode Register
  [7:0] TMPLO_LIMIT
0x51 INT_TMPHI_LMT 8-bit reset 0x7F — High limit for Internal Diode Register
  [7:0] TMPHI_LIMIT — High limit for internal Diode Register
{0x4E+2i} EXT{i}_TMPLO_LMT 8-bit reset 0x81 (i=2..4) — Low limit for External Diode {i} Register
  [7:0] TMPLO{i}_LIMIT
{0x4F+2i} EXT{i}_TMPHI_LMT 8-bit reset 0x7F (i=2..4) — High limit for External Diode {i} Register
  [7:0] TMPHI{i}_LIMIT
{0x56+2i} EXT{i}A_TMPLO_LMT 8-bit reset 0x81 (i=1..4) — Low limit for External Diode {i}A Register
  [7:0] TMPLO{i}A_LIMIT
{0x57+2i} EXT{i}A_TMPHI_LMT 8-bit reset 0x7F (i=1..4) — High limit for External Diode {i}A Register
  [7:0] TMPHI{i}A_LIMIT
0x64 BCOMP3_EN 8-bit reset 0x1F — External Diode3 Beta compensation Register
  [7:0] BCOMP3_EN — Beta compensation settings for External Diode3 Enable
0x65 BCOMP4_EN 8-bit reset 0x1F — External Diode4 Beta compensation Register
  [7:0] BCOMP4_EN — Beta compensation settings for External Diode4 Enable
0x67 BCOMP_INTD_EN 8-bit reset 0xE — Internal Diode Beta compensation Register
  [7:0] BCOMP4_EN — Beta compensation settings for internal Diode1 Enable
0x6C CONV_SRATE 8-bit — Conversion Seconds Rate Register
0x6E CONV_MOD 8-bit — Conversion Mode Register
0x70 REC_EN 8-bit reset 0xFF — REC Enable Register
  [7:0] REC_EN — Enables REC for all external diode channels
0x71 VSET_VLT 8-bit ro reset 0xFF — VSET Voltage Reading Register
  [7:0] VSET_VLT — Stores the VSET Voltage Monitor reading
0x75 THERM1 8-bit ro reset 0x7F — Thermal Trip Temperature Diode 1 Register
  [7:0] THERM1 — Stores the calculated ThermTrip temperature high limit derived from the voltage on VSET and compared against External Diode 1.
0x76 FLSF_STS 8-bit ro — FailSafe Status Register
  [7:0] FLSF_STS — Stores the status indicate which ThermTrip input condition caused the SYS_SHDN# pin to be asserted.
0x77 FLSF_CFG 8-bit — FailSafe Configuration Register
  [7:0] FLSF_CFG — Stores configuration bits that are retained over all power modes
0x78 SHDN_STS 8-bit ro — Shutdown Status Register
  [7:0] SHDN_STS — Stores the status bits that indicate which diode caused the SYS_SHDN# output to assert.
0x79 SHDN_CFG 8-bit reset 0x1 — Shutdown Configuration Register
  [7:0] SHDN_CFG — Stores configuration bits that are retained over all power modes
0x7A FLT_INTSTS_EN 8-bit reset 0x1 — Fault Interrupt Status Enable Register
  [7:0] FLT_INTSTS_EN — Controls whether the External Diode Fault events generates interrupt if the associated status bit is 1.
0x7B TMP_INTSTS 8-bit — Temp Interrupt Status Enable Register
  [7:0] TMP_INTSTS — Controls whether the External Diode events generate an interrupt if the associated status bit is set.
0x7C SPCL_FN 8-bit — Special Function Register
  [7:0] TMP_INTSTS — Controls the bit that resets the FailSafe Status Register
0x7D INTTMP_INTEN 8-bit — Int Temp Interrupt Status Enable Register
  [7:0] INTTMP_INTEN — Controls whether the Internal Diode event generate an interrupt if the associated status bit is set.
0x7E VLT_INTEN 8-bit — Volt Interrupt Status Enable Register
  [7:0] VLT_INTEN — Controls whether the Voltage event generate an interrupt if the associated status bit is set.
{0x7E+i} THRMTRP_TMP{i} 8-bit reset 0x7F (i=2..4) — Thermal Trip Temperature Diode {i} Register
  [7:0] THRMTRP_TMP{i} — ThermTrip temperature high limit compared against External Diode {i}
{0x82+i} THRMTRP_TMP{i}A 8-bit reset 0x7F (i=1..4) — Thermal Trip Temperature Diode {i}A Register
  [7:0] THRMTRP_TMP{i}A — ThermTrip temperature high limit compared against External Diode {i}A
{0x87+i} ADJ_CH{i} 8-bit (i=1..4) — Adjusted Channel {i} Register
  [7:0] ADJ_CH{i} — Contain EMC IP Trim Adjust values for External Channel {i}
{0x8B+i} ADJ_CH{i}A 8-bit (i=1..4) — Adjusted Channel {i}A Register
  [7:0] ADJ_CH{i}A — Contain EMC IP Trim Adjust values for External Channel {i}A
0xFC UNLCK 8-bit ro — Unlock Register
0x400 SYS_SHDN_RST 8-bit ro — System Shutdown Reset Register
  [7:0] SYS_SHDN_RST — Used to de-assert the SYS_SHDN# signal Register
