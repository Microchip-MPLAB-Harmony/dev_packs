# ATSAMRH71F20C device description
Architecture: CORTEX-M7; Family: SAMRH; Series: SAMRH71
Parameters: __CM7_REV=0x0101 (CM7 Core Revision), __NVIC_PRIO_BITS=3 (Number of Bits used for Priority Levels), __Vendor_SysTickConfig=0 (Set to 1 if different SysTick Config is used), __MPU_PRESENT=1 (MPU present or not), __VTOR_PRESENT=1 (Vector Table Offset Register present or not), __FPU_PRESENT=1 (FPU present or not), __FPU_DP=1 (Double Precision FPU), __ICACHE_PRESENT=1 (Instruction Cache present), __DCACHE_PRESENT=1 (Data Cache present), __ITCM_PRESENT=1 (Instruction TCM present), __DTCM_PRESENT=1 (Data TCM present), __DEBUG_LVL=1, __TRACE_LVL=1, LITTLE_ENDIAN=1, __ARCH_ARM=1, __ARCH_ARM_CORTEX_M=1
Programming and debug interfaces: JTAG, SWD
Registers are 32-bit, read-write, no defined reset value unless marked. A register's access mark holds for its fields unless they carry their own. Offsets are from the block's base; lines under a group give offsets from that group; [hi:lo] are bit positions; {n}, {i} and the like mark numbered series; 'fields as' and 'values as' point back to an identical list; <NAME> marks a mode.

## Ordering variants
ATSAMRH71F20C-7GB-E: CQFP256, up to 100 MHz, +25 to +25 C, 1.62 to 3.6 V
ATSAMRH71F20C-7GB-MQ, ATSAMRH71F20C-7GB-SV: CQFP256, up to 100 MHz, -55 to +125 C, 1.62 to 3.6 V

## Memory
base space: start 0 size 0x100000000, little endian
  0x40000000 PERIPHERALS size 0x20000000 io, rw
  0xE0000000 SYSTEM size 0x10000000 io, rw
  0x18000000 QSPIMEM size 0x08000000 other, rw, executable
  0x22000000 AXIMX size 0x00100000 other, rw
  0x00000000 ITCM size 0x00020000 other, rw, executable
  0x10000000 IFLASH size 0x00020000 flash, rw, executable, page 256
  0x20000000 DTCM size 0x00040000 other, rw, executable
  0x21000000 FlexRAM size 0x000C0000 ram, rw, executable
  0x60000000 EBI_CSHEMC size 0x80000000 other, rw, executable
fuses space: start 0 size 0x10, little endian
lockbits space: start 0 size 0x4, little endian

## Peripheral instances (address, pins/pin function, parameters)
CHIPID at 0x40100000
FLEXCOM0 at 0x40010000 (FLEXCOM)
  pins: FLEXCOM0_IO{n} PC{n+21}/A (n=0..7)
  parameters: DMAC_ID_TX=0, DMAC_ID_RX=1, INSTANCE_ID=7, CLOCK_ID=7, USART_FIFO_SIZE=16, SPI_FIFO_SIZE=8, TWI_FIFO_SIZE=8
FLEXCOM1 at 0x40014000 (FLEXCOM)
  pins: FLEXCOM1_IO0 PF30/A; FLEXCOM1_IO1 PF29/A; FLEXCOM1_IO2 PF28/A; FLEXCOM1_IO3 PF27/A; FLEXCOM1_IO4 PF26/A
  parameters: DMAC_ID_TX=2, DMAC_ID_RX=3, INSTANCE_ID=8, CLOCK_ID=8, USART_FIFO_SIZE=16, SPI_FIFO_SIZE=8, TWI_FIFO_SIZE=8
FLEXCOM2 at 0x40018000 (FLEXCOM)
  pins: FLEXCOM2_IO0 PA2/A; FLEXCOM2_IO1 PA6/A; FLEXCOM2_IO2 PA8/A; FLEXCOM2_IO3 PA7/A; FLEXCOM2_IO4 PA3/A
  parameters: DMAC_ID_TX=4, DMAC_ID_RX=5, INSTANCE_ID=13, CLOCK_ID=13, USART_FIFO_SIZE=16, SPI_FIFO_SIZE=8, TWI_FIFO_SIZE=8
FLEXCOM3 at 0x4001C000 (FLEXCOM)
  pins: FLEXCOM3_IO0 PA20/A; FLEXCOM3_IO1 PA19/A; FLEXCOM3_IO2 PA23/A; FLEXCOM3_IO3 PA24/A; FLEXCOM3_IO4 PA21/A; FLEXCOM3_IO5 PA22/A; FLEXCOM3_IO6 PA12/A
  parameters: DMAC_ID_TX=6, DMAC_ID_RX=7, INSTANCE_ID=14, CLOCK_ID=14, USART_FIFO_SIZE=16, SPI_FIFO_SIZE=8, TWI_FIFO_SIZE=8
FLEXCOM4 at 0x40020000 (FLEXCOM)
  pins: FLEXCOM4_IO0 PC0/A; FLEXCOM4_IO1 PC1/A; FLEXCOM4_IO2 PC2/A; FLEXCOM4_IO3 PC3/A; FLEXCOM4_IO4 PC4/A; FLEXCOM4_IO5 PC5/A; FLEXCOM4_IO6 PC6/A
  parameters: DMAC_ID_TX=8, DMAC_ID_RX=9, INSTANCE_ID=15, CLOCK_ID=15, USART_FIFO_SIZE=16, SPI_FIFO_SIZE=8, TWI_FIFO_SIZE=8
FLEXCOM5 at 0x40024000 (FLEXCOM)
  pins: FLEXCOM5_IO0 PC9/A; FLEXCOM5_IO1 PC10/A; FLEXCOM5_IO2 PA9/A; FLEXCOM5_IO3 PA10/A; FLEXCOM5_IO4 PA11/A
  parameters: DMAC_ID_TX=10, DMAC_ID_RX=11, INSTANCE_ID=22, CLOCK_ID=22, USART_FIFO_SIZE=16, SPI_FIFO_SIZE=8, TWI_FIFO_SIZE=8
FLEXCOM6 at 0x40028000 (FLEXCOM)
  pins: FLEXCOM6_IO0 PB6/A; FLEXCOM6_IO1 PB7/A
  parameters: DMAC_ID_TX=12, DMAC_ID_RX=13, INSTANCE_ID=23, CLOCK_ID=23, USART_FIFO_SIZE=16, TWI_FIFO_SIZE=8
FLEXCOM7 at 0x4002C000 (FLEXCOM)
  pins: FLEXCOM7_IO0 PB4/A; FLEXCOM7_IO1 PB5/A
  parameters: DMAC_ID_TX=14, DMAC_ID_RX=15, INSTANCE_ID=24, CLOCK_ID=24, USART_FIFO_SIZE=16, TWI_FIFO_SIZE=8
FLEXCOM8 at 0x40030000 (FLEXCOM)
  pins: FLEXCOM8_IO0 PA27/A; FLEXCOM8_IO1 PA28/A
  parameters: DMAC_ID_TX=16, DMAC_ID_RX=17, INSTANCE_ID=45, CLOCK_ID=45, USART_FIFO_SIZE=16, TWI_FIFO_SIZE=8
FLEXCOM9 at 0x40034000 (FLEXCOM)
  pins: FLEXCOM9_IO0 PA25/A; FLEXCOM9_IO1 PA26/A
  parameters: DMAC_ID_TX=18, DMAC_ID_RX=19, INSTANCE_ID=46, CLOCK_ID=46, USART_FIFO_SIZE=16, TWI_FIFO_SIZE=8
FLEXRAMECC at 0x40100600
GMAC at 0x4009C000
  pins: GCOL PC26/B; GCRS PC27/B; GMDC PC20/B; GMDIO PC19/B; GRXCK PC28/B; GRXDV PC16/B; GRXER PC15/B; GRX0 PC12/B; GRX1 PC11/B; GRX2 PC30/B; GRX3 PC29/B; GTSUCOMP PC31/B; GTXCK PC18/B; GTXEN PC17/B; GTXER PC23/B; GTX0 PC14/B; GTX1 PC13/B; GTX2 PC24/B; GTX3 PC25/B
  parameters: INSTANCE_ID=69, CLOCK_ID=69
HEFC at 0x40004000
  parameters: FLASH_SIZE=131072, PAGE_SIZE=256, INSTANCE_ID=50, CLOCK_ID=50, PAGES_PR_REGION=512
HEMC at 0x40080000
  pins: A{n} PG{n}/A (n=0..27); BA0 PG15/A; BA1 PG16/A; BOOT_MODE PF24/X1; CAS PF10/A; CB{n} PE{n}/A (n=0..12); CB13 PC31/A; CB14 PC30/A; CB15 PC29/A; CFG0 PG24/X1; CFG1 PG25/X1; CFG2 PG26/X1; CFG3 PG27/X1; D{n} PD{n}/A (n=0..31); EXT_CTRL_BUFFER PF25/A; NCS0 PF11/A; NCS1 PF12/A; NCS2 PF13/A; NCS3 PF14/A; NCS4 PF15/A; NCS5 PF16/A; NRD PF17/A; NWAIT PF24/A; NWE PF18/A; NWR0 PF19/A; NWR1 PF20/A; NWR2 PF21/A; NWR3 PF22/A; NWR4 PF23/A; RAS PF0/A; SDA10 PF1/A; SDCK PF2/A; SDCKE PF3/A; SDNBS0 PF4/A; SDNBS1 PF5/A; SDNBS2 PF6/A; SDNBS3 PF7/A; SDNBS4 PF8/A; SDWE PF9/A
  parameters: CLOCK_ID=59
HSDRAMC at 0x40082000
HSMC at 0x40081000
ICM at 0x4008C000
  parameters: INSTANCE_ID=33, CLOCK_ID=33
IP1553 at 0x4003C000
  parameters: INSTANCE_ID=68, CLOCK_ID=68
MATRIX0 at 0x40000000 (MATRIX)
  parameters: INSTANCE_ID=6
MCAN0 at 0x40058000 (MCAN)
  pins: CANRX0 PB7/C or PE8/C; CANTX0 PB6/C or PE9/C
  parameters: INSTANCE_ID=36, CLOCK_ID=36, ID_MCAN0_INT0=36, ID_MCAN0_INT1=37
MCAN1 at 0x4005C000 (MCAN)
  pins: CANRX1 PB5/C or PE10/C; CANTX1 PB4/C or PE11/C
  parameters: INSTANCE_ID=38, CLOCK_ID=38, ID_MCAN1_INT0=38, ID_MCAN1_INT1=39
NMIC at 0x400A8000
  parameters: INSTANCE_ID=9, CLOCK_ID=9, NUM_NMIC_SOURCE=9, NMIC_SOURCE_NMI=0 (External Pin NMI), NMIC_SOURCE_CPU_FAIL=1 (Wrong CPU Frequency Monitor Detection), NMIC_SOURCE_XTAL_12M_FAIL=2 (Fast XTAL Clock Failure Detection), NMIC_SOURCE_XTAL_32K_FAIL=3 (Slow XTAL 32KHZ Clock Failure Detection), NMIC_SOURCE_VDDCORE_FAIL=4 (VDDCORE Failure Detection), NMIC_SOURCE_NOFIX_TCM=5 (TCM non fixable error Detection), NMIC_SOURCE_NOFIX_HEMC=6 (HEMC non fixable error detection), NMIC_SOURCE_NOFIX_HEFC=7 (HEFC non fixable error detection), NMIC_SOURCE_NOFIX_FLEXRAM=8 (FlexRAM non fixable error detection), NMIC_READ_ONLY_GLFEN=0 (NMIC Glitch filter is read only)
PIO at 0x40008000
  pins: P{n} PA{n} (n=0..13); P16 PA16; P17 PA17; P{n} PA{n} (n=19..28); P{n} PB{n-32} (n=32..61); P{n} PC{n-64} (n=64..95); P{n} PD{n-96} (n=96..127); P{n} PE{n-128} (n=128..140); P{n} PF{n-160} (n=160..190); P{n} PG{n-192} (n=192..219); P222 PG30; P223 PG31
  parameters: CLOCK_ID=10, DEBOUNCE_GLITCH_ACTIVE=1
PIOA
  parameters: INSTANCE_ID=10
PIOB
  parameters: INSTANCE_ID=11
PIOC
  parameters: INSTANCE_ID=12
PIOD
  parameters: INSTANCE_ID=16
PIOE
  parameters: INSTANCE_ID=17
PIOF
  parameters: INSTANCE_ID=34
PIOG
  parameters: INSTANCE_ID=35
PMC at 0x4000C000
  pins: PCK0 PA11/B or PC7/A; PCK1 PC8/A or PE12/B; PCK2 PA10/B
  parameters: INSTANCE_ID=5
PWM0 at 0x40068000 (PWM)
  pins: PWMC0_PWMEXTRG0 PA10/C; PWMC0_PWMEXTRG1 PA11/C; PWMC0_PWMFI0 PA8/C; PWMC0_PWMFI1 PA9/C; PWMC0_PWMFI2 PA12/C; PWMC0_PWMH0 PA0/C; PWMC0_PWMH1 PA1/C; PWMC0_PWMH2 PA2/C; PWMC0_PWMH3 PA3/C; PWMC0_PWML0 PA4/C; PWMC0_PWML1 PA5/C; PWMC0_PWML2 PA6/C; PWMC0_PWML3 PA7/C
  parameters: DMAC_ID_TX=22, INSTANCE_ID=31, CLOCK_ID=31, FAULT_PWM_ID0=0x0 (Fault 0 - PWM0_PWMFI0 Input pin), FAULT_PWM_ID1=0x1 (Fault 1 - PWM0_PWMFI1 Input pin), FAULT_PWM_ID2=0x2 (Fault 2 - PWM0_PWMFI2 Input pin), FAULT_PWM_ID3=0x3 (Fault 3 - MAIN_OSC_PMC), FAULT_PWM_ID6=0x6 (Fault 6 - TC0)
PWM1 at 0x4006C000 (PWM)
  pins: PWMC1_PWMEXTRG0 PB17/A; PWMC1_PWMEXTRG1 PB18/A; PWMC1_PWMFI0 PB27/A; PWMC1_PWMFI1 PB28/A; PWMC1_PWMFI2 PB29/A; PWMC1_PWMH0 PB19/A; PWMC1_PWMH1 PB20/A; PWMC1_PWMH2 PB21/A; PWMC1_PWMH3 PB22/A; PWMC1_PWML0 PB23/A; PWMC1_PWML1 PB24/A; PWMC1_PWML2 PB25/A; PWMC1_PWML3 PB26/A
  parameters: DMAC_ID_TX=23, INSTANCE_ID=32, CLOCK_ID=32, FAULT_PWM_ID0=0x0 (Fault 0 - PWM1_PWMFI0 Input pin), FAULT_PWM_ID1=0x1 (Fault 1 - PWM1_PWMFI1 Input pin), FAULT_PWM_ID2=0x2 (Fault 2 - PWM1_PWMFI2 Input pin), FAULT_PWM_ID3=0x3 (Fault 3 - MAIN_OSC_PMC), FAULT_PWM_ID6=0x6 (Fault 6 - TC0)
QSPI at 0x40038000
  pins: QCS PA22/C; QIO0 PA24/C; QIO1 PA23/C; QIO2 PA20/C; QIO3 PA19/C; QSCK PA21/C
  parameters: DMAC_ID_TX=20, DMAC_ID_RX=21, INSTANCE_ID=49, CLOCK_ID=49
RSTC at 0x40100200
  parameters: INSTANCE_ID=1
RSWDT at 0x40100300
  parameters: INSTANCE_ID=47
RTC at 0x40100260
  pins: RTCOUT0 PG30/A; RTCOUT1 PG31/A
  parameters: INSTANCE_ID=2
RTT at 0x40100230
  parameters: INSTANCE_ID=3
SFR at 0x400A0000
SHA at 0x40094000
  parameters: DMAC_ID_TX=28, INSTANCE_ID=44, CLOCK_ID=44
SPW at 0x40040000
  parameters: INSTANCE_ID_SPW=65, INSTANCE_ID_SPW_TIMETICK=66, CLOCK_ID_SPWCLK=65, CLOCK_ID_TIMETICK=66
SUPC at 0x40100210
  parameters: INSTANCE_ID=0
TC0 at 0x40070000 (TC)
  pins: TCLK0 PA0/B; TCLK1 PA3/B; TCLK2 PA6/B; TIOA0 PA1/B; TIOA1 PA4/B; TIOA2 PA7/B; TIOB0 PA2/B; TIOB1 PA5/B; TIOB2 PA8/B
  parameters: DMAC_ID_RX=24, DMAC_ID_CPA=29, DMAC_ID_CPB=33, DMAC_ID_CPC=37, DMAC_ID_ETRG=41, INSTANCE_ID_CHANNEL0=25, INSTANCE_ID_CHANNEL1=26, INSTANCE_ID_CHANNEL2=27, CLOCK_ID_CHANNEL0=25, CLOCK_ID_CHANNEL1=26, CLOCK_ID_CHANNEL2=27, TCCLKS_=0 (MCK), TCCLKS_TIMER_CLOCK1=1 (GCLK), TCCLKS_TIMER_CLOCK2=2 (MCK/8), TCCLKS_TIMER_CLOCK3=3 (MCK/32), TCCLKS_TIMER_CLOCK4=4 (MCK/128), TCCLKS_TIMER_CLOCK5=5 (SLCK), TCCLKS_XC0=6 (XC0), TCCLKS_XC1=7 (XC1), TCCLKS_XC2=8 (XC2), NUM_INTERRUPT_LINES=3, TIMER_WIDTH=32
TC1 at 0x40074000 (TC)
  pins: TCLK3 PB8/A; TCLK4 PB11/A; TCLK5 PB14/A; TIOA3 PB9/A; TIOA4 PB12/A; TIOA5 PB15/A; TIOB3 PB10/A; TIOB4 PB13/A; TIOB5 PB16/A
  parameters: DMAC_ID_RX=25, DMAC_ID_CPA=30, DMAC_ID_CPB=34, DMAC_ID_CPC=38, DMAC_ID_ETRG=42, INSTANCE_ID_CHANNEL0=28, INSTANCE_ID_CHANNEL1=29, INSTANCE_ID_CHANNEL2=30, CLOCK_ID_CHANNEL0=28, CLOCK_ID_CHANNEL1=29, CLOCK_ID_CHANNEL2=30, TCCLKS_=0 (MCK), TCCLKS_TIMER_CLOCK1=1 (GCLK), TCCLKS_TIMER_CLOCK2=2 (MCK/8), TCCLKS_TIMER_CLOCK3=3 (MCK/32), TCCLKS_TIMER_CLOCK4=4 (MCK/128), TCCLKS_TIMER_CLOCK5=5 (SLCK), TCCLKS_XC0=6 (XC0), TCCLKS_XC1=7 (XC1), TCCLKS_XC2=8 (XC2), NUM_INTERRUPT_LINES=3, TIMER_WIDTH=32
TC2 at 0x40078000 (TC)
  pins: TCLK6 PC11/A; TCLK7 PC14/A; TCLK8 PC17/A; TIOA6 PC12/A; TIOA7 PC15/A; TIOA8 PC18/A; TIOB6 PC13/A; TIOB7 PC16/A; TIOB8 PC19/A
  parameters: DMAC_ID_RX=26, DMAC_ID_CPA=31, DMAC_ID_CPB=35, DMAC_ID_CPC=39, DMAC_ID_ETRG=43, INSTANCE_ID_CHANNEL0=53, INSTANCE_ID_CHANNEL1=54, INSTANCE_ID_CHANNEL2=55, CLOCK_ID_CHANNEL0=53, CLOCK_ID_CHANNEL1=54, CLOCK_ID_CHANNEL2=55, TCCLKS_=0 (MCK), TCCLKS_TIMER_CLOCK1=1 (GCLK), TCCLKS_TIMER_CLOCK2=2 (MCK/8), TCCLKS_TIMER_CLOCK3=3 (MCK/32), TCCLKS_TIMER_CLOCK4=4 (MCK/128), TCCLKS_TIMER_CLOCK5=5 (SLCK), TCCLKS_XC0=6 (XC0), TCCLKS_XC1=7 (XC1), TCCLKS_XC2=8 (XC2), NUM_INTERRUPT_LINES=3, TIMER_WIDTH=32
TC3 at 0x4007C000 (TC)
  pins: TCLK9 PC21/D; TCLK10 PC28/D; TCLK11 PC25/D; TIOA9 PC22/D; TIOA10 PC29/D; TIOA11 PC26/D; TIOB9 PC24/D; TIOB10 PC30/D; TIOB11 PC27/D
  parameters: DMAC_ID_RX=27, DMAC_ID_CPA=32, DMAC_ID_CPB=36, DMAC_ID_CPC=40, DMAC_ID_ETRG=44, INSTANCE_ID_CHANNEL0=56, INSTANCE_ID_CHANNEL1=57, INSTANCE_ID_CHANNEL2=58, CLOCK_ID_CHANNEL0=56, CLOCK_ID_CHANNEL1=57, CLOCK_ID_CHANNEL2=58, TCCLKS_=0 (MCK), TCCLKS_TIMER_CLOCK1=1 (GCLK), TCCLKS_TIMER_CLOCK2=2 (MCK/8), TCCLKS_TIMER_CLOCK3=3 (MCK/32), TCCLKS_TIMER_CLOCK4=4 (MCK/128), TCCLKS_TIMER_CLOCK5=5 (SLCK), TCCLKS_XC0=6 (XC0), TCCLKS_XC1=7 (XC1), TCCLKS_XC2=8 (XC2), NUM_INTERRUPT_LINES=3, TIMER_WIDTH=32
TCMECC at 0x40100400
TRNG at 0x40090000
  parameters: INSTANCE_ID=63, CLOCK_ID=63
WDT at 0x40100250
  parameters: INSTANCE_ID=4
XDMAC at 0x40098000
  parameters: INSTANCE_ID=64, CLOCK_ID=64
FUSES at GPNVMBITS 0 in fuses
LOCKBIT at 0 in lockbits
SCnSCB at 0xE000E000
SCB at 0xE000ED00
SysTick at 0xE000E010
NVIC at 0xE000E100
MPU at 0xE000ED90
FPU at 0xE000EF30

## Interrupts
-15 Reset — Reset Vector, invoked on Power up and warm reset
-14 NonMaskableInt — Non maskable Interrupt, cannot be stopped or preempted
-13 HardFault — Hard Fault, all classes of Fault
-12 MemoryManagement — Memory Management, MPU mismatch, including Access Violation and No Match
-11 BusFault — Bus Fault, Pre-Fetch-, Memory Access Fault, other address/memory related Fault
-10 UsageFault — Usage Fault, i.e. Undef Instruction, Illegal State Transition
-5 SVCall — System Service Call via SVC instruction
-4 DebugMonitor
-2 PendSV — Pendable request for system service
-1 SysTick — System Tick Timer
0 SUPC — Supply Controller
1 RSTC — Reset Controller
2 RTC — Real Time Clock
3 RTT — Real Time Timer
4 WDT — Watchdog Timer 0
5 PMC — Power Management Controller
6 MATRIX0
7 FLEXCOM0
8 FLEXCOM1
9 NMIC — NMI Controller
10 PIOA — Parallel I/O Controller A
11 PIOB — Parallel I/O Controller B
12 PIOC — Parallel I/O Controller C
13 FLEXCOM2
14 FLEXCOM3
15 FLEXCOM4
16 PIOD — Parallel I/O Controller D
17 PIOE — Parallel I/O Controller E
18 CCW (SCB) — Cache ECC Warning
19 CCF (SCB) — Cache ECC Fault
20 FPU — Floating Point Unit
21 IXC (FPU) — Floating Point Unit IXC
22 FLEXCOM5
23 FLEXCOM6
24 FLEXCOM7
25 TC0 — Timer/Counter 0
26 TC1 (TC0) — Timer/Counter 1
27 TC2 (TC0) — Timer/Counter 2
28 TC3 (TC1) — Timer/Counter 3
29 TC4 (TC1) — Timer/Counter 4
30 TC5 (TC1) — Timer/Counter 5
31 PWM0 — Pulse Width Modulation 0
32 PWM1 — Pulse Width Modulation 1
33 ICM — Integrity Check Monitor
34 PIOF — Parallel I/O Controller F
35 PIOG — Parallel I/O Controller G
36 MCAN0_INT0 (MCAN0) — MCAN Controller 0 Interrupt 0
37 MCAN0_INT1 (MCAN0) — MCAN Controller 0 Interrupt 1
38 MCAN1_INT0 (MCAN1) — MCAN Controller 1 Interrupt 0
39 MCAN1_INT1 (MCAN1) — MCAN Controller 1 Interrupt 1
40 TCMECC_INTFIX (TCMECC) — TCM ECC Fixable error detected
41 TCMECC_INTNOFIX (TCMECC) — TCM ECC Un-Fixable error detected
42 FLEXRAMECC_INTFIX (FLEXRAMECC) — FlexRAM ECC Fixable error detected
43 FLEXRAMECC_INTNOFIX (FLEXRAMECC) — FlexRAM ECC Un-Fixable error detected
44 SHA — Secure Hash Algorithm
45 FLEXCOM8
46 FLEXCOM9
47 RSWDT — Reinforced Secure Watchdog Timer
49 QSPI — Quad I/O Serial Peripheral Interface
50 HEFC_INT0 (HEFC) — HEFC Flash Interrupts
51 HEFC_INTFIX (HEFC) — HEFC ECC Fixable error detected
52 HEFC_INTNOFIX (HEFC) — HEFC ECC Un-Fixable error detected
53 TC6 (TC2) — Timer/Counter 6
54 TC7 (TC2) — Timer/Counter 7
55 TC8 (TC2) — Timer/Counter 8
56 TC9 (TC3) — Timer/Counter 9
57 TC10 (TC3) — Timer/Counter 10
58 TC11 (TC3) — Timer/Counter 11
59 HEMC_INTSDRAMC (HEMC) — HEMC SDRAM Controller
60 HEMC_INTFIX (HEMC) — HEMC ECC Fixable error detected
61 HEMC_INTNOFIX (HEMC) — HEMC ECC Un-Fixable error detected
62 SFR
63 TRNG — True Random Generator
64 XDMAC — eXtended DMA Controller
65 SPW — SpaceWire
68 IP1553 — MIL 1553
69 GMAC — Ethernet MAC
70 GMAC_Q1 (GMAC) — GMAC Queue 1
71 GMAC_Q2 (GMAC) — GMAC Queue 2
72 GMAC_Q3 (GMAC) — GMAC Queue 3
73 GMAC_Q4 (GMAC) — GMAC Queue 4
74 GMAC_Q5 (GMAC) — GMAC Queue 5

## Properties
SIGNATURES: JTAGID=0x05D0503F, CHIPID_CIDR=0xA22F0700, CHIPID_EXID=0x00000001

## Pinouts (pin number, pad)
CQFP256: 1 GNDCORE, 2 VDDCORE, 3 PF29, 4 PF30, 5 ATXOUTN, 6 ATXOUTP, 7 ARXINN, 8 ARXINP, 9 PA0, 10 PA1, 11 PA2, 12 PA3, 13 PA4, 14 PA5, 15 PA6, 16 PA7, 17 PA8, 18 PA9, 19 PA10, 20 PA11, 21 PA12, 22 PA13, 23 TST, 24 JTAGSEL, 25 NMIC_NMI, 26 PA16, 27 PA17, 28 NRST, 29 PA19, 30 PA20, 31 PA21, 32 VDDIO, 33 GNDIO, 34 PA22, 35 PA23, 36 PA24, 37 PA25, 38 PA26, 39 PA27, 40 PA28, 41 SPWDINP1, 42 SPWDINN1, 43 SPWDOUTP1, 44 SPWDOUTN1, 45 SPWREF1, 46 SPWSOUTP1, 47 SPWSOUTN1, 48 SPWSINP1, 49 SPWSINN1, 50 SPWDINP0, 51 SPWDINN0, 52 SPWDOUTP0, 53 SPWDOUTN0, 54 SPWREF0, 55 SPWSOUTP0, 56 SPWSOUTN0, 57 SPWSINP0, 58 SPWSINN0, 59 PB0, 60 PB1, 61 PB2, 62 PB3, 63 VDDCORE, 64 GNDCORE, 65 GNDCORE, 66 VDDCORE, 67 PB4, 68 PB5, 69 PB6, 70 PB7, 71 PB8, 72 PB9, 73 PB10, 74 PB11, 75 PB12, 76 PB13, 77 PB14, 78 PB15, 79 PB16, 80 XOUT, 81 XIN, 82 VDD18_PLLA, 83 GND_PLLA, 84 GND_PLLB, 85 VDD18_PLLB, 86 PB17, 87 PB18, 88 PB19, 89 PB20, 90 PB21, 91 PB22, 92 PB23, 93 PB24, 94 PB25, 95 PB26, 96 VDDIO, 97 GNDIO, 98 PB27, 99 PB28, 100 PB29, 101 PC0, 102 PC1, 103 PC2, 104 PC3, 105 PC4, 106 PC5, 107 PC6, 108 PC7, 109 PC8, 110 PC9, 111 PC10, 112 PC11, 113 PC12, 114 PC13, 115 PC14, 116 PC15, 117 PC16, 118 PC17, 119 PC18, 120 PC19, 121 PC20, 122 PC21, 123 PC22, 124 PC23, 125 PC24, 126 PC25, 127 VDDCORE, 128 GNDCORE, 129 GNDCORE, 130 VDDCORE, 131 PC26, 132 PC27, 133 PC28, 134 PC29, 135 PC30, 136 PC31, 137 PE12, 138 PE11, 139 PE10, 140 PE9, 141 PE8, 142 PE7, 143 PE6, 144 PE5, 145 PE4, 146 PE3, 147 PE2, 148 PE1, 149 PE0, 150 PF0, 151 PF1, 152 PF2, 153 PF3, 154 PF4, 155 PF5, 156 PF6, 157 PF7, 158 PF8, 159 PF9, 160 VDDIO, 161 GNDIO, 162 PF10, 163 PD0, 164 PD1, 165 PD2, 166 PD3, 167 PD4, 168 PD5, 169 PD6, 170 PD7, 171 PD8, 172 PD9, 173 PD10, 174 PD11, 175 PD12, 176 PD13, 177 PD14, 178 PD15, 179 PD16, 180 PD17, 181 PD18, 182 PD19, 183 PD20, 184 PD21, 185 PD22, 186 PD23, 187 PD24, 188 PD25, 189 PD26, 190 PD27, 191 VDDCORE, 192 GNDCORE, 193 GNDCORE, 194 VDDCORE, 195 PD28, 196 PD29, 197 PD30, 198 PD31, 199 PG0, 200 PG1, 201 PG2, 202 PG3, 203 PG4, 204 PG5, 205 PG6, 206 PG7, 207 PG8, 208 PG9, 209 PG10, 210 PG11, 211 PG12, 212 PG13, 213 PG14, 214 PG15, 215 PG16, 216 PG17, 217 PG18, 218 PG19, 219 PG20, 220 PG21, 221 PG22, 222 PG23, 223 PG24, 224 VDDIO, 225 GNDIO, 226 PG25, 227 PG26, 228 PG27, 229 XOUT32, 230 XIN32, 231 PG30, 232 PG31, 233 PF11, 234 PF12, 235 PF13, 236 PF14, 237 PF15, 238 PF16, 239 PF17, 240 PF18, 241 PF19, 242 PF20, 243 PF21, 244 PF22, 245 PF23, 246 PF24, 247 PF25, 248 BTXOUTN, 249 BTXOUTP, 250 BRXINN, 251 BRXINP, 252 PF26, 253 PF27, 254 PF28, 255 VDDCORE, 256 GNDCORE

## Notices in the file
Copyright (c) 2018 Microchip Technology Inc.
SPDX-License-Identifier: Apache-2.0
Licensed under the Apache License, Version 2.0 (the "License");
you may not use this file except in compliance with the License.
You may obtain a copy of the License at
http://www.apache.org/licenses/LICENSE-2.0
Unless required by applicable law or agreed to in writing, software
distributed under the License is distributed on an "AS IS" BASIS,
WITHOUT WARRANTIES OR CONDITIONS OF ANY KIND, either express or implied.
See the License for the specific language governing permissions and
limitations under the License.
