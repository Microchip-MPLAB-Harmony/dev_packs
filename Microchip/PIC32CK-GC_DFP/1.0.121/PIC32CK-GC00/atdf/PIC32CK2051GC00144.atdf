# PIC32CK2051GC00144 device description
Architecture: CORTEX-M33; Family: PIC32CK; Series: PIC32CKGC00

## Interrupts
-15 Reset — Reset Vector, invoked on Power up and warm reset
-14 NonMaskableInt — Non maskable Interrupt, cannot be stopped or preempted
-13 HardFault — Hard Fault, all classes of Fault
-12 MemoryManagement — Memory Management, MPU mismatch, including Access Violation and No Match
-11 BusFault — Bus Fault, Pre-Fetch-, Memory Access Fault, other address/memory related Fault
-10 UsageFault — Usage Fault, i.e. Undef Instruction, Illegal State Transition
-9 SecureFaultMonitor — Secure Fault
-5 SVCall — System Service Call via SVC instruction
-4 DebugMonitor
-2 PendSV — Pendable request for system service
-1 SysTick — System Tick Timer
0 FCR_ERR (FCR) — Flash Read Controller ECC Error
1 FCR_FLT (FCR) — Flash Read Controller CRC Fault
2 FCW — Flash Write Controller Interrupt
3 PM — Power Manager
4 SUPC — Supply Controller
5 OSCCTRL_XOSC (OSCCTRL) — External Oscillator
6 OSCCTRL_DFLL (OSCCTRL) — DFLL
7 OSCCTRL_PLL0 (OSCCTRL) — PLL
8 OSC32KCTRL — 32K Oscillator
9 MCLK — Main Clock
10 FREQM — Frequency Meter
11 WDT — Watchdog Timer
12 RTC
{n+13} EIC_EXTINT_{n} (EIC) (n=0..15) — External Interrupt {n}
29 EIC_NSCHK (EIC) — External Interrupt Non-Secure Check
30 PAC — Peripheral Access Controller
31 TRAM — Trust RAM Interrupt
32 PORT
33 DMA0_PRI0 (DMA0) — DMA 0 Priority 0 Interrupt
34 DMA0_PRI1 (DMA0) — DMA 0 Priority 1 Interrupt
35 DMA0_PRI2 (DMA0) — DMA 0 Priority 2 Interrupt
36 DMA1_PRI0 (DMA1) — DMA 1 Priority 0 Interrupt
37 DMA1_PRI1 (DMA1) — DMA 1 Priority 1 Interrupt
38 HMATRIX
39 EVSYS_0 (EVSYS) — Event System Channel 0
40 EVSYS_1 (EVSYS) — Event System Channel 1
41 EVSYS_2 (EVSYS) — Event System Channel 2
42 EVSYS_3 (EVSYS) — Event System Channel 3
43 EVSYS_OTHER (EVSYS) — Event System Channel 4..X
44 SERCOM0_56 (SERCOM0) — Serial Communication Interface 0
45 SERCOM0_0 (SERCOM0) — Serial Communication Interface 0
46 SERCOM0_1 (SERCOM0) — Serial Communication Interface 0
47 SERCOM0_2 (SERCOM0) — Serial Communication Interface 0
48 SERCOM0_3 (SERCOM0) — Serial Communication Interface 0
49 SERCOM0_4 (SERCOM0) — Serial Communication Interface 0
50 SERCOM1_56 (SERCOM1) — Serial Communication Interface 1
51 SERCOM1_0 (SERCOM1) — Serial Communication Interface 1
52 SERCOM1_1 (SERCOM1) — Serial Communication Interface 1
53 SERCOM1_2 (SERCOM1) — Serial Communication Interface 1
54 SERCOM1_3 (SERCOM1) — Serial Communication Interface 1
55 SERCOM1_4 (SERCOM1) — Serial Communication Interface 1
56 SERCOM2_56 (SERCOM2) — Serial Communication Interface 2
57 SERCOM2_0 (SERCOM2) — Serial Communication Interface 2
58 SERCOM2_1 (SERCOM2) — Serial Communication Interface 2
59 SERCOM2_2 (SERCOM2) — Serial Communication Interface 2
60 SERCOM2_3 (SERCOM2) — Serial Communication Interface 2
61 SERCOM2_4 (SERCOM2) — Serial Communication Interface 2
62 SERCOM3_56 (SERCOM3) — Serial Communication Interface 3
63 SERCOM3_0 (SERCOM3) — Serial Communication Interface 3
64 SERCOM3_1 (SERCOM3) — Serial Communication Interface 3
65 SERCOM3_2 (SERCOM3) — Serial Communication Interface 3
66 SERCOM3_3 (SERCOM3) — Serial Communication Interface 3
67 SERCOM3_4 (SERCOM3) — Serial Communication Interface 3
68 TCC0_OTHER (TCC0) — Error/Overflow/Underflow/Fault Interrupt
69 TCC0_MC0 (TCC0) — TCC Match/Compare 0
70 TCC0_MC1 (TCC0) — TCC Match/Compare 1
71 TCC0_MC2 (TCC0) — TCC Match/Compare 2
72 TCC0_MC3 (TCC0) — TCC Match/Compare 3
73 TCC0_MC4 (TCC0) — TCC Match/Compare 4
74 TCC0_MC5 (TCC0) — TCC Match/Compare 5
75 TCC1_OTHER (TCC1) — Error/Overflow/Underflow/Fault Interrupt
76 TCC1_MC0 (TCC1) — TCC Match/Compare 0
77 TCC1_MC1 (TCC1) — TCC Match/Compare 1
78 TCC1_MC2 (TCC1) — TCC Match/Compare 2
79 TCC1_MC3 (TCC1) — TCC Match/Compare 3
80 TCC1_MC4 (TCC1) — TCC Match/Compare 4
81 TCC1_MC5 (TCC1) — TCC Match/Compare 5
82 TCC2_OTHER (TCC2) — Error/Overflow/Underflow/Fault Interrupt
83 TCC2_MC0 (TCC2) — TCC Match/Compare 0
84 TCC2_MC1 (TCC2) — TCC Match/Compare 1
85 TCC2_MC2 (TCC2) — TCC Match/Compare 2
86 TCC2_MC3 (TCC2) — TCC Match/Compare 3
87 TCC2_MC4 (TCC2) — TCC Match/Compare 4
88 TCC2_MC5 (TCC2) — TCC Match/Compare 5
89 TCC3_OTHER (TCC3) — Error/Overflow/Underflow/Fault Interrupt
90 TCC3_MC0 (TCC3) — TCC Match/Compare 0
91 TCC3_MC1 (TCC3) — TCC Match/Compare 1
92 TCC3_MC2 (TCC3) — TCC Match/Compare 2
93 TCC3_MC3 (TCC3) — TCC Match/Compare 3
94 TCC3_MC4 (TCC3) — TCC Match/Compare 4
95 TCC3_MC5 (TCC3) — TCC Match/Compare 5
96 SERCOM4_56 (SERCOM4) — Serial Communication Interface 4
97 SERCOM4_0 (SERCOM4) — Serial Communication Interface 4
98 SERCOM4_1 (SERCOM4) — Serial Communication Interface 4
99 SERCOM4_2 (SERCOM4) — Serial Communication Interface 4
100 SERCOM4_3 (SERCOM4) — Serial Communication Interface 4
101 SERCOM4_4 (SERCOM4) — Serial Communication Interface 4
102 SERCOM5_56 (SERCOM5) — Serial Communication Interface 5
103 SERCOM5_0 (SERCOM5) — Serial Communication Interface 5
104 SERCOM5_1 (SERCOM5) — Serial Communication Interface 5
105 SERCOM5_2 (SERCOM5) — Serial Communication Interface 5
106 SERCOM5_3 (SERCOM5) — Serial Communication Interface 5
107 SERCOM5_4 (SERCOM5) — Serial Communication Interface 5
108 SERCOM6_56 (SERCOM6) — Serial Communication Interface 6
109 SERCOM6_0 (SERCOM6) — Serial Communication Interface 6
110 SERCOM6_1 (SERCOM6) — Serial Communication Interface 6
111 SERCOM6_2 (SERCOM6) — Serial Communication Interface 6
112 SERCOM6_3 (SERCOM6) — Serial Communication Interface 6
113 SERCOM6_4 (SERCOM6) — Serial Communication Interface 6
114 SERCOM7_56 (SERCOM7) — Serial Communication Interface 7
115 SERCOM7_0 (SERCOM7) — Serial Communication Interface 7
116 SERCOM7_1 (SERCOM7) — Serial Communication Interface 7
117 SERCOM7_2 (SERCOM7) — Serial Communication Interface 7
118 SERCOM7_3 (SERCOM7) — Serial Communication Interface 7
119 SERCOM7_4 (SERCOM7) — Serial Communication Interface 7
120 TCC4_OTHER (TCC4) — Error/Overflow/Underflow/Fault Interrupt
121 TCC4_MC0 (TCC4) — TCC Match/Compare 0
122 TCC4_MC1 (TCC4) — TCC Match/Compare 1
123 TCC5_OTHER (TCC5) — Error/Overflow/Underflow/Fault Interrupt
124 TCC5_MC0 (TCC5) — TCC Match/Compare 0
125 TCC5_MC1 (TCC5) — TCC Match/Compare 1
126 TCC6_OTHER (TCC6) — Error/Overflow/Underflow/Fault Interrupt
127 TCC6_MC0 (TCC6) — TCC Match/Compare 0
128 TCC6_MC1 (TCC6) — TCC Match/Compare 1
129 TCC7_OTHER (TCC7) — Error/Overflow/Underflow/Fault Interrupt
130 TCC7_MC0 (TCC7) — TCC Match/Compare 0
131 TCC7_MC1 (TCC7) — TCC Match/Compare 1
132 ADC_GLOBAL (ADC) — ADC Global Interrupt
133 ADC_CORE1 (ADC) — ADC Core 1 Interrupt
134 Reserved2 (ADC) — ADC Unused/Reserved
135 Reserved3 (ADC) — ADC Unused/Reserved
136 Reserved4 (ADC) — ADC Unused/Reserved
137 Reserved5 (ADC) — ADC Unused/Reserved
138 AC — Analog Comparator Interrupt
139 PTC — Peripheral Touch Controller
140 SPI_IXS — Audio SPI Interrupt
141 PCC
142 PDEC
143 Reserved6 (CAN0) — Controller Area Network 0 Unused/Reserved
144 Reserved7 (CAN1) — Controller Area Network 1 Unused/Reserved
145 ETH — Ethernet MAC Interrupt
146 SQI — Quad SPI Interrupt
147 TRNG — True Random Generator
148 SDMMC0 — SD/MMC Host Controller Interrupt 0
149 SDMMC1 — SD/MMC Host Controller Interrupt 1
150 USB_OTHER (USB) — USB Other Interrupt
151 USB_SOF (USB) — USB SOF Interrupt
152 USB_TRCPT0 (USB) — USB TRCPT0 Interrupt
153 USB_TRCPT1 (USB) — USB TRCPT1 Interrupt
154 USBHS — High Speed USB Interrupt
155 HSM_ERROR (HSM) — Hardware Security Module Error Interrupt
156 HSM_TXINT (HSM) — Hardware Security Module Transmit Interrupt
157 HSM_RXINT (HSM) — Hardware Security Module Receive Interrupt

## Event generators
1 SUPC_LVDET, 2 OSCCTRL_XOSC_FAIL, 3 OSC32KCTRL_XOSC32K_FAIL, 4 FREQM_DONE, 5 FREQM_WINMON, {n+6} RTC_PER_{n} (n=0..7), 14 RTC_PERD, {n+15} RTC_CMP_{n} (n=0..3), 19 RTC_TAMPER, 20 RTC_OVF, {n+21} EIC_EXTINT_{n} (n=0..15), 37 PAC_ACCERR, {n+38} DMA0_CH_{n} (n=0..7), {n+46} DMA1_CH_{n} (n=0..3), {9n+50} TCC{n}_OVF (n=0..4), {9n+51} TCC{n}_TRG (n=0..4), {9n+52} TCC{n}_CNT (n=0..4), {9n+53} TCC{n}_MC_0 (n=0..4), {9n+54} TCC{n}_MC_1 (n=0..4), {9n+55} TCC{n}_MC_2 (n=0..3), {9n+56} TCC{n}_MC_3 (n=0..3), {9n+57} TCC{n}_MC_4 (n=0..3), {9n+58} TCC{n}_MC_5 (n=0..3), {5n+66} TCC{n}_OVF (n=5..7), {5n+67} TCC{n}_TRG (n=5..7), {5n+68} TCC{n}_CNT (n=5..7), {5n+69} TCC{n}_MC_0 (n=5..7), {5n+70} TCC{n}_MC_1 (n=5..7), 106 ADC_CHRDYC_0, 107 ADC_CMP_0, 108 AC_COMP_0, 109 AC_COMP_1, 110 AC_WIN_0, 113 SPI_IXS_GEN, {n+114} CCL_LUTOUT_{n} (n=0..3), 118 PDEC_DIR, 119 PDEC_ERR, 120 PDEC_MC_0, 121 PDEC_MC_1, 122 PDEC_OVF, 123 PDEC_VLC, 125 TRNG_READY

## Event users
0 FREQM_START, 1 RTC_TAMPER, {n+2} PORT_EV_{n} (n=0..3), {n+6} DMA0_CHSTRT_{n} (n=0..7), {n+14} DMA0_CHAUX_{n} (n=0..7), {n+22} DMA1_CHSTRT_{n} (n=0..3), {n+26} DMA1_CHAUX_{n} (n=0..3), {8n+30} TCC{n}_EV_0 (n=0..4), {8n+31} TCC{n}_EV_1 (n=0..4), {8n+32} TCC{n}_MC_0 (n=0..4), {8n+33} TCC{n}_MC_1 (n=0..4), {8n+34} TCC{n}_MC_2 (n=0..3), {8n+35} TCC{n}_MC_3 (n=0..3), {8n+36} TCC{n}_MC_4 (n=0..3), {8n+37} TCC{n}_MC_5 (n=0..3), {4n+46} TCC{n}_EV_0 (n=5..7), {4n+47} TCC{n}_EV_1 (n=5..7), {4n+48} TCC{n}_MC_0 (n=5..7), {4n+49} TCC{n}_MC_1 (n=5..7), {n+78} ADC_TRIGGERS_{n} (n=0..10), 89 AC_SOC_0, 90 AC_SOC_1, {n+93} CCL_LUTIN_{n} (n=0..3), {n+97} PDEC_EVU_{n} (n=0..2)

## Properties
SIGNATURES: DSU_DID=0x09509053

## Pinouts (pin number, pad)
P144: 1 PA00, 2 PA01, 3 PA02, 4 PA03, 5 RESET_N, 6 GND, 7 VDDIO, 8 PA20, 9 PA21, 10 PA22, 11 PA23, 12 PA13, 13 PA14, 14 PA15, 15 PA16, 16 PA17, 17 PA24, 18 GND, 19 VDDIO, 20 PA25, 21 PA26, 22 PA27, 23 PA04, 24 PA05, 25 PA06, 26 PA07, 27 PA08, 28 PA18, 29 PA28, 30 GND, 31 VDDIO, 32 EXT, 33 PA09, 34 ATEST, 35 PA11, 36 PA12, 37 PB00, 38 VREFH, 39 PB11, 40 PB12, 41 PB18, 42 PB19, 43 PB20, 44 VSSA, 45 PB02, 46 PB03, 47 VDDA, 48 VDDIO, 49 GND, 50 PB04, 51 PB05, 52 PB13, 53 PB06, 54 PB14, 55 PB15, 56 VDDIO, 57 GND, 58 VDDREG, 59 PB21, 60 PB22, 61 PB23, 62 PB24, 63 PB25, 64 PB26, 65 PB16, 66 VDDIO, 67 GND, 68 PB17, 69 PB07, 70 PB08, 71 PB09, 72 PB10, 73 PC00, 74 PC01, 75 PC02, 76 PC03, 77 PC04, 78 VDDIO, 79 GND, 80 PC21, 81 PC22, 82 PC14, 83 PC23, 84 PC05, 85 PC06, 86 PC07, 87 PC24, 88 PC25, 89 VDDREG, 90 VDDIO, 91 GND, 92 PC26, 93 PC27, 94 PC09, 95 PC15, 96 PC28, 97 PC29, 98 PC16, 99 PC17, 100 PC18, 101 PC10, 102 VDDIO, 103 GND, 104 PC11, 105 PC12, 106 PC13, 107 PC19, 108 PC20, 109 USB0PN, 110 USB0PP, 111 USB0ID, 112 VCCAP3, 113 USBVSSA, 114 VBUS, 115 USRBIAS, 116 VDDREG, 117 VSSIO, 118 VDDIO, 119 PD00, 120 PD01, 121 PD02, 122 PD03, 123 PD04, 124 PD13, 125 PD14, 126 PD15, 127 PD16, 128 GND, 129 VDDIO, 130 PD17, 131 PD18, 132 PD19, 133 PD20, 134 PD21, 135 PD12, 136 PD05, 137 PD06, 138 PD07, 139 GND, 140 VDDIOB, 141 PD08, 142 PD09, 143 PD10, 144 PD11

## Notices in the file
Copyright (c) 2021 Microchip Technology Inc.
SPDX-License-Identifier: Apache-2.0
Licensed under the Apache License, Version 2.0 (the "License");
you may not use this file except in compliance with the License.
You may obtain a copy of the License at
http://www.apache.org/licenses/LICENSE-2.0
Unless required by applicable law or agreed to in writing, software
distributed under the License is distributed on an "AS IS" BASIS,
WITHOUT WARRANTIES OR CONDITIONS OF ANY KIND, either express or implied.
See the License for the specific language governing permissions and
limitations under the License.
