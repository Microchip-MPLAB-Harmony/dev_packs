# PIC32MK0512MCJ064 device description
Architecture: MIPS; Family: PIC32MK; Series: PIC32MK
Parameters: __MPU_PRESENT=1 (MPU present or not), __INT_PRIO_LEVELS=7 (Number of interrupt priority levels), __INT_SUBPRIO_LEVELS=4 (Number of interrupt subpriority levels), __SYS_DEF_FREQ=120000000 (System Clock Default Frequency), __NUM_DMA_CHANNELS=8 (Number of DMA Channels), __PB1_DEF_FREQ=60000000 (Peripheral Bus 1 Default Clock Frequency), __PB2_DEF_FREQ=60000000 (Peripheral Bus 2 Default Clock Frequency), __PB4_DEF_FREQ=60000000 (Peripheral Bus 4 Default Clock Frequency), __PB5_DEF_FREQ=60000000 (Peripheral Bus 5 Default Clock Frequency), __PB6_DEF_FREQ=30000000 (Peripheral Bus 6 Default Clock Frequency), __REFCLK1_DEF_FREQ=120000000 (Reference Clock 1 Default Frequency), __REFCLK2_DEF_FREQ=120000000 (Reference Clock 2 Default Frequency), __REFCLK3_DEF_FREQ=120000000 (Reference Clock 3 Default Frequency), __REFCLK4_DEF_FREQ=120000000 (Reference Clock 4 Default Frequency), __POSC_DEF_FREQ=8000000 (Primary Oscillator Input Default Frequency), __SOSC_DEF_FREQ=32768 (Secondary Oscillator Input Default Frequency), __PB1_DEF_DIV=2 (Peripheral Bus 1 Default Divider Value), __PB2_DEF_DIV=2 (Peripheral Bus 2 Default Divider Value), __PB4_DEF_DIV=2 (Peripheral Bus 4 Default Divider Value), __PB5_DEF_DIV=2 (Peripheral Bus 5 Default Divider Value), __PB6_DEF_DIV=4 (Peripheral Bus 6 Default Divider Value), __INT_NUM_SHADOW_SETS=7 (Number of interrupt shadow register sets), __VTOR_PRESENT=1 (Vector Table Offset Register present or not), __FPU_PRESENT=1 (FPU present or not), __FPU_DP=1 (Double Precision FPU implemented or not), __ICACHE_PRESENT=1 (Instruction Cache present or not), __DCACHE_PRESENT=1 (Data Cache present or not), __ITCM_PRESENT=0 (Instruction TCM present or not), __DTCM_PRESENT=0 (Data TCM present or not), LITTLE_ENDIAN=1 (Little endian used or not), __ARCH_ARM=0 (ARM architecture or not)
Programming and debug interfaces: JTAG, SWD
Registers are 32-bit, read-write, no defined reset value unless marked. A register's access mark holds for its fields unless they carry their own. Offsets are from the block's base; lines under a group give offsets from that group; [hi:lo] are bit positions; {n}, {i} and the like mark numbered series; 'fields as' and 'values as' point back to an identical list; <NAME> marks a mode.

## Ordering variants
PIC32MK0512MCJ064: TQFP64, up to 120 MHz, -40 to 85 C, 2.3 to 3.6 V
PIC32MK0512MCJ064: QFN64, up to 120 MHz, -40 to 85 C, 2.3 to 3.6 V

## Memory
base space: start 0 size 0x100000000, little endian
  0x1fc03f30 lowerbootaliasaltconfig size 0x50
  0x1fc43f30 altboot1config size 0x50
  0x1fc43fb0 boot1config size 0x50
  0x1fc00000 lowerbootalias size 0x3f30
  0x1fc04000 lowerbootaliaslastpage size 0x1000
  0x1fc40000 boot1page0 size 0x1000
  0x1fc41000 boot1page1 size 0x1000
  0x1fc43000 boot1page3 size 0xf30
  0x1fc44000 boot1lastpage size 0x1000
  0x1d000000 code size 0x80000
  0x1fc03fb0 lowerbootaliasconfig size 0x50
  0x1fc45000 adccal size 0x1c
  0x1fc45020 serial size 0x10
  0x1fc45030 eedatacal size 0x10
  0xffffffff devid size 0x0
  0xff300000 emulation size 0x100000
  0x00000000 kseg0_data_mem size 0x10000
  0x1f800000 periph_pb1_std size 0x2000
  0x1f810000 periph_pb1_fast size 0x2000
  0x1f820000 periph_pb2_std size 0xe200
  0x1f840000 periph_pb3_std size 0xc800
  0x1f860000 periph_pb4_std size 0x700
  0x1f880000 periph_pb5_std size 0xb000
  0x1f8c0000 periph_pb6_std size 0x400
  0x1f8f0000 periph_ssx size 0x10000
  0x1fc42000 testmem size 0x1000

## Peripheral instances (address, pins/pin function, parameters)
ADCHS at 0x1f887000 in periph_pb5_std
CAN1 at CAN 0x1f880000 in periph_pb5_std
CDAC1 at CDAC 0x1f82c400 in periph_pb2_std
CDAC2
CFG at 0x1f800000 in periph_pb1_std
CLC1 at CLC 0x1f82d200 in periph_pb2_std
CLC{n} (n=2..4)
CMP at 0x1f82c000 in periph_pb2_std
CORE at 0x0
CRU at 0x1f801200 in periph_pb1_std
CTMU at 0x1f82d000 in periph_pb2_std
DMAC at 0x1f811000 in periph_pb1_fast
DMT at 0x1f800e00 in periph_pb1_std
DSCTRL at 0x1f8c0200 in periph_pb6_std
GPIO at 0x1f860000 in periph_pb4_std
HLVD at 0x1f801800 in periph_pb1_std
I2C1 at I2C 0x1f826000 in periph_pb2_std
I2C2
ICAP1 at ICAP 0x1f822000 in periph_pb2_std
  parameters: TMR_SRC_0=0 (Timer 3), TMR_SRC_1=1 (Timer 2), TMR_ALTERNATE_SRC_0=0 (Timer 5), TMR_ALTERNATE_SRC_1=1 (Timer 4)
ICAP2
  parameters: TMR_SRC_0=0 (Timer 3), TMR_SRC_1=1 (Timer 2), TMR_ALTERNATE_SRC_0=0 (Timer 5), TMR_ALTERNATE_SRC_1=1 (Timer 4)
ICAP3
  parameters: TMR_SRC_0=0 (Timer 3), TMR_SRC_1=1 (Timer 2), TMR_ALTERNATE_SRC_0=0 (Timer 5), TMR_ALTERNATE_SRC_1=1 (Timer 4)
ICAP{n} (n=4..6)
  parameters: TMR_SRC_0=0 (Timer 3), TMR_SRC_1=1 (Timer 2), TMR_ALTERNATE_SRC_0=0 (Timer 3), TMR_ALTERNATE_SRC_1=1 (Timer 2)
ICAP{n} (n=7..9)
  parameters: TMR_SRC_0=0 (Timer 3), TMR_SRC_1=1 (Timer 2), TMR_ALTERNATE_SRC_0=0 (Timer 7), TMR_ALTERNATE_SRC_1=1 (Timer 6)
INT at 0x1f810000 in periph_pb1_fast
JTAG at 0x1f801000 in periph_pb1_std
MCPWM at 0x1f82a000 in periph_pb2_std
  parameters: MCPWM_CH{n}_OUTPUTS=2 (n=1..6), MCPWM_CH7_OUTPUTS=1, MCPWM_CH8_OUTPUTS=1, MCPWM_CH9_OUTPUTS=1, MCPWM_CH10_OUTPUTS=1, MCPWM_CH11_OUTPUTS=2, MCPWM_CH12_OUTPUTS=2
NVM at 0x1f800a00 in periph_pb1_std
OCMP1 at OCMP 0x1f824000 in periph_pb2_std
  parameters: TMR_SRC_0=0 (Timer 2), TMR_SRC_1=1 (Timer 3), TMR_ALTERNATE_SRC_0=0 (Timer 4), TMR_ALTERNATE_SRC_1=1 (Timer 5)
OCMP2
  parameters: TMR_SRC_0=0 (Timer 2), TMR_SRC_1=1 (Timer 3), TMR_ALTERNATE_SRC_0=0 (Timer 4), TMR_ALTERNATE_SRC_1=1 (Timer 5)
OCMP3
  parameters: TMR_SRC_0=0 (Timer 2), TMR_SRC_1=1 (Timer 3), TMR_ALTERNATE_SRC_0=0 (Timer 4), TMR_ALTERNATE_SRC_1=1 (Timer 5)
OCMP{n} (n=4..6)
  parameters: TMR_SRC_0=0 (Timer 2), TMR_SRC_1=1 (Timer 3), TMR_ALTERNATE_SRC_0=0 (Timer 2), TMR_ALTERNATE_SRC_1=1 (Timer 3)
OCMP{n} (n=7..9)
  parameters: TMR_SRC_0=0 (Timer 2), TMR_SRC_1=1 (Timer 3), TMR_ALTERNATE_SRC_0=0 (Timer 6), TMR_ALTERNATE_SRC_1=1 (Timer 7)
PCACHE at 0x1f800800 in periph_pb1_std
QEI1 at QEI 0x1f82b200 in periph_pb2_std
QEI2
QEI3
RPIN at 0x1f801404 in periph_pb1_std
RPOR at 0x1f801600 in periph_pb1_std
RTCC at 0x1f8c0000 in periph_pb6_std
SB at 0x1f8f0510 in periph_ssx
SPI1 at SPI 0x1f827000 in periph_pb2_std
SPI2
TMR1 at 0x1f820000 in periph_pb2_std
TMR2 at 0x1f820200 in periph_pb2_std
TMR{n} (n=3..9)
UART1 at UART 0x1f828000 in periph_pb2_std
UART2
WDT at 0x1f800c00 in periph_pb1_std

## Interrupts
0 CORE_TIMER — Core Timer Interrupt
1 CORE_SOFTWARE_0 — Core Software Interrupt 0
2 CORE_SOFTWARE_1 — Core Software Interrupt 1
3 EXTERNAL_0 — External Interrupt 0
4 TIMER_1
5 INPUT_CAPTURE_1_ERROR
6 INPUT_CAPTURE_1
7 OUTPUT_COMPARE_1
8 EXTERNAL_1 — External Interrupt 1
9 TIMER_2
10 INPUT_CAPTURE_2_ERROR
11 INPUT_CAPTURE_2
12 OUTPUT_COMPARE_2
13 EXTERNAL_2 — External Interrupt 2
14 TIMER_3
15 INPUT_CAPTURE_3_ERROR
16 INPUT_CAPTURE_3
17 OUTPUT_COMPARE_3
18 EXTERNAL_3 — External Interrupt 3
19 TIMER_4
20 INPUT_CAPTURE_4_ERROR
21 INPUT_CAPTURE_4
22 OUTPUT_COMPARE_4
23 EXTERNAL_4 — External Interrupt 4
24 TIMER_5
25 INPUT_CAPTURE_5_ERROR
26 INPUT_CAPTURE_5
27 OUTPUT_COMPARE_5
30 RTCC — Real Time Clock
31 FLASH_CONTROL — Flash Control Event
32 COMPARATOR_1 — Comparator 1 Interrupt
33 COMPARATOR_2 — Comparator 2 Interrupt
35 SPI1_FAULT
36 SPI1_RX — SPI1 Receive Done
37 SPI1_TX — SPI1 Transfer Done
38 UART1_FAULT
39 UART1_RX — UART1 Receive Done
40 UART1_TX — UART1 Transfer Done
41 I2C1_BUS — I2C1 Bus Collision Event
42 I2C1_SLAVE — I2C1 Slave Event
43 I2C1_MASTER — I2C1 Master Event
44 CHANGE_NOTICE_A — PORTA Input Change Interrupt
45 CHANGE_NOTICE_B — PORTB Input Change Interrupt
46 CHANGE_NOTICE_C — PORTC Input Change Interrupt
47 CHANGE_NOTICE_D — PORTD Input Change Interrupt
48 CHANGE_NOTICE_E — PORTE Input Change Interrupt
49 CHANGE_NOTICE_F — PORTF Input Change Interrupt
50 CHANGE_NOTICE_G — PORTG Input Change Interrupt
53 SPI2_FAULT
54 SPI2_RX — SPI2 Receive Done
55 SPI2_TX — SPI2 Transfer Done
56 UART2_FAULT
57 UART2_RX — UART2 Receive Done
58 UART2_TX — UART2 Transfer Done
59 I2C2_BUS — I2C2 Bus Collision Event
60 I2C2_SLAVE — I2C2 Slave Event
61 I2C2_MASTER — I2C2 Master Event
71 CTMU — CTMU Interrupt
72 DMA0 — DMA Channel 0
73 DMA1 — DMA Channel 1
74 DMA2 — DMA Channel 2
75 DMA3 — DMA Channel 3
76 TIMER_6
77 INPUT_CAPTURE_6_ERROR
78 INPUT_CAPTURE_6
79 OUTPUT_COMPARE_6
80 TIMER_7
81 INPUT_CAPTURE_7_ERROR
82 INPUT_CAPTURE_7
83 OUTPUT_COMPARE_7
84 TIMER_8
85 INPUT_CAPTURE_8_ERROR
86 INPUT_CAPTURE_8
87 OUTPUT_COMPARE_8
88 TIMER_9
89 INPUT_CAPTURE_9_ERROR
90 INPUT_CAPTURE_9
91 OUTPUT_COMPARE_9
92 ADC — ADC Global Interrupt
94 ADC_DC1 — ADC Digital Comparator 1
95 ADC_DC2 — ADC Digital Comparator 2
96 ADC_DF1 — ADC Digital Filter 1
97 ADC_DF2 — ADC Digital Filter 2
98 ADC_DF3 — ADC Digital Filter 3
99 ADC_DF4 — ADC Digital Filter 4
100 ADC_FAULT
101 ADC_EOS — ADC End of Scan
102 ADC_ARDY — ADC Ready
103 ADC_URDY — ADC Update Ready After Suspend
104 ADC_DMA — ADC First Class Channels DMA
105 ADC_EARLY — ADC Early Group Interrupt
{n+106} ADC_DATA{n} (n=0..19)
130 ADC_DATA24
131 ADC_DATA25
132 ADC_DATA26
133 ADC_DATA27
146 ADC_DATA40
147 ADC_DATA41
{n+106} ADC_DATA{n} (n=46..53)
160 COMPARATOR_3 — Comparator 3 Interrupt
161 COMPARATOR_4 — Comparator 4 Interrupt
162 COMPARATOR_5 — Comparator 5 Interrupt
167 CAN1 — CAN1 Global Interrupt
169 QEI1 — QEI 1 Interrupt
170 QEI2 — QEI 2 Interrupt
171 PWM_PRI — PWM Primary Event
172 PWM_SEC — PWM Secondary Event
173 PWM1 — PWM 1 Interrupt
174 PWM2 — PWM 2 Interrupt
175 PWM3 — PWM 3 Interrupt
176 PWM4 — PWM 4 Interrupt
177 PWM5 — PWM 5 Interrupt
178 PWM6 — PWM 6 Interrupt
182 DMA4 — DMA Channel 4
183 DMA5 — DMA Channel 5
184 DMA6 — DMA Channel 6
185 DMA7 — DMA Channel 7
189 QEI3 — QEI 3 Interrupt
230 SYSTEM_BUS_PROTECTION — System Bus Protection Violation
238 PWM7 — PWM 7 Interrupt
239 PWM8 — PWM 8 Interrupt
240 PWM9 — PWM 9 Interrupt
245 ADC_DC3 — ADC Digital Comparator 3
246 ADC_DC4 — ADC Digital Comparator 4
247 PCACHE — P - Cache Event Interrupt
249 CLC1 — CLC 1 Interrupt
250 CLC2 — CLC 2 Interrupt
251 CLC3 — CLC 3 Interrupt
252 CLC4 — CLC 4 Interrupt
254 CORE_PERF_COUNT — MPU Core Performance Counter Event
255 CORE_FAST_DEBUG_CHAN — Core Fast Debug Channel

## Notices in the file
Copyright (c) 2019 Microchip Technology Inc.
SPDX-License-Identifier: Apache-2.0
Licensed under the Apache License, Version 2.0 (the "License");
you may not use this file except in compliance with the License.
You may obtain a copy of the License at
http://www.apache.org/licenses/LICENSE-2.0
Unless required by applicable law or agreed to in writing, software
distributed under the License is distributed on an "AS IS" BASIS,
WITHOUT WARRANTIES OR CONDITIONS OF ANY KIND, either express or implied.
See the License for the specific language governing permissions and
limitations under the License.
