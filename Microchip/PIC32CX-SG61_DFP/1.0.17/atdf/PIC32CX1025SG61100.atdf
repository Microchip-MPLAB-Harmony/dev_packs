# PIC32CX1025SG61100 device description
Architecture: CORTEX-M4; Family: PIC32CX; Series: PIC32CXSG61

## Peripheral instances (address, pins/pin function, parameters) (continued)
SERCOM3 at 0x41014000 (SERCOM)
  pins: PAD0 PA17/D set 3 or PA22/C set 1 or PB20/C set 2; PAD1 PA16/D set 3 or PA23/C set 1 or PB21/C set 2; PAD2 PA18/D set 3 or PA20/D set 2 or PA24/C set 1; PAD3 PA19/D set 3 or PA21/D set 2 or PA25/C set 1
  parameters: CLK_REDUCTION=1 (Reduce clock options to pin 1 for SPI and USART), DLY_COMPENSATION=1 (Compensates for a fast DLY50 element. Assuming 20ns), DMA=1 (DMA support implemented?), DMAC_ID_RX=10 (Index of DMA RX trigger), DMAC_ID_TX=11 (Index of DMA TX trigger), FIFO_DEPTH_POWER=1 (2^FIFO_DEPTH_POWER gives rx FIFO depth.), GCLK_ID_CORE=24, GCLK_ID_SLOW=3, INT_MSB=6, PMSB=3, RETENTION_SUPPORT=0 (Retention supported?), SE_CNT=1 (SE counter included?), SPI=1 (SPI mode implemented?), SPI_HW_SS_CTRL=1 (Master _SS hardware control implemented?), SPI_ICSPACE_EXT=1 (SPI inter character space implemented?), SPI_OZMO=0 (OZMO features implemented?), SPI_WAKE_ON_SSL=1 (_SS low detect implemented?), SPI_TX_READY_INT_SRC=58 (SPI TX READY Interrupt), SPI_TX_COMPLETE_INT_SRC=59 (SPI TX COMPLETE Interrupt), SPI_RX_INT_SRC=60 (SPI RX Interrupt), SPI_ERROR_INT_SRC=61 (SPI ERROR Interrupt), TTBIT_EXTENSION=1 (32-bit extension implemented?), I2CM=1 (I2C Master mode implemented?), I2CS=1 (I2C Slave mode implemented?), I2CS_AUTO_ACK=1 (I2C slave automatic acknowledge implemented?), I2CS_GROUP_CMD=1 (I2C slave group command implemented?), I2CS_SDASETUP_CNT_SIZE=8 (I2CS sda setup count size), I2CS_SDASETUP_SIZE=4, I2CS_SUDAT=1 (I2C slave SDA setup implemented?), I2C_FASTMP=1 (I2C fast mode plus implemented?), I2C_HSMODE=1 (USART mode implemented?), I2C_SCLSM_MODE=1 (I2C SCL clock stretch mode implemented?), I2C_SMB_TIMEOUTS=1 (I2C SMBus timeouts implemented?), I2C_TENBIT_ADR=1 (I2C ten bit enabled?), I2C_0_INT_SRC=58 (I2C 0 Interrupt), I2C_1_INT_SRC=59 (I2C 1 Interrupt), I2C_2_INT_SRC=60 (I2C 2 Interrupt), I2C_3_INT_SRC=61 (I2C 3 Interrupt), USART=1 (USART mode implemented?), USART_AUTOBAUD=1 (USART autobaud implemented?), USART_COLDET=1 (USART collision detection implemented?), USART_FLOW_CTRL=1 (USART flow control implemented?), USART_FRAC_BAUD=1 (USART fractional BAUD implemented?), USART_IRDA=1 (USART IrDA implemented?), USART_ISO7816=1 (USART ISO7816 mode implemented?), USART_LIN_MASTER=1 (USART LIN Master mode implemented?), USART_RS485=1 (USART RS485 mode implemented?), USART_SAMPA_EXT=1 (USART sample adjust implemented?), USART_SAMPR_EXT=1 (USART oversampling adjustment implemented?), USART_TX_READY_INT_SRC=58 (USART TX READY Interrupt), USART_TX_COMPLETE_INT_SRC=59 (USART TX COMPLETE Interrupt), USART_RX_INT_SRC=60 (USART RX Interrupt), USART_ERROR_INT_SRC=61 (USART ERROR Interrupt), INSTANCE_ID=42 (Instance index for SERCOM3)
SERCOM4 at 0x43000000 (SERCOM)
  pins: PAD0 PA13/D set 3 or PB08/D set 2 or PB12/C set 1; PAD1 PA12/D set 3 or PB09/D set 2 or PB13/C set 1; PAD2 PA14/D set 3 or PB10/D set 2 or PB14/C set 1; PAD3 PB11/D set 2 or PA15/D set 3 or PB15/C set 1
  parameters: CLK_REDUCTION=1 (Reduce clock options to pin 1 for SPI and USART), DLY_COMPENSATION=1 (Compensates for a fast DLY50 element. Assuming 20ns), DMA=1 (DMA support implemented?), DMAC_ID_RX=12 (Index of DMA RX trigger), DMAC_ID_TX=13 (Index of DMA TX trigger), FIFO_DEPTH_POWER=1 (2^FIFO_DEPTH_POWER gives rx FIFO depth.), GCLK_ID_CORE=34, GCLK_ID_SLOW=3, INT_MSB=6, PMSB=3, RETENTION_SUPPORT=0 (Retention supported?), SE_CNT=1 (SE counter included?), SPI=1 (SPI mode implemented?), SPI_HW_SS_CTRL=1 (Master _SS hardware control implemented?), SPI_ICSPACE_EXT=1 (SPI inter character space implemented?), SPI_OZMO=0 (OZMO features implemented?), SPI_WAKE_ON_SSL=1 (_SS low detect implemented?), SPI_TX_READY_INT_SRC=62 (SPI TX READY Interrupt), SPI_TX_COMPLETE_INT_SRC=63 (SPI TX COMPLETE Interrupt), SPI_RX_INT_SRC=64 (SPI RX Interrupt), SPI_ERROR_INT_SRC=65 (SPI ERROR Interrupt), TTBIT_EXTENSION=1 (32-bit extension implemented?), I2CM=1 (I2C Master mode implemented?), I2CS=1 (I2C Slave mode implemented?), I2CS_AUTO_ACK=1 (I2C slave automatic acknowledge implemented?), I2CS_GROUP_CMD=1 (I2C slave group command implemented?), I2CS_SDASETUP_CNT_SIZE=8 (I2CS sda setup count size), I2CS_SDASETUP_SIZE=4, I2CS_SUDAT=1 (I2C slave SDA setup implemented?), I2C_FASTMP=1 (I2C fast mode plus implemented?), I2C_HSMODE=1 (USART mode implemented?), I2C_SCLSM_MODE=1 (I2C SCL clock stretch mode implemented?), I2C_SMB_TIMEOUTS=1 (I2C SMBus timeouts implemented?), I2C_TENBIT_ADR=1 (I2C ten bit enabled?), I2C_0_INT_SRC=62 (I2C 0 Interrupt), I2C_1_INT_SRC=63 (I2C 1 Interrupt), I2C_2_INT_SRC=64 (I2C 2 Interrupt), I2C_3_INT_SRC=65 (I2C 3 Interrupt), USART=1 (USART mode implemented?), USART_AUTOBAUD=1 (USART autobaud implemented?), USART_COLDET=1 (USART collision detection implemented?), USART_FLOW_CTRL=1 (USART flow control implemented?), USART_FRAC_BAUD=1 (USART fractional BAUD implemented?), USART_IRDA=1 (USART IrDA implemented?), USART_ISO7816=1 (USART ISO7816 mode implemented?), USART_LIN_MASTER=1 (USART LIN Master mode implemented?), USART_RS485=1 (USART RS485 mode implemented?), USART_SAMPA_EXT=1 (USART sample adjust implemented?), USART_SAMPR_EXT=1 (USART oversampling adjustment implemented?), USART_TX_READY_INT_SRC=62 (USART TX READY Interrupt), USART_TX_COMPLETE_INT_SRC=63 (USART TX COMPLETE Interrupt), USART_RX_INT_SRC=64 (USART RX Interrupt), USART_ERROR_INT_SRC=65 (USART ERROR Interrupt), INSTANCE_ID=96 (Instance index for SERCOM4)
SERCOM5 at 0x43000400 (SERCOM)
  pins: PAD0 PA23/D set 2 3 4 or PB02/D set 6 or PB31/D set 5 or PB16/C set 1; PAD1 PA22/D set 2 3 4 or PB03/D set 6 or PB30/D set 5 or PB17/C set 1; PAD2 PA24/D set 3 or PB00/D set 5 6 or PB22/D set 4 or PA20/C set 2 or PB18/C set 1; PAD3 PA25/D set 3 or PB01/D set 5 6 or PB23/D set 4 or PA21/C set 2 or PB19/C set 1
  parameters: CLK_REDUCTION=1 (Reduce clock options to pin 1 for SPI and USART), DLY_COMPENSATION=1 (Compensates for a fast DLY50 element. Assuming 20ns), DMA=1 (DMA support implemented?), DMAC_ID_RX=14 (Index of DMA RX trigger), DMAC_ID_TX=15 (Index of DMA TX trigger), FIFO_DEPTH_POWER=1 (2^FIFO_DEPTH_POWER gives rx FIFO depth.), GCLK_ID_CORE=35, GCLK_ID_SLOW=3, INT_MSB=6, PMSB=3, RETENTION_SUPPORT=0 (Retention supported?), SE_CNT=1 (SE counter included?), SPI=1 (SPI mode implemented?), SPI_HW_SS_CTRL=1 (Master _SS hardware control implemented?), SPI_ICSPACE_EXT=1 (SPI inter character space implemented?), SPI_OZMO=0 (OZMO features implemented?), SPI_WAKE_ON_SSL=1 (_SS low detect implemented?), SPI_TX_READY_INT_SRC=66 (SPI TX READY Interrupt), SPI_TX_COMPLETE_INT_SRC=67 (SPI TX COMPLETE Interrupt), SPI_RX_INT_SRC=68 (SPI RX Interrupt), SPI_ERROR_INT_SRC=69 (SPI ERROR Interrupt), TTBIT_EXTENSION=1 (32-bit extension implemented?), I2CM=1 (I2C Master mode implemented?), I2CS=1 (I2C Slave mode implemented?), I2CS_AUTO_ACK=1 (I2C slave automatic acknowledge implemented?), I2CS_GROUP_CMD=1 (I2C slave group command implemented?), I2CS_SDASETUP_CNT_SIZE=8 (I2CS sda setup count size), I2CS_SDASETUP_SIZE=4, I2CS_SUDAT=1 (I2C slave SDA setup implemented?), I2C_FASTMP=1 (I2C fast mode plus implemented?), I2C_HSMODE=1 (USART mode implemented?), I2C_SCLSM_MODE=1 (I2C SCL clock stretch mode implemented?), I2C_SMB_TIMEOUTS=1 (I2C SMBus timeouts implemented?), I2C_TENBIT_ADR=1 (I2C ten bit enabled?), I2C_0_INT_SRC=66 (I2C 0 Interrupt), I2C_1_INT_SRC=67 (I2C 1 Interrupt), I2C_3_INT_SRC=69 (I2C 3 Interrupt), USART=1 (USART mode implemented?), USART_AUTOBAUD=1 (USART autobaud implemented?), USART_COLDET=1 (USART collision detection implemented?), USART_FLOW_CTRL=1 (USART flow control implemented?), USART_FRAC_BAUD=1 (USART fractional BAUD implemented?), USART_IRDA=1 (USART IrDA implemented?), USART_ISO7816=1 (USART ISO7816 mode implemented?), USART_LIN_MASTER=1 (USART LIN Master mode implemented?), USART_RS485=1 (USART RS485 mode implemented?), USART_SAMPA_EXT=1 (USART sample adjust implemented?), USART_SAMPR_EXT=1 (USART oversampling adjustment implemented?), USART_TX_READY_INT_SRC=66 (USART TX READY Interrupt), USART_TX_COMPLETE_INT_SRC=67 (USART TX COMPLETE Interrupt), USART_RX_INT_SRC=68 (USART RX Interrupt), USART_ERROR_INT_SRC=69 (USART ERROR Interrupt), INSTANCE_ID=97 (Instance index for SERCOM5)
SERCOM6 at 0x43000800 (SERCOM)
  pins: PAD0 PC13/D set 4 5 or PC16/C set 1; PAD1 PC12/D set 4 5 or PC05/C set 2 or PC17/C set 1; PAD2 PC14/D set 4 or PC06/C set 2 or PC10/C set 5 or PC18/C set 1; PAD3 PC15/D set 4 or PC07/C set 2 or PC11/C set 5 or PC19/C set 1
  parameters: CLK_REDUCTION=1 (Reduce clock options to pin 1 for SPI and USART), DLY_COMPENSATION=1 (Compensates for a fast DLY50 element. Assuming 20ns), DMA=1 (DMA support implemented?), DMAC_ID_RX=16 (Index of DMA RX trigger), DMAC_ID_TX=17 (Index of DMA TX trigger), FIFO_DEPTH_POWER=1 (2^FIFO_DEPTH_POWER gives rx FIFO depth.), GCLK_ID_CORE=36, GCLK_ID_SLOW=3, INT_MSB=6, PMSB=3, RETENTION_SUPPORT=0 (Retention supported?), SE_CNT=1 (SE counter included?), SPI=1 (SPI mode implemented?), SPI_HW_SS_CTRL=1 (Master _SS hardware control implemented?), SPI_ICSPACE_EXT=1 (SPI inter character space implemented?), SPI_OZMO=0 (OZMO features implemented?), SPI_WAKE_ON_SSL=1 (_SS low detect implemented?), SPI_TX_READY_INT_SRC=70 (SPI TX READY Interrupt), SPI_TX_COMPLETE_INT_SRC=71 (SPI TX COMPLETE Interrupt), SPI_RX_INT_SRC=72 (SPI RX Interrupt), SPI_ERROR_INT_SRC=73 (SPI ERROR Interrupt), TTBIT_EXTENSION=1 (32-bit extension implemented?), I2CM=1 (I2C Master mode implemented?), I2CS=1 (I2C Slave mode implemented?), I2CS_AUTO_ACK=1 (I2C slave automatic acknowledge implemented?), I2CS_GROUP_CMD=1 (I2C slave group command implemented?), I2CS_SDASETUP_CNT_SIZE=8 (I2CS sda setup count size), I2CS_SDASETUP_SIZE=4, I2CS_SUDAT=1 (I2C slave SDA setup implemented?), I2C_FASTMP=1 (I2C fast mode plus implemented?), I2C_HSMODE=1 (USART mode implemented?), I2C_SCLSM_MODE=1 (I2C SCL clock stretch mode implemented?), I2C_SMB_TIMEOUTS=1 (I2C SMBus timeouts implemented?), I2C_TENBIT_ADR=1 (I2C ten bit enabled?), I2C_0_INT_SRC=70 (I2C 0 Interrupt), I2C_1_INT_SRC=71 (I2C 1 Interrupt), I2C_2_INT_SRC=72 (I2C 2 Interrupt), I2C_3_INT_SRC=73 (I2C 3 Interrupt), USART=1 (USART mode implemented?), USART_AUTOBAUD=1 (USART autobaud implemented?), USART_COLDET=1 (USART collision detection implemented?), USART_FLOW_CTRL=1 (USART flow control implemented?), USART_FRAC_BAUD=1 (USART fractional BAUD implemented?), USART_IRDA=1 (USART IrDA implemented?), USART_ISO7816=1 (USART ISO7816 mode implemented?), USART_LIN_MASTER=1 (USART LIN Master mode implemented?), USART_RS485=1 (USART RS485 mode implemented?), USART_SAMPA_EXT=1 (USART sample adjust implemented?), USART_SAMPR_EXT=1 (USART oversampling adjustment implemented?), USART_TX_READY_INT_SRC=70 (USART TX READY Interrupt), USART_TX_COMPLETE_INT_SRC=71 (USART TX COMPLETE Interrupt), USART_RX_INT_SRC=72 (USART RX Interrupt), USART_ERROR_INT_SRC=73 (USART ERROR Interrupt), INSTANCE_ID=98 (Instance index for SERCOM6)
SERCOM7 at 0x43000C00 (SERCOM)
  pins: PAD0 PB21/D set 4 or PB30/C set 5 or PC12/C set 1 3; PAD1 PB20/D set 4 or PB31/C set 5 or PC13/C set 1 3; PAD2 PB18/D set 4 or PC10/D set 3 or PC14/C set 1 or PA30/C set 5; PAD3 PB19/D set 4 or PC11/D set 3 or PC15/C set 1 or PA31/C set 5
  parameters: CLK_REDUCTION=1 (Reduce clock options to pin 1 for SPI and USART), DLY_COMPENSATION=1 (Compensates for a fast DLY50 element. Assuming 20ns), DMA=1 (DMA support implemented?), DMAC_ID_RX=18 (Index of DMA RX trigger), DMAC_ID_TX=19 (Index of DMA TX trigger), FIFO_DEPTH_POWER=1 (2^FIFO_DEPTH_POWER gives rx FIFO depth.), GCLK_ID_CORE=37, GCLK_ID_SLOW=3, INT_MSB=6, PMSB=3, RETENTION_SUPPORT=0 (Retention supported?), SE_CNT=1 (SE counter included?), SPI=1 (SPI mode implemented?), SPI_HW_SS_CTRL=1 (Master _SS hardware control implemented?), SPI_ICSPACE_EXT=1 (SPI inter character space implemented?), SPI_OZMO=0 (OZMO features implemented?), SPI_WAKE_ON_SSL=1 (_SS low detect implemented?), SPI_TX_READY_INT_SRC=74 (SPI TX READY Interrupt), SPI_TX_COMPLETE_INT_SRC=75 (SPI TX COMPLETE Interrupt), SPI_RX_INT_SRC=76 (SPI RX Interrupt), SPI_ERROR_INT_SRC=77 (SPI ERROR Interrupt), TTBIT_EXTENSION=1 (32-bit extension implemented?), I2CM=1 (I2C Master mode implemented?), I2CS=1 (I2C Slave mode implemented?), I2CS_AUTO_ACK=1 (I2C slave automatic acknowledge implemented?), I2CS_GROUP_CMD=1 (I2C slave group command implemented?), I2CS_SDASETUP_CNT_SIZE=8 (I2CS sda setup count size), I2CS_SDASETUP_SIZE=4, I2CS_SUDAT=1 (I2C slave SDA setup implemented?), I2C_FASTMP=1 (I2C fast mode plus implemented?), I2C_HSMODE=1 (USART mode implemented?), I2C_SCLSM_MODE=1 (I2C SCL clock stretch mode implemented?), I2C_SMB_TIMEOUTS=1 (I2C SMBus timeouts implemented?), I2C_TENBIT_ADR=1 (I2C ten bit enabled?), I2C_0_INT_SRC=74 (I2C 0 Interrupt), I2C_1_INT_SRC=75 (I2C 1 Interrupt), I2C_2_INT_SRC=76 (I2C 2 Interrupt), I2C_3_INT_SRC=77 (I2C 3 Interrupt), USART=1 (USART mode implemented?), USART_AUTOBAUD=1 (USART autobaud implemented?), USART_COLDET=1 (USART collision detection implemented?), USART_FLOW_CTRL=1 (USART flow control implemented?), USART_FRAC_BAUD=1 (USART fractional BAUD implemented?), USART_IRDA=1 (USART IrDA implemented?), USART_ISO7816=1 (USART ISO7816 mode implemented?), USART_LIN_MASTER=1 (USART LIN Master mode implemented?), USART_RS485=1 (USART RS485 mode implemented?), USART_SAMPA_EXT=1 (USART sample adjust implemented?), USART_SAMPR_EXT=1 (USART oversampling adjustment implemented?), USART_TX_READY_INT_SRC=74 (USART TX READY Interrupt), USART_TX_COMPLETE_INT_SRC=75 (USART TX COMPLETE Interrupt), USART_RX_INT_SRC=76 (USART RX Interrupt), USART_ERROR_INT_SRC=77 (USART ERROR Interrupt), INSTANCE_ID=99 (Instance index for SERCOM7)
SUPC at 0x40001800
  pins: OUT0 PB01 set 1; OUT1 PB02 set 1; VBAT PB03 set 1
  parameters: BOD12_CALIB_MSB=5, BOD33_CALIB_MSB=5, INSTANCE_ID=6 (Instance index for SUPC)
TC0 at 0x40003800 (TC)
  pins: WO0 PA04/E set 1 or PA08/E set 2 or PB30/E set 3; WO1 PA05/E set 1 or PA09/E set 2 or PB31/E set 3
  parameters: CC_NUM=2, DMAC_ID_OVF=44 (Indexes of DMA Overflow trigger), DMAC_ID_MC0=45 (Indexes of DMA Match/Compare 0 trigger), DMAC_ID_MC1=46 (Indexes of DMA Match/Compare 1 trigger), EXT=0 (Coding of implemented extended features (keep 0 value)), GCLK_ID=9 (Index of Generic Clock), MASTER_SLAVE_MODE=1 (TC type 0 : NA, 1 : Master, 2 : Slave), OW_NUM=2 (Number of Output Waveforms), INSTANCE_ID=14 (Instance index for TC0)
TC1 at 0x40003C00 (TC)
  pins: WO0 PA06/E set 1 or PA10/E set 2; WO1 PA07/E set 1 or PA11/E set 2
  parameters: CC_NUM=2, DMAC_ID_OVF=47 (Indexes of DMA Overflow trigger), DMAC_ID_MC0=48 (Indexes of DMA Match/Compare 0 trigger), DMAC_ID_MC1=49 (Indexes of DMA Match/Compare 1 trigger), EXT=0 (Coding of implemented extended features (keep 0 value)), GCLK_ID=9 (Index of Generic Clock), MASTER_SLAVE_MODE=2 (TC type 0 : NA, 1 : Master, 2 : Slave), OW_NUM=2 (Number of Output Waveforms), INSTANCE_ID=15 (Instance index for TC1)
TC2 at 0x4101A000 (TC)
  pins: WO0 PA12/E set 2 or PA16/E set 3 or PA00/E set 1; WO1 PA01/E set 1 or PA13/E set 2 or PA17/E set 3
  parameters: CC_NUM=2, DMAC_ID_OVF=50 (Indexes of DMA Overflow trigger), DMAC_ID_MC0=51 (Indexes of DMA Match/Compare 0 trigger), DMAC_ID_MC1=52 (Indexes of DMA Match/Compare 1 trigger), EXT=0 (Coding of implemented extended features (keep 0 value)), GCLK_ID=26 (Index of Generic Clock), MASTER_SLAVE_MODE=1 (TC type 0 : NA, 1 : Master, 2 : Slave), OW_NUM=2 (Number of Output Waveforms), INSTANCE_ID=45 (Instance index for TC2)
TC3 at 0x4101C000 (TC)
  pins: WO0 PA18/E set 2 or PA14/E set 1; WO1 PA15/E set 1 or PA19/E set 2
  parameters: CC_NUM=2, DMAC_ID_OVF=53 (Indexes of DMA Overflow trigger), DMAC_ID_MC0=54 (Indexes of DMA Match/Compare 0 trigger), DMAC_ID_MC1=55 (Indexes of DMA Match/Compare 1 trigger), EXT=0 (Coding of implemented extended features (keep 0 value)), GCLK_ID=26 (Index of Generic Clock), MASTER_SLAVE_MODE=2 (TC type 0 : NA, 1 : Master, 2 : Slave), OW_NUM=2 (Number of Output Waveforms), INSTANCE_ID=46 (Instance index for TC3)
TC4 at 0x42001400 (TC)
  pins: WO0 PA22/E set 3 or PB08/E set 1 or PB12/E set 2; WO1 PA23/E set 3 or PB09/E set 1 or PB13/E set 2
  parameters: CC_NUM=2, DMAC_ID_OVF=56 (Indexes of DMA Overflow trigger), DMAC_ID_MC0=57 (Indexes of DMA Match/Compare 0 trigger), DMAC_ID_MC1=58 (Indexes of DMA Match/Compare 1 trigger), EXT=0 (Coding of implemented extended features (keep 0 value)), GCLK_ID=30 (Index of Generic Clock), MASTER_SLAVE_MODE=1 (TC type 0 : NA, 1 : Master, 2 : Slave), OW_NUM=2 (Number of Output Waveforms), INSTANCE_ID=69 (Instance index for TC4)
TC5 at 0x42001800 (TC)
  pins: WO0 PA24/E set 3 or PB10/E set 1 or PB14/E set 2; WO1 PA25/E set 3 or PB11/E set 1 or PB15/E set 2
  parameters: CC_NUM=2, DMAC_ID_OVF=59 (Indexes of DMA Overflow trigger), DMAC_ID_MC0=60 (Indexes of DMA Match/Compare 0 trigger), DMAC_ID_MC1=61 (Indexes of DMA Match/Compare 1 trigger), EXT=0 (Coding of implemented extended features (keep 0 value)), GCLK_ID=30 (Index of Generic Clock), MASTER_SLAVE_MODE=2 (TC type 0 : NA, 1 : Master, 2 : Slave), OW_NUM=2 (Number of Output Waveforms), INSTANCE_ID=70 (Instance index for TC5)
TC6 at 0x43001400 (TC)
  pins: WO0 PA30/E set 2 or PB02/E set 3 or PB16/E set 1; WO1 PA31/E set 3 or PB03/E set 1 or PB17/E set 2
  parameters: CC_NUM=2, DMAC_ID_OVF=62 (Indexes of DMA Overflow trigger), DMAC_ID_MC0=63 (Indexes of DMA Match/Compare 0 trigger), DMAC_ID_MC1=64 (Indexes of DMA Match/Compare 1 trigger), EXT=0 (Coding of implemented extended features (keep 0 value)), GCLK_ID=39 (Index of Generic Clock), MASTER_SLAVE_MODE=1 (TC type 0 : NA, 1 : Master, 2 : Slave), OW_NUM=2 (Number of Output Waveforms), INSTANCE_ID=101 (Instance index for TC6)
TC7 at 0x43001800 (TC)
  pins: WO0 PA20/E set 1 or PB00/E set 3 or PB22/E set 2; WO1 PA21/E set 1 or PB01/E set 3 or PB23/E set 2
  parameters: CC_NUM=2, DMAC_ID_OVF=65 (Indexes of DMA Overflow trigger), DMAC_ID_MC0=66 (Indexes of DMA Match/Compare 0 trigger), DMAC_ID_MC1=67 (Indexes of DMA Match/Compare 1 trigger), EXT=0 (Coding of implemented extended features (keep 0 value)), GCLK_ID=39 (Index of Generic Clock), MASTER_SLAVE_MODE=2 (TC type 0 : NA, 1 : Master, 2 : Slave), OW_NUM=2 (Number of Output Waveforms), INSTANCE_ID=102 (Instance index for TC7)
TCC0 at 0x41016000 (TCC)
  pins: WO0 PA20/G set 6 or PB12/G set 5 or PA08/F set 1 or PC10/F set 3 or PC16/F set 4; WO1 PA21/G set 6 or PB13/G set 5 or PA09/F set 1 or PC11/F set 3 or PC17/F set 4; WO2 PA22/G set 6 or PB14/G set 5 or PA10/F set 1 or PC12/F set 3 or PC18/F set 4; WO3 PA23/G set 6 or PB15/G set 5 or PA11/F set 1 or PC13/F set 3 or PC19/F set 4; WO4 PA16/G set 5 or PB16/G set 6 or PB10/F set 1 or PC14/F set 3 or PC20/F set 4; WO5 PA17/G set 5 or PB17/G set 6 or PB11/F set 1 or PC15/F set 3 or PC21/F set 4; WO6 PA18/G set 3 or PB30/G set 4 or PA12/F set 1; WO7 PA19/G set 3 or PB31/G set 4 or PA13/F set 1
  parameters: CC_NUM=6 (Number of Compare/Capture units), DITHERING=1 (Dithering feature implemented), DMAC_ID_OVF=22 (DMA overflow/underflow/retrigger trigger), DMAC_ID_MC{n}={n+23} (Indexes of DMA Match/Compare {n} trigger) (n=0..5), DTI=1 (Dead-Time-Insertion feature implemented), EXT=31 (Coding of implemented extended features), GCLK_ID=25 (Index of Generic Clock), MASTER_SLAVE_MODE=1 (TCC type 0 : NA, 1 : Master, 2 : Slave), OTMX=1 (Output Matrix feature implemented), OW_NUM=8 (Number of Output Waveforms), PG=1 (Pattern Generation feature implemented), SIZE=24, SWAP=1 (DTI outputs swap feature implemented), INSTANCE_ID=43 (Instance index for TCC0)
TCC1 at 0x41018000 (TCC)
  pins: WO0 PB10/G set 4 or PC14/G set 5 or PA16/F set 1 or PB18/F set 3; WO1 PB11/G set 4 or PC15/G set 5 or PA17/F set 1 or PB19/F set 3; WO2 PA12/G set 4 or PA14/G set 5 or PA18/F set 1 or PB20/F set 2; WO3 PA13/G set 4 or PA15/G set 5 or PA19/F set 1 or PB21/F set 2; WO4 PA08/G set 3 or PC10/G set 4 or PA20/F set 1; WO5 PA09/G set 3 or PC11/G set 4 or PA21/F set 1; WO6 PA10/G set 2 or PC12/G set 3 or PA22/F set 1; WO7 PA11/G set 2 or PC13/G set 3 or PA23/F set 1
  parameters: CC_NUM=4 (Number of Compare/Capture units), DITHERING=1 (Dithering feature implemented), DMAC_ID_OVF=29 (DMA overflow/underflow/retrigger trigger), DMAC_ID_MC0=30 (Indexes of DMA Match/Compare 0 trigger), DMAC_ID_MC1=31 (Indexes of DMA Match/Compare 1 trigger), DMAC_ID_MC2=32 (Indexes of DMA Match/Compare 2 trigger), DMAC_ID_MC3=33 (Indexes of DMA Match/Compare 3 trigger), DTI=1 (Dead-Time-Insertion feature implemented), EXT=31 (Coding of implemented extended features), GCLK_ID=25 (Index of Generic Clock), MASTER_SLAVE_MODE=2 (TCC type 0 : NA, 1 : Master, 2 : Slave), OTMX=1 (Output Matrix feature implemented), OW_NUM=8 (Number of Output Waveforms), PG=1 (Pattern Generation feature implemented), SIZE=24, SWAP=1 (DTI outputs swap feature implemented), INSTANCE_ID=44 (Instance index for TCC1)
TCC2 at 0x42000C00 (TCC)
  pins: WO0 PA14/F set 1 or PA30/F set 2; WO1 PA15/F set 1 or PA31/F set 2; WO2 PA24/F set 1 or PB02/F set 2
  parameters: CC_NUM=3 (Number of Compare/Capture units), DITHERING=0 (Dithering feature implemented), DMAC_ID_OVF=34 (DMA overflow/underflow/retrigger trigger), DMAC_ID_MC0=35 (Indexes of DMA Match/Compare 0 trigger), DMAC_ID_MC1=36 (Indexes of DMA Match/Compare 1 trigger), DMAC_ID_MC2=37 (Indexes of DMA Match/Compare 2 trigger), DTI=0 (Dead-Time-Insertion feature implemented), EXT=1 (Coding of implemented extended features), GCLK_ID=29 (Index of Generic Clock), MASTER_SLAVE_MODE=0 (TCC type 0 : NA, 1 : Master, 2 : Slave), OTMX=1 (Output Matrix feature implemented), OW_NUM=3 (Number of Output Waveforms), PG=0 (Pattern Generation feature implemented), SIZE=16, SWAP=0 (DTI outputs swap feature implemented), INSTANCE_ID=67 (Instance index for TCC2)
TCC3 at 0x42001000 (TCC)
  pins: WO0 PB12/F set 1 or PB16/F set 2; WO1 PB13/F set 1 or PB17/F set 2
  parameters: CC_NUM=2 (Number of Compare/Capture units), DITHERING=0 (Dithering feature implemented), DMAC_ID_OVF=38 (DMA overflow/underflow/retrigger trigger), DMAC_ID_MC0=39 (Indexes of DMA Match/Compare 0 trigger), DMAC_ID_MC1=40 (Indexes of DMA Match/Compare 1 trigger), DTI=0 (Dead-Time-Insertion feature implemented), EXT=0 (Coding of implemented extended features), GCLK_ID=29 (Index of Generic Clock), MASTER_SLAVE_MODE=0 (TCC type 0 : NA, 1 : Master, 2 : Slave), OTMX=0 (Output Matrix feature implemented), OW_NUM=2 (Number of Output Waveforms), PG=0 (Pattern Generation feature implemented), SIZE=16, SWAP=0 (DTI outputs swap feature implemented), INSTANCE_ID=68 (Instance index for TCC3)
TCC4 at 0x43001000 (TCC)
  pins: WO0 PB14/F set 1 or PB30/F set 2; WO1 PB15/F set 1 or PB31/F set 2
  parameters: CC_NUM=2 (Number of Compare/Capture units), DITHERING=0 (Dithering feature implemented), DMAC_ID_OVF=41 (DMA overflow/underflow/retrigger trigger), DMAC_ID_MC0=42 (Indexes of DMA Match/Compare 0 trigger), DMAC_ID_MC1=43 (Indexes of DMA Match/Compare 1 trigger), DTI=0 (Dead-Time-Insertion feature implemented), EXT=0 (Coding of implemented extended features), GCLK_ID=38 (Index of Generic Clock), MASTER_SLAVE_MODE=0 (TCC type 0 : NA, 1 : Master, 2 : Slave), OTMX=0 (Output Matrix feature implemented), OW_NUM=2 (Number of Output Waveforms), PG=0 (Pattern Generation feature implemented), SIZE=16, SWAP=0 (DTI outputs swap feature implemented), INSTANCE_ID=100 (Instance index for TCC4)
TRNG at 0x42002800
  parameters: INSTANCE_ID=74 (Instance index for TRNG)
USB at 0x41000000
  pins: DM PA24/H; DP PA25/H; SOF_1KHZ PA23/H set 1 or PB22/H set 2
  parameters: AHB_2_USB_FIFO_DEPTH=4 (bytes number, should be at least 2, and 2^n (4,8,16 ...)), AHB_2_USB_RD_DATA_BITS=8 (8, 16 or 32, here : 8-bits is required as UTMI interface should work in 8-bits mode), AHB_2_USB_WR_DATA_BITS=32 (8, 16 or 32 : here, AHB transfer is made in word mode), AHB_2_USB_WR_THRESHOLD=2 (as soon as there are N bytes-free inside the fifo, ahb read transfer is requested), DATA_BUS_16_8=0 (UTMI/SIE data bus size : 0 -> 8 bits, 1 -> 16 bits), EPNUM=8 (parameter for rtl : max of ENDPOINT and PIPE NUM), EPT_NUM=8 (Number of USB end points), GCLK_ID=10 (Index of Generic Clock), INITIAL_CONTROL_QOS=3 (CONTROL QOS RESET value), INITIAL_DATA_QOS=3 (DATA QOS RESET value), MISSING_SOF_DET_IMPLEMENTED=1 (48 mHz xPLL feature implemented), PIPE_NUM=8 (Number of USB pipes), SYSTEM_CLOCK_IS_CKUSB=0 (Dual (1'b0) or Single (1'b1) clock system), USB_2_AHB_FIFO_DEPTH=4 (bytes number, should be at least 2, and 2^n (4,8,16 ...)), USB_2_AHB_RD_DATA_BITS=16 (8, 16 or 32, here : 8-bits is required as UTMI interface should work in 8-bits mode), USB_2_AHB_RD_THRESHOLD=2 (as soon as there are 16 bytes-free inside the fifo, ahb read transfer is requested), USB_2_AHB_WR_DATA_BITS=8 (8, 16 or 32 : here : 8-bits is required as UTMI interface should work in 8-bits mode), INSTANCE_ID=32 (Instance index for USB)
WDT at 0x40002000
  parameters: INSTANCE_ID=8 (Instance index for WDT)
CoreDebug at 0xE000EDF0
DWT at 0xE0001000
ETM at 0xE0041000
FPU at 0xE000EF30
ITM at 0xE0000000
MPU at 0xE000ED90
NVIC at 0xE000E100
  parameters: NUM_IRQ=137 (Number of interrupt requests), __NVIC_PRIO_BITS=3 (Number of NVIC interrupt priority bits)
SysTick at 0xE000E010
SystemControl at 0xE000E000
TPIU at 0xE0040000
  pins: TRACECLK PC27/H; TRACED0 PC28/H; TRACED1 PC26/H; TRACED2 PC25/H; TRACED3 PC24/H
  parameters: GCLK_ID=47 (Index of Trace Generic Clock)

## Interrupts
-15 Reset — Reset Vector, invoked on Power up and warm reset
-14 NonMaskableInt — Non maskable Interrupt, cannot be stopped or preempted
-13 HardFault — Hard Fault, all classes of Fault
-12 MemoryManagement — Memory Management, MPU mismatch, including Access Violation and No Match
-11 BusFault — Bus Fault, Pre-Fetch-, Memory Access Fault, other address/memory related Fault
-10 UsageFault — Usage Fault, i.e. Undef Instruction, Illegal State Transition
-5 SVCall — System Service Call via SVC instruction
-4 DebugMonitor
-2 PendSV — Pendable request for system service
-1 SysTick — System Tick Timer
0 PM — Power Manager
1 MCLK — Main Clock
2 OSCCTRL_XOSC0 (OSCCTRL) — External Oscillator 0
3 OSCCTRL_XOSC1 (OSCCTRL) — External Oscillator 1
4 OSCCTRL_DFLL (OSCCTRL) — Digital Frequency Locked Loop
5 OSCCTRL_DPLL0 (OSCCTRL) — Digital Phase Locked Loop 0
6 OSCCTRL_DPLL1 (OSCCTRL) — Digital Phase Locked Loop 1
7 OSC32KCTRL — 32Khz Oscillator Controller
8 SUPC_OTHER (SUPC) — Suppyly controller
9 SUPC_BODDET (SUPC) — Brown Out Detection
10 WDT — Watch Dog Timer
11 RTC — Real Time Counter
{n+12} EIC_EXTINT_{n} (EIC) (n=0..15) — EIC Channel {n}
28 FREQM — Frequency Meter
29 NVMCTRL_0 (NVMCTRL) — Non-Volatile Memory Controller
30 NVMCTRL_1 (NVMCTRL) — NVMCTRL SmartEEPROM Interrupts
31 DMAC_0 (DMAC) — DMA Channel 0
32 DMAC_1 (DMAC) — DMA Channel 1
33 DMAC_2 (DMAC) — DMA Channel 2
34 DMAC_3 (DMAC) — DMA Channel 3
35 DMAC_OTHER (DMAC) — DMA Channel 4..X
36 EVSYS_0 (EVSYS) — Event System Channel 0
37 EVSYS_1 (EVSYS) — Event System Channel 1
38 EVSYS_2 (EVSYS) — Event System Channel 2
39 EVSYS_3 (EVSYS) — Event System Channel 3
40 EVSYS_OTHER (EVSYS) — Event System Channel 4..X
41 PAC — Peripheral Access Controller
45 RAMECC — RAM Error Correction Code
{4n+46} SERCOM{n}_0 (SERCOM{n}) (n=0..7) — Serial Communication Interface {n}
{4n+47} SERCOM{n}_1 (SERCOM{n}) (n=0..7) — Serial Communication Interface {n}
{4n+48} SERCOM{n}_2 (SERCOM{n}) (n=0..7) — Serial Communication Interface {n}
{4n+49} SERCOM{n}_OTHER (SERCOM{n}) (n=0..7) — Serial Communication Interface {n}
78 CAN0 — Controller Area Network 0
79 CAN1 — Controller Area Network 1
80 USB_OTHER (USB) — Universal Serial Bus
81 USB_SOF_HSOF (USB) — USB Start of Frame
82 USB_TRCPT0 (USB) — USB Transfer Complete 0
83 USB_TRCPT1 (USB) — USB Transfer Complete 1
84 GMAC — Ethernet MAC
85 TCC0_OTHER (TCC0) — Timer Counter Control 0
86 TCC0_MC0 (TCC0) — TCC Match/Compare 0
87 TCC0_MC1 (TCC0) — TCC Match/Compare 1
88 TCC0_MC2 (TCC0) — TCC Match/Compare 2
89 TCC0_MC3 (TCC0) — TCC Match/Compare 3
90 TCC0_MC4 (TCC0) — TCC Match/Compare 4
91 TCC0_MC5 (TCC0) — TCC Match/Compare 5
92 TCC1_OTHER (TCC1) — Timer Counter Control 1
93 TCC1_MC0 (TCC1) — TCC Match/Compare 0
94 TCC1_MC1 (TCC1) — TCC Match/Compare 1
95 TCC1_MC2 (TCC1) — TCC Match/Compare 2
96 TCC1_MC3 (TCC1) — TCC Match/Compare 3
97 TCC2_OTHER (TCC2) — Timer Counter Control 2
98 TCC2_MC0 (TCC2) — TCC Match/Compare 0
99 TCC2_MC1 (TCC2) — TCC Match/Compare 1
100 TCC2_MC2 (TCC2) — TCC Match/Compare 2
101 TCC3_OTHER (TCC3) — Timer Counter Control 3
102 TCC3_MC0 (TCC3) — TCC Match/Compare 0
103 TCC3_MC1 (TCC3) — TCC Match/Compare 1
104 TCC4_OTHER (TCC4) — Timer Counter Control 4
105 TCC4_MC0 (TCC4) — TCC Match/Compare 0
106 TCC4_MC1 (TCC4) — TCC Match/Compare 1
{n+107} TC{n} (n=0..7) — Timer Counter {n}
115 PDEC_OTHER (PDEC) — Position Decoder
116 PDEC_MC0 (PDEC) — PDEC Match/Compare 0
117 PDEC_MC1 (PDEC) — PDEC Match Compare 1
118 ADC0_OTHER (ADC0) — Analog To Digital Converter 0
119 ADC0_RESRDY (ADC0) — ADC0 Result Ready
120 ADC1_OTHER (ADC1) — Analog To Digital Converter 1
121 ADC1_RESRDY (ADC1) — ADC1 Result Ready
122 AC — Analog Comparator
123 DAC_OTHER (DAC) — Digital to Analog Converter
124 DAC_EMPTY_0 (DAC) — DAC Buffer 0 Empty
125 DAC_EMPTY_1 (DAC) — DAC Buffer 1 Empty
126 DAC_RESRDY_0 (DAC) — DAC Filter 0 Result Ready
127 DAC_RESRDY_1 (DAC) — DAC Filter 1 Result Ready
128 I2S — Inter-IC Sound Interface
129 PCC — Parallel Capture Controller
130 AES — Advanced Encryption Standard
131 TRNG — True Random Generator
132 ICM — Integrity Check Monitor
133 PUKCC — Public-Key Cryptography Controller
134 QSPI — Quad SPI interface
135 SDHC0 — SD/MMC Host Controller 0
136 SDHC1 — SD/MMC Host Controller 1

## Event generators
1 OSCCTRL_XOSC_FAIL_0, 2 OSCCTRL_XOSC_FAIL_1, 3 OSC32KCTRL_XOSC32K_FAIL, {n+4} RTC_PER_{n} (n=0..7), {n+12} RTC_CMP_{n} (n=0..3), 16 RTC_TAMPER, 17 RTC_OVF, {n+18} EIC_EXTINT_{n} (n=0..15), {n+34} DMAC_CH_{n} (n=0..3), 38 PAC_ACCERR, 41 TCC0_OVF, 42 TCC0_TRG, 43 TCC0_CNT, {n+44} TCC0_MC_{n} (n=0..5), 50 TCC1_OVF, 51 TCC1_TRG, 52 TCC1_CNT, {n+53} TCC1_MC_{n} (n=0..3), 57 TCC2_OVF, 58 TCC2_TRG, 59 TCC2_CNT, {n+60} TCC2_MC_{n} (n=0..2), 63 TCC3_OVF, 64 TCC3_TRG, 65 TCC3_CNT, 66 TCC3_MC_0, 67 TCC3_MC_1, 68 TCC4_OVF, 69 TCC4_TRG, 70 TCC4_CNT, 71 TCC4_MC_0, 72 TCC4_MC_1, {3n+73} TC{n}_OVF (n=0..7), {3n+74} TC{n}_MC_0 (n=0..7), {3n+75} TC{n}_MC_1 (n=0..7), 97 PDEC_OVF, 98 PDEC_ERR, 99 PDEC_DIR, 100 PDEC_VLC, 101 PDEC_MC_0, 102 PDEC_MC_1, 103 ADC0_RESRDY, 104 ADC0_WINMON, 105 ADC1_RESRDY, 106 ADC1_WINMON, 107 AC_COMP_0, 108 AC_COMP_1, 109 AC_WIN_0, 110 DAC_EMPTY_0, 111 DAC_EMPTY_1, 112 DAC_RESRDY_0, 113 DAC_RESRDY_1, 114 GMAC_TSU_CMP, 115 TRNG_READY, {n+116} CCL_LUTOUT_{n} (n=0..3)

## Event users
0 RTC_TAMPER, {n+1} PORT_EV_{n} (n=0..3), {n+5} DMAC_CH_{n} (n=0..7), 14 CM4_TRACE_START, 15 CM4_TRACE_STOP, 16 CM4_TRACE_TRIG, 17 TCC0_EV_0, 18 TCC0_EV_1, {n+19} TCC0_MC_{n} (n=0..5), 25 TCC1_EV_0, 26 TCC1_EV_1, {n+27} TCC1_MC_{n} (n=0..3), 31 TCC2_EV_0, 32 TCC2_EV_1, {n+33} TCC2_MC_{n} (n=0..2), 36 TCC3_EV_0, 37 TCC3_EV_1, 38 TCC3_MC_0, 39 TCC3_MC_1, 40 TCC4_EV_0, 41 TCC4_EV_1, 42 TCC4_MC_0, 43 TCC4_MC_1, {n+44} TC{n}_EVU (n=0..7), {n+52} PDEC_EVU_{n} (n=0..2), 55 ADC0_START, 56 ADC0_SYNC, 57 ADC1_START, 58 ADC1_SYNC, 59 AC_SOC_0, 60 AC_SOC_1, 61 DAC_START_0, 62 DAC_START_1, {n+63} CCL_LUTIN_{n} (n=0..3)

## Properties
SIGNATURES: DSU_DID=0x61820501

## Pinouts (pin number, pad)
TQFP100: 1 PA00, 2 PA01, 3 PC00, 4 PC01, 5 PC02, 6 PC03, 7 PA02, 8 PA03, 9 PB04, 10 PB05, 11 AVSS, 12 AVDD, 13 PB06, 14 PB07, 15 PB08, 16 PB09, 17 PA04, 18 PA05, 19 PA06, 20 PA07, 21 PC05, 22 PC06, 23 PC07, 24 VSS, 25 VDD, 26 PA08, 27 PA09, 28 PA10, 29 PA11, 30 VDD, 31 VSS, 32 PB10, 33 PB11, 34 PB12, 35 PB13, 36 PB14, 37 PB15, 38 VSS, 39 VDD, 40 PC10, 41 PC11, 42 PC12, 43 PC13, 44 PC14, 45 PC15, 46 PA12, 47 PA13, 48 PA14, 49 PA15, 50 VSS, 51 VDD, 52 PA16, 53 PA17, 54 PA18, 55 PA19, 56 PC16, 57 PC17, 58 PC18, 59 PC19, 60 PC20, 61 PC21, 62 VSS, 63 VDD, 64 PB16, 65 PB17, 66 PB18, 67 PB19, 68 PB20, 69 PB21, 70 PA20, 71 PA21, 72 PA22, 73 PA23, 74 PA24, 75 PA25, 76 VSS, 77 VDD, 78 PB22, 79 PB23, 80 PB24, 81 PB25, 82 PC24, 83 PC25, 84 PC26, 85 PC27, 86 PC28, 87 PA27, 88 RESET_N, 89 VDDCORE, 90 VSS, 91 VSW, 92 VDD, 93 PA30, 94 PA31, 95 PB30, 96 PB31, 97 PB00, 98 PB01, 99 PB02, 100 PB03, MOSI PB26, SCK PB27, MISO PB28, CS PB29, GPIO PC04
TFBGA100: A1 PB30, A2 VSS, A3 VDD, A4 VSW, A5 VDDCORE, A6 PC27, A7 PC26, A8 VSS, A9 VDD, A10 PA20, B1 PC03, B2 PB03, B3 PB01, B4 PB00, B5 PA30, B6 PC28, B7 PC25, B8 PB23, B9 PB22, B10 PA22, C1 PB04, C2 PC00, C3 PB31, C4 PA31, C5 RESET_N, C6 PA27, C7 PC24, C8 PB24, C9 PA23, C10 PA25, D1 PB07, D2 PA00, D3 PC01, D4 PB02, D5 VDD, D6 VSS, D7 PB25, D8 PB20, D9 PB17, D10 PA24, E1 PB09, E2 PA01, E3 PC02, E4 VSS, E5 VDD, E6 PC21, E7 PB19, E8 PB21, E9 PB16, E10 PA19, F1 PA04, F2 PA02, F3 PB05, F4 PA03, F5 PB12, F6 PC11, F7 PB18, F8 PA21, F9 VSS, F10 VDD, G1 PA05, G2 PB06, G3 AVSS, G4 AVDD, G5 PB13, G6 PC12, G7 PC18, G8 PC19, G9 PC20, G10 PA18, H1 PA07, H2 PA06, H3 PB08, H4 VSS, H5 VDD, H6 PC13, H7 PC14, H8 PC17, H9 PC16, H10 PA17, J1 PC05, J2 PC06, J3 PA09, J4 PA11, J5 PB10, J6 PB14, J7 PA14, J8 PA15, J9 PA16, J10 VSS, K1 PC07, K2 PA10, K3 PA08, K4 PB11, K5 PB15, K6 PC10, K7 PC15, K8 PA13, K9 PA12, K10 VDD, MOSI PB26, SCK PB27, MISO PB28, CS PB29, GPIO PC04

## Notices in the file
Copyright (c) 2021 Microchip Technology Inc.
SPDX-License-Identifier: Apache-2.0
Licensed under the Apache License, Version 2.0 (the "License");
you may not use this file except in compliance with the License.
You may obtain a copy of the License at
http://www.apache.org/licenses/LICENSE-2.0
Unless required by applicable law or agreed to in writing, software
distributed under the License is distributed on an "AS IS" BASIS,
WITHOUT WARRANTIES OR CONDITIONS OF ANY KIND, either express or implied.
See the License for the specific language governing permissions and
limitations under the License.
