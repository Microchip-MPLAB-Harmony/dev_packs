# PIC32CZ2051CA90208 register map
Vendor: Microchip Technology; Series: PIC32CZCA90; File version: 0
Microchip PIC32CZ2051CA90208 Microcontroller
CPU: CM7 r1p1, selectable endian, MPU, FPU, 3 interrupt priority bits
Registers are 32-bit, read-write, reset 0x0 unless marked. A register's access mark holds for its fields unless they carry their own. Offsets are from the block's base; lines under a group give offsets from that group; [hi:lo] are bit positions; {n}, {i} and the like mark numbered series; 'fields as' and 'values as' point back to an identical list; <NAME> marks a mode.

## Memory map
0x40000000 PORT_AHB size 0x380
0x44000000 DSU size 0x2000 — Device Service Unit
0x44002000 FCW size 0xD0 — Flash Write Control (FCW)
0x44004000 FCR size 0x64 — Flash Read Controller (FCR)
0x44010000 PM size 0xA — Power Manager
0x44020000 SUPC size 0x30 — Supply Controller
0x44030000 RSTC size 0x8 — Reset Controller
0x44040000 OSCCTRL size 0x8C — Oscillators Control
0x44042000 OSC32KCTRL size 0x20 — 32kHz Oscillators Control
0x44050000 GCLK size 0x210 — Generic Clock Generator
0x44052000 MCLK size 0x60 — Main Clock
0x44060000 FREQM size 0x28 — Frequency Meter
0x44070000 WDT size 0xD — Watchdog Timer
0x44072000 RTC size 0x70 — Real-Time Counter
0x44080000 PRM size 0x4 — Boot ROM Controller
0x44800000 EIC size 0x3C — External Interrupt Controller
0x44810000 PAC size 0x40 — Peripheral Access Controller
0x44820000 DRMTCM size 0x50 — DRM TCM ECC
0x44822000 MCRAMC size 0x2C — Multi-Channel RAM Controller
0x44824000 TRAM size 0x9120 — TrustRAM
0x44840000 PORT size 0x380 — Port Module
0x44850000 DMA size 0x730 — Direct Memory Access Controller
0x44860000 EVSYS size 0x237 — Event System Interface
0x44870000 TRNG size 0x24 — True Random Generator
0x45000000 SERCOM7 size 0x38
0x45002000 SERCOM8 size 0x38
0x45004000 SERCOM9 size 0x38
0x45010000 TCC0 size 0x90 — Timer Counter for Control Applications
0x45012000 TCC1 size 0x90
0x45014000 TCC2 size 0x90
0x45030000 SPI_IXS1 size 0x3C
0x45060000 CAN0 size 0x104 — Control Area Network
0x45062000 CAN4 size 0x104
0x45070000 ETH size 0x1820 — Ethernet Controller
0x45800000 SERCOM2 size 0x38
0x45802000 SERCOM3 size 0x38
0x45804000 SERCOM5 size 0x38
0x45806000 SERCOM6 size 0x38
0x45810000 TCC3 size 0x90
0x45812000 TCC4 size 0x90
0x45860000 CAN3 size 0x104
0x458A0000 SDMMC0 size 0x238 — SD/MMC Host Controller
0x458B0000 EBI size 0xEC — External Bus Interface
0x458C0000 MLB size 0x7E0 — Media Local Bus
0x46000000 SERCOM0 size 0x38 — Serial Communication Interface
0x46002000 SERCOM1 size 0x38
0x46004000 SERCOM4 size 0x38
0x46010000 TCC5 size 0x90
0x46012000 TCC6 size 0x90
0x46030000 SPI_IXS0 size 0x3C — Audio SPI with 8 channels compatibilty
0x46060000 CAN1 size 0x104
0x46062000 CAN2 size 0x104
0x460A0000 SDMMC1 size 0x238
0x46810000 TCC7 size 0x90
0x46812000 TCC8 size 0x90
0x46814000 TCC9 size 0x90
0x46820000 ADC size 0x16C — ADC Controller
0x46822000 AC size 0x40 — Analog Comparator Controller
0x46828000 PTC — Peripheral Touch Controller
0x46860000 CAN5 size 0x104
0x4F008000 SQI0 size 0x16C — Polaris Serial Quad Interface SIB
0x4F009000 SQI1 size 0x16C
0x4F010000 USBHS0 size 0x1554 — USB High Speed
0x4F012000 USBHS1 size 0x1554
0x4F018000 HSM size 0x15C — Hardware Security Module
0xE0001000 DWT size 0x1000 — Data Watchpoint and Trace Register
0xE0002000 FPB size 0x1000 — Flash Patch and Breakpoint
0xE000E000 NVIC size 0x456 — Nested Vectored Interrupt Controller
0xE000E000 SystemControl size 0xD8C — System Control Registers
0xE000E010 SysTick size 0x10 — System timer
0xE000ED00 CoreDebug size 0x100
0xE000ED90 MPU size 0x2C — Memory Protection Unit
0xE000EF30 FPU size 0x1C — Floating Point Unit
0xE0040000 TPI size 0xFD0 — Trace Port Interface Register
0xE0041000 ETM size 0x1000 — Embedded Trace Macrocell
0xE0041000 ITM size 0xF00 — Instrumentation Trace Macrocell

## Interrupts
0 FCW
1 FCR_ECCERR (FCR)
2 FCR_CRC_FAULT (FCR)
3 PM
4 SUPC
5 OSCCTRL_FAIL (OSCCTRL)
6 OSCCTRL_XOSCRDY (OSCCTRL)
7 OSCCTRL_DFLLRDY (OSCCTRL)
8 OSCCTRL_OTHER (OSCCTRL)
9 OSCCTRL_LOCK (OSCCTRL)
10 OSC32KCTRL_FAIL (OSC32KCTRL)
11 OSC32KCTRL_RDY (OSC32KCTRL)
12 MCLK
13 FREQM
14 WDT
15 RTC_TAMPER (RTC)
16 RTC_OVF (RTC)
17 RTC_PERIOD (RTC)
18 RTC_COMPARE (RTC)
{n+19} EIC_EXTINT_{n} (EIC) (n=0..15)
35 PAC
36 DRMTCM
37 MCRAMC
38 TRAM
39 DMA_PRI3 (DMA)
40 DMA_PRI2 (DMA)
41 DMA_PRI1 (DMA)
42 DMA_PRI0 (DMA)
{n+43} EVSYS_{n} (EVSYS) (n=0..11)
{7n+55} SERCOM{n}_6 (SERCOM{n}) (n=0..9)
{7n+56} SERCOM{n}_5 (SERCOM{n}) (n=0..9)
{7n+57} SERCOM{n}_0 (SERCOM{n}) (n=0..9)
{7n+58} SERCOM{n}_1 (SERCOM{n}) (n=0..9)
{7n+59} SERCOM{n}_2 (SERCOM{n}) (n=0..9)
{7n+60} SERCOM{n}_3 (SERCOM{n}) (n=0..9)
{7n+61} SERCOM{n}_4 (SERCOM{n}) (n=0..9)
125 TCC0_OTHER (TCC0)
126 TCC0_CNT_TRIG (TCC0)
{n+127} TCC0_MC{n} (TCC0) (n=0..7)
135 TCC1_OTHER (TCC1)
136 TCC1_CNT_TRIG (TCC1)
{n+137} TCC1_MC{n} (TCC1) (n=0..7)
145 TCC2_OTHER (TCC2)
146 TCC2_CNT_TRIG (TCC2)
147 TCC2_MC0 (TCC2)
148 TCC2_MC1 (TCC2)
149 TCC2_MC2 (TCC2)
150 TCC2_MC3 (TCC2)
151 TCC2_MC4 (TCC2)
152 TCC2_MC5 (TCC2)
153 TCC3_OTHER (TCC3)
154 TCC3_CNT_TRIG (TCC3)
155 TCC3_MC0 (TCC3)
156 TCC3_MC1 (TCC3)
157 TCC4_OTHER (TCC4)
158 TCC4_CNT_TRIG (TCC4)
159 TCC4_MC0 (TCC4)
160 TCC4_MC1 (TCC4)
161 TCC5_OTHER (TCC5)
162 TCC5_CNT_TRIG (TCC5)
163 TCC5_MC0 (TCC5)
164 TCC5_MC1 (TCC5)
165 TCC6_OTHER (TCC6)
166 TCC6_CNT_TRIG (TCC6)
167 TCC6_MC0 (TCC6)
168 TCC6_MC1 (TCC6)
169 TCC7_OTHER (TCC7)
170 TCC7_CNT_TRIG (TCC7)
171 TCC7_MC0 (TCC7)
172 TCC7_MC1 (TCC7)
173 TCC8_OTHER (TCC8)
174 TCC8_CNT_TRIG (TCC8)
175 TCC8_MC0 (TCC8)
176 TCC8_MC1 (TCC8)
177 TCC9_OTHER (TCC9)
178 TCC9_CNT_TRIG (TCC9)
179 TCC9_MC0 (TCC9)
180 TCC9_MC1 (TCC9)
181 TCC9_MC2 (TCC9)
182 TCC9_MC3 (TCC9)
183 TCC9_MC4 (TCC9)
184 TCC9_MC5 (TCC9)
185 ADC_GLOBAL (ADC)
186 ADC_CORE1 (ADC)
187 ADC_CORE2 (ADC)
188 ADC_CORE3 (ADC)
189 ADC_CORE4 (ADC)
190 AC
191 PTC
192 SPI_IXS0
193 SPI_IXS1
194 CAN0
195 CAN1
196 CAN2
197 CAN3
198 CAN4
199 CAN5
202 ETH_PRI_Q_0 (ETH)
203 ETH_PRI_Q_1 (ETH)
204 ETH_PRI_Q_2 (ETH)
205 ETH_PRI_Q_3 (ETH)
206 ETH_PRI_Q_4 (ETH)
207 ETH_PRI_Q_5 (ETH)
208 SQI0
209 SQI1
210 TRNG
211 SDMMC0
212 SDMMC1
213 USBHS0
214 USBHS1
215 HSM_TAMPER (HSM)
216 HSM_TXINT (HSM)
217 HSM_RXINT (HSM)
218 MLB_GENERAL (MLB)
219 MLB_BUSREQ (MLB)

## Notices in the file
Copyright (c) 2017 Microchip Technology Inc.
SPDX-License-Identifier: Apache-2.0
Licensed under the Apache License, Version 2.0 (the "License");
you may not use this file except in compliance with the License.
You may obtain a copy of the License at
http://www.apache.org/licenses/LICENSE-2.0
Unless required by applicable law or agreed to in writing, software
distributed under the License is distributed on an "AS IS" BASIS,
WITHOUT WARRANTIES OR CONDITIONS OF ANY KIND, either express or implied.
See the License for the specific language governing permissions and
limitations under the License.
