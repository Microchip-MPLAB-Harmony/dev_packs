# ATSAMC21E18A device description
Architecture: CORTEX-M0PLUS; Family: SAMC; Series: SAMC21
Parameters: NUM_IRQ=31 (Number of interrupt request lines), __CM0PLUS_REV=0x0001 (Cortex-M0+ Core Revision), __MPU_PRESENT=1 (MPU present or not), __NVIC_PRIO_BITS=2 (Number of Bits used for Priority Levels), __VTOR_PRESENT=1 (Vector Table Offset Register present or not), __Vendor_SysTickConfig=0 (Set to 1 if different SysTick Config is used), __ARCH_ARM=1, __ARCH_ARM_CORTEX_M=1, __DEVICE_IS_SAM=1
Programming and debug interfaces: SWD
Registers are 32-bit, read-write, reset 0x0 unless marked. A register's access mark holds for its fields unless they carry their own. Offsets are from the block's base; lines under a group give offsets from that group; [hi:lo] are bit positions; {n}, {i} and the like mark numbered series; 'fields as' and 'values as' point back to an identical list; <NAME> marks a mode.

## Ordering variants
ATSAMC21E18A-MU: QFN32, pinout SAMC21E, up to 48 MHz, -40 to 85 C, 2.7 to 5.5 V
ATSAMC21E18A-MU64, ATSAMC21E18A-MUT64: QFN32, pinout SAMC21E, up to 64 MHz, -40 to 85 C, 2.7 to 5.5 V
ATSAMC21E18A-MN: QFN32, pinout SAMC21E, up to 48 MHz, -40 to 105 C, 2.7 to 5.5 V
ATSAMC21E18A-MZ: QFN32, pinout SAMC21E, up to 48 MHz, -40 to 125 C, 2.7 to 5.5 V
ATSAMC21E18A-AU: TQFP32, pinout SAMC21E, up to 48 MHz, -40 to 85 C, 2.7 to 5.5 V
ATSAMC21E18A-AU64, ATSAMC21E18A-AUT64: TQFP32, pinout SAMC21E, up to 64 MHz, -40 to 85 C, 2.7 to 5.5 V
ATSAMC21E18A-AN: TQFP32, pinout SAMC21E, up to 48 MHz, -40 to 105 C, 2.7 to 5.5 V
ATSAMC21E18A-AZ: TQFP32, pinout SAMC21E, up to 48 MHz, -40 to 125 C, 2.7 to 5.5 V

## Memory
base space: start 0 size 0x100000000, little endian
  0x00000000 FLASH size 0x40000 flash, rw, executable, page 64
  0x00806020 OTP5 size 0x8 fuses, ro
  0x00806030 TEMP_LOG size 0x8 fuses, ro
  0x00804000 USER_PAGE size 0x100 user_page, rw, page 64
  0x00400000 RWW size 0x2000 flash, rw, executable, page 64
  0x20000000 HSRAM size 0x8000 ram, rw, executable
  0x40000000 HPB0 size 0x4000 io, rw
  0x41000000 HPB1 size 0x10000 io, rw
  0x42000000 HPB2 size 0x8000 io, rw
  0x48000000 DIVAS size 0x20 io, rw
  0xE0000000 PPB size 0x100000 io, rw
  0xE000E000 SCS size 0x00001000 io, rw
  0x40000000 PERIPHERALS size 0x20000000 io, rw
fuses space: start 0x00000000 size 0x20000000, little endian

## Peripheral instances (address, pins/pin function, parameters)
AC at 0x42005000
  pins: AIN0 PA04/B; AIN1 PA05/B; AIN2 PA06/B; AIN3 PA07/B; AIN4 PA02/B; AIN5 PA03/B; CMP0 PA18/H; CMP1 PA19/H; CMP2 PA00/H or PA24/H; CMP3 PA01/H or PA25/H
  parameters: COMPCTRL_MUXNEG_OPAMP=7 (OPAMP selection for MUXNEG), GCLK_ID=40 (Index of Generic Clock), NUM_CMP=4 (Number of comparators), PAIRS=2 (Number of pairs of comparators), SPEED_LEVELS=2 (Number of speed values), INSTANCE_ID=84
ADC0 at 0x42004400 (ADC)
  pins: AIN0 PA02/B; AIN1 PA03/B; AIN{n} PA{n:02}/B (n=4..11); VREFP PA03/B
  parameters: DMAC_ID_RESRDY=42 (index of DMA RESRDY trigger), EXTCHANNEL_MSB=11 (Number of external channels), GCLK_ID=33 (index of Generic Clock), INT_CH30=0 (Select OPAMP or CTAT on Channel 30), MASTER_SLAVE_MODE=1 (ADC Master/Slave Mode), LOAD_CALIB=1 (CALIB register to be loaded from NVM), INSTANCE_ID=81
ADC1 at 0x42004800 (ADC)
  pins: AIN10 PA08/B; AIN11 PA09/B
  parameters: DMAC_ID_RESRDY=43 (index of DMA RESRDY trigger), EXTCHANNEL_MSB=11 (Number of external channels), GCLK_ID=34 (index of Generic Clock), INT_CH30=0 (Select OPAMP or CTAT on Channel 30), MASTER_SLAVE_MODE=2 (ADC Master/Slave Mode), LOAD_CALIB=1 (CALIB register to be loaded from NVM), INSTANCE_ID=82
CAN0 at 0x42001C00 (CAN)
  pins: RX PA25/G; TX PA24/G
  parameters: DMAC_ID_DEBUG=14 (DMA CAN Debug Req), GCLK_ID=26 (Index of Generic Clock), MSG_RAM_ADDR=0x200000000, QOS_RESET_VAL=2 (QOS reset value), INSTANCE_ID=71
CCL at 0x42005C00
  pins: IN0 PA04/I or PA16/I; IN1 PA05/I or PA17/I; IN2 PA06/I or PA18/I; IN3 PA08/I or PA30/I; IN4 PA09/I; IN5 PA10/I; IN6 PA22/I; IN7 PA23/I; IN8 PA24/I; OUT0 PA07/I or PA19/I; OUT1 PA11/I or PA31/I; OUT2 PA25/I
  parameters: GCLK_ID=38 (GCLK index for CCL), IO_NUM=12 (Numer of input pins), LUT_NUM=4 (Number of LUT in a CCL), SEQ_NUM=2 (Number of SEQ in a CCL), INSTANCE_ID=87
DAC at 0x42005400
  pins: VOUT PA02/B; VREFP PA03/B
  parameters: DMAC_ID_EMPTY=45 (Index of DMA EMPTY trigger), GCLK_ID=36, INSTANCE_ID=85
DIVAS at 0x48000000
DMAC at 0x41006000
  parameters: CH_BITS=4 (Number of bits to select channel), CH_NUM=12 (Number of channels), EVIN_NUM=4 (Number of input events), EVOUT_NUM=4 (Number of output events), LVL_BITS=2 (Number of bit to select level priority), LVL_NUM=4 (Enable priority level number), QOSCTRL_D_RESETVALUE=2 (QOS dmac ahb interface reset value), QOSCTRL_F_RESETVALUE=2 (QOS dmac fetch interface reset value), QOSCTRL_WRB_RESETVALUE=2 (QOS dmac write back interface reset value), TRIG_BITS=6 (Number of bits to select trigger source), TRIG_NUM=49 (Number of peripheral triggers), INSTANCE_ID=35
DSU at 0x41002000
  parameters: INSTANCE_ID=33
EIC at 0x40002800
  pins: EXTINT0 PA16/A or PA00/A; EXTINT1 PA17/A or PA01/A; EXTINT2 PA02/A or PA18/A; EXTINT3 PA03/A or PA19/A; EXTINT4 PA04/A; EXTINT5 PA05/A; EXTINT6 PA06/A or PA22/A; EXTINT7 PA07/A or PA23/A; EXTINT8 PA28/A; EXTINT9 PA09/A; EXTINT10 PA10/A or PA30/A; EXTINT11 PA11/A or PA31/A; EXTINT12 PA24/A; EXTINT13 PA25/A; EXTINT14 PA14/A; EXTINT15 PA27/A or PA15/A; NMI PA08/A
  parameters: EXTINT_NUM=16 (Number of external interrupts), GCLK_ID=2 (Generic Clock index), NUMBER_OF_CONFIG_REGS=2 (Number of CONFIG registers), NUMBER_OF_INTERRUPTS=16 (Number of external interrupts (obsolete)), INSTANCE_ID=10
EVSYS at 0x42000000
  parameters: CHANNELS=12 (Number of Channels), CHANNELS_BITS=4 (Number of bits to select Channel), CHANNELS_MSB=11 (Number of Channels - 1), EXTEVT_NUM=0 (Number of External Event Generators), GCLK_ID_{n}={n+6} (Index of Generic Clock {n}) (n=0..11), GENERATORS=87 (Total Number of Event Generators), GENERATORS_BITS=7 (Number of bits to select Event Generator), USERS=47 (Total Number of Event Users), USERS_BITS=6 (Number of bits to select Event User), INSTANCE_ID=64
FREQM at 0x40002C00
  parameters: GCLK_ID_MSR=3 (Index of measure generic clock), GCLK_ID_REF=4 (Index of reference generic clock), INSTANCE_ID=11
GCLK at 0x40001C00
  pins: IO0 PA14/H or PA27/H or PA30/H or PA28/H; IO1 PA15/H; IO2 PA16/H; IO3 PA17/H; IO4 PA10/H; IO5 PA11/H; IO6 PA22/H; IO7 PA23/H
  parameters: GENDIV_BITS=16, GEN_BITS=4, GEN_NUM=9 (Number of Generic Clock Generators), GEN_NUM_MSB=8 (Number of Generic Clock Generators - 1), GEN_SOURCE_NUM_MSB=7 (Number of Generic Clock Sources - 1), NUM=41 (Number of Generic Clock Users), SOURCE_BITS=3, SOURCE_DPLL96M=7, SOURCE_GCLKGEN1=2, SOURCE_GCLKIN=1, SOURCE_NUM=8 (Number of Generic Clock Sources), SOURCE_OSCULP32K=3, SOURCE_OSC32K=4, SOURCE_OSC48M=6, SOURCE_XOSC=0, SOURCE_XOSC32K=5, INSTANCE_ID=7
HMATRIXHS at 0x4100A000 (HMATRIXB)
  parameters: MASTER_NUM=3, MASTER_CM0PLUS=0, MASTER_DSU=1, MASTER_DMAC=2, SLAVE_NUM=8, SLAVE_FLASH=0, SLAVE_HSRAMCM0P=1, SLAVE_HSRAMDSU=2, SLAVE_HPB1=3, SLAVE_HPB0=4, SLAVE_HPB2=5, SLAVE_LPRAMDMAC=6, SLAVE_DIVAS=7, INSTANCE_ID=37
MCLK at 0x40000800
  parameters: CTRLA_MCSEL_GCLK=1, CTRLA_MCSEL_OSC8M=0, MCLK_CLK_APB_NUM=3, SYSTEM_CLOCK=4000000 (System Clock Frequency at Reset), INSTANCE_ID=2
  clocks: AHB HPB0 bit 0, HPB1 bit 1, HPB2 bit 2, DSU bit 3, HMATRIXHS bit 4, NVMCTRL bit 5, HSRAM bit 6, DMAC bit 7, CAN0 bit 8, PAC bit 10, NVMCTRL_PICACHU bit 11, DIVAS bit 12
MTB at 0x41008000
  parameters: INSTANCE_ID=36
NVMCTRL at 0x41004000
  pins: MARGIN VMARGIN
  parameters: FACTORY_WORD_IMPLEMENTED_MASK=0XC0000007FFFFFFFF, GCLK_ID=39 (Index of Generic Clock for test), PMSB=3, PSZ_BITS=6, USER_PAGE_OFFSET=0x00800000, USER_WORD_IMPLEMENTED_MASK=0XC01FFFFFFFFFFFFF, RWWEE_PAGES=128, RWWEE_ROW_SIZE=256, RWW_EEPROM_ADDR=0x00400000 (Start address of the WWR EEPROM area), RWW_EEPROM_SIZE=8192 (Byte size of the WWR EEPROM area), FLASH_SIZE=262144, PAGE_SIZE=64, PAGES=4096, PAGES_PR_REGION=256, ROW_SIZE=256, PSM_0_FRMFW_FWS_1_MAX_FREQ=12000000, PSM_0_FRMLP_FWS_0_MAX_FREQ=18000000, PSM_0_FRMLP_FWS_1_MAX_FREQ=36000000, PSM_0_FRMHS_FWS_0_MAX_FREQ=25000000, PSM_0_FRMHS_FWS_1_MAX_FREQ=50000000, PSM_1_FRMFW_FWS_1_MAX_FREQ=12000000, PSM_1_FRMLP_FWS_0_MAX_FREQ=8000000, PSM_1_FRMLP_FWS_1_MAX_FREQ=12000000, INSTANCE_ID=34
FUSES at OTP5_FUSES 0x00806020 in fuses, TEMP_LOG_FUSES 0x00806030 in fuses, USER_FUSES 0x00804000 in fuses
OSCCTRL at 0x40001000
  pins: XIN PA14/XIN; XOSC_CLK PA09/XOSC; XOSC_EN PA08/XOSC; XOUT PA15/XOUT
  parameters: GCLK_ID_FDPLL=0 (Index of Generic Clock for DPLL), GCLK_ID_FDPLL32K=1 (Index of Generic Clock for DPLL 32K), FDPLL_VERSION=0x211, OSC48M_VERSION=0x101, XOSC_VERSION=0x201, INSTANCE_ID=4
OSC32KCTRL at 0x40001400
  pins: XIN32 PA00/XIN32; XOUT32 PA01/XOUT32
  parameters: OSC32K_COARSE_CALIB_MSB=6, INSTANCE_ID=5
PAC at 0x40000000
  parameters: HPB_NUM=3 (Number of bridges AHB/APB), INTFLAG_NUM=4 (Number of intflag registers), INSTANCE_ID=0
PM at 0x40000400
  pins: RESET_N RESET_N
  parameters: BIAS_RAM_HS=1 (one if RAM HS can be back biased), PD_NUM=0 (Number of switchable Power Domain), INSTANCE_ID=1
PORT at 0x41000000, PORT_IOBUS 0x60000000
  pins: P{n} PA{n:02} (n=0..11); P14 PA14; P15 PA15; P16 PA16; P17 PA17; P18 PA18; P19 PA19; P22 PA22; P23 PA23; P24 PA24; P25 PA25; P27 PA27; P28 PA28; P30 PA30; P31 PA31
  parameters: BITS=64, DRVSTR=1 (DRVSTR supported), EV_NUM=4, GROUPS=1, ODRAIN=0 (ODRAIN supported), SLEWLIM=0 (SLEWLIM supported), INSTANCE_ID=32
PTC at 0x42005800
  pins: X0 PA08/B; X1 PA09/B; X2 PA10/B; X3 PA11/B; X4 PA16/B; X5 PA17/B; X6 PA18/B; X7 PA19/B; X10 PA22/B; X11 PA23/B; Y0 PA02/B; Y1 PA03/B; Y2 PA04/B; Y3 PA05/B; Y4 PA06/B; Y5 PA07/B; Y16 PA08/B; Y17 PA09/B; Y18 PA10/B; Y19 PA11/B; Y20 PA16/B; Y21 PA17/B; Y22 PA18/B; Y23 PA19/B; Y26 PA22/B; Y27 PA23/B
  parameters: DMAC_ID_EOC=46 (Index of DMA EOC trigger), DMAC_ID_SEQ=48 (Index of DMA SEQ trigger), DMAC_ID_WCOMP=47 (Index of DMA WCOMP trigger), GCLK_ID=37 (Index of Generic Clock), X_LINES_NUM=16 (Number of X lines), Y_LINES_NUM=32 (Number of Y lines), SELF_CAP_CHANNELS_NUM=16 (Number of self-capacitance channels), MUTUAL_CAP_CHANNELS_NUM=64 (Number of mutual-capacitance channels), INSTANCE_ID=86
RSTC at 0x40000C00
  pins: EXTWAKE{n} PA{n:02}/A (n=0..11); EXTWAKE14 PA14/A; EXTWAKE15 PA15/A
  parameters: NUMBER_OF_EXTWAKE=0 (number of external wakeup line), INSTANCE_ID=3
RTC at 0x40002400
  parameters: ALARM_NUM=1 (Number of Alarms), COMP16_NUM=2 (Number of 16-bit Comparators), COMP32_NUM=1 (Number of 32-bit Comparators), GPR_NUM=0 (Number of General-Purpose Registers), PER_NUM=8 (Number of Periodic Intervals), INSTANCE_ID=9
SDADC at 0x42004C00
  pins: INN0 PA06/B; INP0 PA07/B; VREFP PA04/B
  parameters: DMAC_ID_RESRDY=44 (Index of DMA RESRDY trigger), EXT_CHANNELS=3 (Number of external channels), GCLK_ID=35 (Index of generic clock), INSTANCE_ID=83
SERCOM0 at 0x42000400 (SERCOM)
  pins: PAD0 PA04/D or PA08/C; PAD1 PA05/D or PA09/C; PAD2 PA06/D or PA10/C; PAD3 PA07/D or PA11/C
  parameters: DMAC_ID_RX=2 (Index of DMA RX trigger), DMAC_ID_TX=3 (Index of DMA TX trigger), GCLK_ID_CORE=19, GCLK_ID_SLOW=18, INT_MSB=6, PMSB=3, INSTANCE_ID=65
SERCOM1 at 0x42000800 (SERCOM)
  pins: PAD0 PA16/C or PA00/D; PAD1 PA17/C or PA01/D; PAD2 PA30/D or PA18/C; PAD3 PA31/D or PA19/C
  parameters: DMAC_ID_RX=4 (Index of DMA RX trigger), DMAC_ID_TX=5 (Index of DMA TX trigger), GCLK_ID_CORE=20, GCLK_ID_SLOW=18, INT_MSB=6, PMSB=3, INSTANCE_ID=66
SERCOM2 at 0x42000C00 (SERCOM)
  pins: PAD0 PA08/D; PAD1 PA09/D; PAD2 PA10/D or PA14/C; PAD3 PA11/D or PA15/C
  parameters: DMAC_ID_RX=6 (Index of DMA RX trigger), DMAC_ID_TX=7 (Index of DMA TX trigger), GCLK_ID_CORE=21, GCLK_ID_SLOW=18, INT_MSB=6, PMSB=3, INSTANCE_ID=67
SERCOM3 at 0x42001000 (SERCOM)
  pins: PAD0 PA16/D or PA22/C; PAD1 PA17/D or PA23/C; PAD2 PA18/D or PA24/C; PAD3 PA19/D or PA25/C
  parameters: DMAC_ID_RX=8 (Index of DMA RX trigger), DMAC_ID_TX=9 (Index of DMA TX trigger), GCLK_ID_CORE=22, GCLK_ID_SLOW=18, INT_MSB=6, PMSB=3, INSTANCE_ID=68
SUPC at 0x40001800
  pins: BGBUFREADY0 PA08/VREG; BGBUFREADY1 PA09/VREG; BGBUFREADY2 PA10/VREG; BGBUFREADY3 PA11/VREG; BGBUFREADY5 PA07/VREG; BGBUFRRREADY PA04/VREG; BIAS_TEST_OUT PA06/VREG; VREFREADY1 PA03/VREG; VREF_ANA_OUT PA05/VREG
  parameters: BODCORE_CALIB_MSB=5, BODVDD_CALIB_MSB=5, SUPC_OUT_NUM_MSB=1 (MSB of backup output pad Number), INSTANCE_ID=6
TC0 at 0x42003000 (TC)
  pins: WO0 PA22/E; WO1 PA23/E
  parameters: CC_NUM=2, DMAC_ID_OVF=27 (Indexes of DMA Overflow trigger), DMAC_ID_MC0=28 (Indexes of DMA Match/Compare 0 trigger), DMAC_ID_MC1=29 (Indexes of DMA Match/Compare 1 trigger), EXT=0 (Coding of implemented extended features (keep 0 value)), GCLK_ID=30 (Index of Generic Clock), MASTER_SLAVE_MODE=1 (TC type 0 : NA, 1 : Master, 2 : Slave), OW_NUM=2 (Number of Output Waveforms), INSTANCE_ID=76
TC1 at 0x42003400 (TC)
  pins: WO0 PA24/E; WO1 PA25/E
  parameters: CC_NUM=2, DMAC_ID_OVF=30 (Indexes of DMA Overflow trigger), DMAC_ID_MC0=31 (Indexes of DMA Match/Compare 0 trigger), DMAC_ID_MC1=32 (Indexes of DMA Match/Compare 1 trigger), EXT=0 (Coding of implemented extended features (keep 0 value)), GCLK_ID=30 (Index of Generic Clock), MASTER_SLAVE_MODE=2 (TC type 0 : NA, 1 : Master, 2 : Slave), OW_NUM=2 (Number of Output Waveforms), INSTANCE_ID=77
TC2 at 0x42003800 (TC)
  parameters: CC_NUM=2, DMAC_ID_OVF=33 (Indexes of DMA Overflow trigger), DMAC_ID_MC0=34 (Indexes of DMA Match/Compare 0 trigger), DMAC_ID_MC1=35 (Indexes of DMA Match/Compare 1 trigger), EXT=0 (Coding of implemented extended features (keep 0 value)), GCLK_ID=31 (Index of Generic Clock), MASTER_SLAVE_MODE=1 (TC type 0 : NA, 1 : Master, 2 : Slave), OW_NUM=2 (Number of Output Waveforms), INSTANCE_ID=78
TC3 at 0x42003C00 (TC)
  parameters: CC_NUM=2, DMAC_ID_OVF=36 (Indexes of DMA Overflow trigger), DMAC_ID_MC0=37 (Indexes of DMA Match/Compare 0 trigger), DMAC_ID_MC1=38 (Indexes of DMA Match/Compare 1 trigger), EXT=0 (Coding of implemented extended features (keep 0 value)), GCLK_ID=31 (Index of Generic Clock), MASTER_SLAVE_MODE=2 (TC type 0 : NA, 1 : Master, 2 : Slave), OW_NUM=2 (Number of Output Waveforms), INSTANCE_ID=79
TC4 at 0x42004000 (TC)
  pins: WO0 PA18/E or PA14/E; WO1 PA19/E or PA15/E
  parameters: CC_NUM=2, DMAC_ID_OVF=39 (Indexes of DMA Overflow trigger), DMAC_ID_MC0=40 (Indexes of DMA Match/Compare 0 trigger), DMAC_ID_MC1=41 (Indexes of DMA Match/Compare 1 trigger), EXT=0 (Coding of implemented extended features (keep 0 value)), GCLK_ID=32 (Index of Generic Clock), MASTER_SLAVE_MODE=0 (TC type 0 : NA, 1 : Master, 2 : Slave), OW_NUM=2 (Number of Output Waveforms), INSTANCE_ID=80
TCC0 at 0x42002400 (TCC)
  pins: WO0 PA04/E or PA08/E; WO1 PA05/E or PA09/E; WO2 PA10/F or PA18/F; WO3 PA11/F or PA19/F; WO4 PA22/F or PA14/F; WO5 PA15/F or PA23/F; WO6 PA16/F; WO7 PA17/F
  parameters: CC_NUM=4 (Number of Compare/Capture units), DITHERING=1 (Dithering feature implemented), DMAC_ID_OVF=16 (DMA overflow/underflow/retrigger trigger), DMAC_ID_MC0=17 (Indexes of DMA Match/Compare 0 trigger), DMAC_ID_MC1=18 (Indexes of DMA Match/Compare 1 trigger), DMAC_ID_MC2=19 (Indexes of DMA Match/Compare 2 trigger), DMAC_ID_MC3=20 (Indexes of DMA Match/Compare 3 trigger), DTI=1 (Dead-Time-Insertion feature implemented), EXT=31 (Coding of implemented extended features), GCLK_ID=28 (Index of Generic Clock), OTMX=1 (Output Matrix feature implemented), OW_NUM=8 (Number of Output Waveforms), PG=1 (Pattern Generation feature implemented), SIZE=24, SWAP=1 (DTI outputs swap feature implemented), MASTER_SLAVE_MODE=1 (TCC type 0 : NA, 1 : Master, 2 : Slave), INSTANCE_ID=73
TCC1 at 0x42002800 (TCC)
  pins: WO0 PA06/E or PA10/E or PA30/E; WO1 PA07/E or PA11/E or PA31/E; WO2 PA08/F or PA24/F; WO3 PA09/F or PA25/F
  parameters: CC_NUM=2 (Number of Compare/Capture units), DITHERING=1 (Dithering feature implemented), DMAC_ID_OVF=21 (DMA overflow/underflow/retrigger trigger), DMAC_ID_MC0=22 (Indexes of DMA Match/Compare 0 trigger), DMAC_ID_MC1=23 (Indexes of DMA Match/Compare 1 trigger), DTI=0 (Dead-Time-Insertion feature implemented), EXT=24 (Coding of implemented extended features), GCLK_ID=28 (Index of Generic Clock), OTMX=0 (Output Matrix feature implemented), OW_NUM=4 (Number of Output Waveforms), PG=1 (Pattern Generation feature implemented), SIZE=24, SWAP=0 (DTI outputs swap feature implemented), MASTER_SLAVE_MODE=2 (TCC type 0 : NA, 1 : Master, 2 : Slave), INSTANCE_ID=74
TCC2 at 0x42002C00 (TCC)
  pins: WO0 PA16/E or PA00/E; WO1 PA17/E or PA01/E
  parameters: CC_NUM=2 (Number of Compare/Capture units), DITHERING=0 (Dithering feature implemented), DMAC_ID_OVF=24 (DMA overflow/underflow/retrigger trigger), DMAC_ID_MC0=25 (Indexes of DMA Match/Compare 0 trigger), DMAC_ID_MC1=26 (Indexes of DMA Match/Compare 1 trigger), DTI=0 (Dead-Time-Insertion feature implemented), EXT=0 (Coding of implemented extended features), GCLK_ID=29 (Index of Generic Clock), OTMX=0 (Output Matrix feature implemented), OW_NUM=2 (Number of Output Waveforms), PG=0 (Pattern Generation feature implemented), SIZE=16, SWAP=0 (DTI outputs swap feature implemented), MASTER_SLAVE_MODE=0 (TCC type 0 : NA, 1 : Master, 2 : Slave), INSTANCE_ID=75
TSENS at 0x40003000
  parameters: DMAC_ID_RESRDY=1 (Index of DMA RESRDY trigger), GCLK_ID=5 (Index of Generic Clock), INSTANCE_ID=12
WDT at 0x40002000
  parameters: INSTANCE_ID=8
MPU at 0xE000ED90
NVIC at 0xE000E100
  parameters: NUM_IRQ=31 (Number of interrupt requests), __NVIC_PRIO_BITS=2 (Number of NVIC interrupt priority bits)
SysTick at 0xE000E010
SystemControl at 0xE000E000
  parameters: __VTOR_PRESENT=1 (Vector Table Offset Register present)

## Interrupts
-15 Reset — Reset Vector, invoked on Power up and warm reset
-14 NonMaskableInt — Non maskable Interrupt, cannot be stopped or preempted
-13 HardFault — Hard Fault, all classes of Fault
-5 SVCall — System Service Call via SVC instruction
-2 PendSV — Pendable request for system service
-1 SysTick — System Tick Timer
0 SYSTEM (MCLK OSCCTRL OSC32KCTRL PAC SUPC) — System peripherals shared interrupt
1 WDT — Watchdog Timer
2 RTC — Real Time Counter
3 EIC — External Interrupt Controller
4 FREQM — Frequency Meter
5 TSENS — Temperature Sensor
6 NVMCTRL — Non-Volatile Memory Controller
7 DMAC — Direct Memory Controller
8 EVSYS — Event Systems
9 SERCOM0 — Serial Communication Interface 0
10 SERCOM1 — Serial Communication Interface 1
11 SERCOM2 — Serial Communication Interface 2
12 SERCOM3 — Serial Communication Interface 3
15 CAN0 — Control Area Network 0
17 TCC0 — Timer/Counter for Control Applications 0
18 TCC1 — Timer/Counter for Control Applications 1
19 TCC2 — Timer/Counter for Control Applications 2
20 TC0 — Timer/Counter 0
21 TC1 — Timer/Counter 1
22 TC2 — Timer/Counter 2
23 TC3 — Timer/Counter 3
24 TC4 — Timer/Counter 4
25 ADC0 — Analog-to-Digital Converter 0
26 ADC1 — Analog-to-Digital Converter 1
27 AC — Analog Comparators
28 DAC — Digital-to-Analog Converter
29 SDADC — Sigma-Delat Analog-to-Digital Converter
30 PTC — Peripheral Touch Controller

## Event generators
1 OSCCTRL_XOSC_FAIL, 2 OSC32KCTRL_XOSC32K_FAIL, 3 RTC_CMP_0, 4 RTC_CMP_1, 5 RTC_OVF, {n+6} RTC_PER_{n} (n=0..7), {n+14} EIC_EXTINT_{n} (n=0..15), 30 TSENS_WINMON, {n+31} DMAC_CH_{n} (n=0..3), 35 TCC0_OVF, 36 TCC0_TRG, 37 TCC0_CNT, {n+38} TCC0_MC_{n} (n=0..3), 42 TCC1_OVF, 43 TCC1_TRG, 44 TCC1_CNT, 45 TCC1_MC_0, 46 TCC1_MC_1, 47 TCC2_OVF, 48 TCC2_TRG, 49 TCC2_CNT, 50 TCC2_MC_0, 51 TCC2_MC_1, {3n+52} TC{n}_OVF (n=0..4), {3n+53} TC{n}_MC_0 (n=0..4), {3n+54} TC{n}_MC_1 (n=0..4), 67 ADC0_RESRDY, 68 ADC0_WINMON, 69 ADC1_RESRDY, 70 ADC1_WINMON, 71 SDADC_RESRDY, 72 SDADC_WINMON, {n+73} AC_COMP_{n} (n=0..3), 77 AC_WIN_0, 78 AC_WIN_1, 79 DAC_EMPTY, 80 PTC_EOC, 81 PTC_WIN_COMP, {n+82} CCL_LUTOUT_{n} (n=0..3), 86 PAC_ACCERR

## Event users
0 TSENS_START, {n+1} PORT_EV_{n} (n=0..3), {n+5} DMAC_CH_{n} (n=0..3), 9 TCC0_EV_0, 10 TCC0_EV_1, {n+11} TCC0_MC_{n} (n=0..3), 15 TCC1_EV_0, 16 TCC1_EV_1, 17 TCC1_MC_0, 18 TCC1_MC_1, 19 TCC2_EV_0, 20 TCC2_EV_1, 21 TCC2_MC_0, 22 TCC2_MC_1, {n+23} TC{n}_EVU (n=0..4), 28 ADC0_START, 29 ADC0_SYNC, 30 ADC1_START, 31 ADC1_SYNC, 32 SDADC_START, 33 SDADC_FLUSH, {n+34} AC_SOC_{n} (n=0..3), 38 DAC_START, {n+40} CCL_LUTIN_{n} (n=0..3), 45 MTB_START, 46 MTB_STOP

## Properties
SIGNATURES: DSU_DID=0x1101050A

## Pinouts (pin number, pad)
SAMC21E: 1 PA00, 2 PA01, 3 PA02, 4 PA03, 5 PA04, 6 PA05, 7 PA06, 8 PA07, 9 VDDANA, 10 GNDIO, 11 PA08, 12 PA09, 13 PA10, 14 PA11, 15 PA14, 16 PA15, 17 PA16, 18 PA17, 19 PA18, 20 PA19, 21 PA22, 22 PA23, 23 PA24, 24 PA25, 25 PA27, 26 RESET_N, 27 PA28, 28 GNDIO, 29 VDDCORE, 30 VDDIN, 31 PA30, 32 PA31

## Notices in the file
Copyright (c) 2018 Microchip Technology Inc.
SPDX-License-Identifier: Apache-2.0
Licensed under the Apache License, Version 2.0 (the "License");
you may not use this file except in compliance with the License.
You may obtain a copy of the License at
http://www.apache.org/licenses/LICENSE-2.0
Unless required by applicable law or agreed to in writing, software
distributed under the License is distributed on an "AS IS" BASIS,
WITHOUT WARRANTIES OR CONDITIONS OF ANY KIND, either express or implied.
See the License for the specific language governing permissions and
limitations under the License.
