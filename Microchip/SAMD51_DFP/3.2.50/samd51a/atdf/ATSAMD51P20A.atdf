# ATSAMD51P20A device description
Architecture: CORTEX-M4; Family: SAMD; Series: SAMD51

## Interrupts
-15 Reset — Reset Vector, invoked on Power up and warm reset
-14 NonMaskableInt — Non maskable Interrupt, cannot be stopped or preempted
-13 HardFault — Hard Fault, all classes of Fault
-12 MemoryManagement — Memory Management, MPU mismatch, including Access Violation and No Match
-11 BusFault — Bus Fault, Pre-Fetch-, Memory Access Fault, other address/memory related Fault
-10 UsageFault — Usage Fault, i.e. Undef Instruction, Illegal State Transition
-5 SVCall — System Service Call via SVC instruction
-4 DebugMonitor
-2 PendSV — Pendable request for system service
-1 SysTick — System Tick Timer
0 PM — Power Manager
1 MCLK — Main Clock
2 OSCCTRL_XOSC0 (OSCCTRL) — External Oscillator 0
3 OSCCTRL_XOSC1 (OSCCTRL) — External Oscillator 1
4 OSCCTRL_DFLL (OSCCTRL) — Digital Frequency Locked Loop
5 OSCCTRL_DPLL0 (OSCCTRL) — Digital Phase Locked Loop 0
6 OSCCTRL_DPLL1 (OSCCTRL) — Digital Phase Locked Loop 1
7 OSC32KCTRL — 32Khz Oscillator Controller
8 SUPC_OTHER (SUPC) — Suppyly controller
9 SUPC_BODDET (SUPC) — Brown Out Detection
10 WDT — Watch Dog Timer
11 RTC — Real Time Counter
{n+12} EIC_EXTINT_{n} (EIC) (n=0..15) — EIC Channel {n}
28 FREQM — Frequency Meter
29 NVMCTRL_0 (NVMCTRL) — Non-Volatile Memory Controller
30 NVMCTRL_1 (NVMCTRL) — NVMCTRL SmartEEPROM Interrupts
31 DMAC_0 (DMAC) — DMA Channel 0
32 DMAC_1 (DMAC) — DMA Channel 1
33 DMAC_2 (DMAC) — DMA Channel 2
34 DMAC_3 (DMAC) — DMA Channel 3
35 DMAC_OTHER (DMAC) — DMA Channel 4..X
36 EVSYS_0 (EVSYS) — Event System Channel 0
37 EVSYS_1 (EVSYS) — Event System Channel 1
38 EVSYS_2 (EVSYS) — Event System Channel 2
39 EVSYS_3 (EVSYS) — Event System Channel 3
40 EVSYS_OTHER (EVSYS) — Event System Channel 4..X
41 PAC — Peripheral Access Controller
45 RAMECC — RAM Error Correction Code
{4n+46} SERCOM{n}_0 (SERCOM{n}) (n=0..7) — Serial Communication Interface {n}
{4n+47} SERCOM{n}_1 (SERCOM{n}) (n=0..7) — Serial Communication Interface {n}
{4n+48} SERCOM{n}_2 (SERCOM{n}) (n=0..7) — Serial Communication Interface {n}
{4n+49} SERCOM{n}_OTHER (SERCOM{n}) (n=0..7) — Serial Communication Interface {n}
80 USB_OTHER (USB) — Universal Serial Bus
81 USB_SOF_HSOF (USB) — USB Start of Frame
82 USB_TRCPT0 (USB) — USB Transfer Complete 0
83 USB_TRCPT1 (USB) — USB Transfer Complete 1
85 TCC0_OTHER (TCC0) — Timer Counter Control 0
86 TCC0_MC0 (TCC0) — TCC Match/Compare 0
87 TCC0_MC1 (TCC0) — TCC Match/Compare 1
88 TCC0_MC2 (TCC0) — TCC Match/Compare 2
89 TCC0_MC3 (TCC0) — TCC Match/Compare 3
90 TCC0_MC4 (TCC0) — TCC Match/Compare 4
91 TCC0_MC5 (TCC0) — TCC Match/Compare 5
92 TCC1_OTHER (TCC1) — Timer Counter Control 1
93 TCC1_MC0 (TCC1) — TCC Match/Compare 0
94 TCC1_MC1 (TCC1) — TCC Match/Compare 1
95 TCC1_MC2 (TCC1) — TCC Match/Compare 2
96 TCC1_MC3 (TCC1) — TCC Match/Compare 3
97 TCC2_OTHER (TCC2) — Timer Counter Control 2
98 TCC2_MC0 (TCC2) — TCC Match/Compare 0
99 TCC2_MC1 (TCC2) — TCC Match/Compare 1
100 TCC2_MC2 (TCC2) — TCC Match/Compare 2
101 TCC3_OTHER (TCC3) — Timer Counter Control 3
102 TCC3_MC0 (TCC3) — TCC Match/Compare 0
103 TCC3_MC1 (TCC3) — TCC Match/Compare 1
104 TCC4_OTHER (TCC4) — Timer Counter Control 4
105 TCC4_MC0 (TCC4) — TCC Match/Compare 0
106 TCC4_MC1 (TCC4) — TCC Match/Compare 1
{n+107} TC{n} (n=0..7) — Timer Counter {n}
115 PDEC_OTHER (PDEC) — Position Decoder
116 PDEC_MC0 (PDEC) — PDEC Match/Compare 0
117 PDEC_MC1 (PDEC) — PDEC Match Compare 1
118 ADC0_OTHER (ADC0) — Analog To Digital Converter 0
119 ADC0_RESRDY (ADC0) — ADC0 Result Ready
120 ADC1_OTHER (ADC1) — Analog To Digital Converter 1
121 ADC1_RESRDY (ADC1) — ADC1 Result Ready
122 AC — Analog Comparator
123 DAC_OTHER (DAC) — Digital to Analog Converter
124 DAC_EMPTY_0 (DAC) — DAC Buffer 0 Empty
125 DAC_EMPTY_1 (DAC) — DAC Buffer 1 Empty
126 DAC_RESRDY_0 (DAC) — DAC Filter 0 Result Ready
127 DAC_RESRDY_1 (DAC) — DAC Filter 1 Result Ready
128 I2S — Inter-IC Sound Interface
129 PCC — Parallel Capture Controller
130 AES — Advanced Encryption Standard
131 TRNG — True Random Generator
132 ICM — Integrity Check Monitor
133 PUKCC — Public-Key Cryptography Controller
134 QSPI — Quad SPI interface
135 SDHC0 — SD/MMC Host Controller 0
136 SDHC1 — SD/MMC Host Controller 1

## Event generators
1 OSCCTRL_XOSC_FAIL_0, 2 OSCCTRL_XOSC_FAIL_1, 3 OSC32KCTRL_XOSC32K_FAIL, {n+4} RTC_PER_{n} (n=0..7), {n+12} RTC_CMP_{n} (n=0..3), 16 RTC_TAMPER, 17 RTC_OVF, {n+18} EIC_EXTINT_{n} (n=0..15), {n+34} DMAC_CH_{n} (n=0..3), 38 PAC_ACCERR, 41 TCC0_OVF, 42 TCC0_TRG, 43 TCC0_CNT, {n+44} TCC0_MC_{n} (n=0..5), 50 TCC1_OVF, 51 TCC1_TRG, 52 TCC1_CNT, {n+53} TCC1_MC_{n} (n=0..3), 57 TCC2_OVF, 58 TCC2_TRG, 59 TCC2_CNT, {n+60} TCC2_MC_{n} (n=0..2), 63 TCC3_OVF, 64 TCC3_TRG, 65 TCC3_CNT, 66 TCC3_MC_0, 67 TCC3_MC_1, 68 TCC4_OVF, 69 TCC4_TRG, 70 TCC4_CNT, 71 TCC4_MC_0, 72 TCC4_MC_1, {3n+73} TC{n}_OVF (n=0..7), {3n+74} TC{n}_MC_0 (n=0..7), {3n+75} TC{n}_MC_1 (n=0..7), 97 PDEC_OVF, 98 PDEC_ERR, 99 PDEC_DIR, 100 PDEC_VLC, 101 PDEC_MC_0, 102 PDEC_MC_1, 103 ADC0_RESRDY, 104 ADC0_WINMON, 105 ADC1_RESRDY, 106 ADC1_WINMON, 107 AC_COMP_0, 108 AC_COMP_1, 109 AC_WIN_0, 110 DAC_EMPTY_0, 111 DAC_EMPTY_1, 112 DAC_RESRDY_0, 113 DAC_RESRDY_1, 115 TRNG_READY, {n+116} CCL_LUTOUT_{n} (n=0..3)

## Event users
0 RTC_TAMPER, {n+1} PORT_EV_{n} (n=0..3), {n+5} DMAC_CH_{n} (n=0..7), 14 CM4_TRACE_START, 15 CM4_TRACE_STOP, 16 CM4_TRACE_TRIG, 17 TCC0_EV_0, 18 TCC0_EV_1, {n+19} TCC0_MC_{n} (n=0..5), 25 TCC1_EV_0, 26 TCC1_EV_1, {n+27} TCC1_MC_{n} (n=0..3), 31 TCC2_EV_0, 32 TCC2_EV_1, {n+33} TCC2_MC_{n} (n=0..2), 36 TCC3_EV_0, 37 TCC3_EV_1, 38 TCC3_MC_0, 39 TCC3_MC_1, 40 TCC4_EV_0, 41 TCC4_EV_1, 42 TCC4_MC_0, 43 TCC4_MC_1, {n+44} TC{n}_EVU (n=0..7), {n+52} PDEC_EVU_{n} (n=0..2), 55 ADC0_START, 56 ADC0_SYNC, 57 ADC1_START, 58 ADC1_SYNC, 59 AC_SOC_0, 60 AC_SOC_1, 61 DAC_START_0, 62 DAC_START_1, {n+63} CCL_LUTIN_{n} (n=0..3)

## Properties
SIGNATURES: DSU_DID=0x60060300

## Pinouts (pin number, pad)
SAMD51PC: A1 PA00, A2 PB02, A3 PB00, A4 PC30, A5 PB30, A6 VSW, A7 VDDCORE, A8 RESET_N, A9 PC27, A10 PC26, A11 PC24, A12 PB28, A13 PB26, A14 PB23, A15 PB22, B1 PA01, B2 PB03, B3 PB01, B4 PC31, B5 PB31, B6 PA31, B7 PA30, B8 PA27, B9 PC28, B10 PC25, B11 PB29, B12 PB27, B13 PB25, B14 PB24, B15 PA25, C1 PC00, C2 PC01, C14 PA23, C15 PA24, D1 PC02, D2 GNDIO, D14 PA22, D15 PA21, E1 PA02, E2 PC03, E14 PA20, E15 PB21, F1 PB04, F2 PA03, F6 GNDIO, F7 VDDIO, F8 VDDIO, F9 GNDIO, F10 VDDIO, F14 PB20, F15 PB19, G1 PB05, G2 PD00, G6 VDDANA, G10 GNDIO, G14 PB18, G15 PB17, H1 PD01, H2 PB06, H6 GNDANA, H10 VDDIO, H14 PD21, H15 PB16, J1 PB07, J2 PB08, J6 GNDIO, J10 GNDIO, J14 PC23, J15 PD20, K1 PB09, K2 PA04, K6 VDDIO, K7 VDDIO, K8 GNDIO, K9 GNDIO, K10 VDDIO, K14 PC21, K15 PC22, L1 PA05, L2 PA06, L14 PC19, L15 PC20, M1 PA07, M2 VDDANA, M14 PC17, M15 PC18, N1 PC04, N2 PC05, N14 PA19, N15 PC16, P1 PC06, P2 PC07, P3 PA09, P4 PA11, P5 PB11, P6 PB13, P7 PB15, P8 PD09, P9 PD11, P10 PC10, P11 PC13, P12 PC15, P13 PA13, P14 PA17, P15 PA18, R1 PA08, R2 PA10, R3 PB10, R4 PB12, R5 PB14, R6 PD08, R7 PD10, R8 PD12, R9 PC11, R10 PC12, R11 PC14, R12 PA12, R13 PA14, R14 PA15, R15 PA16
SAMD51P: 1 PA00, 2 PA01, 3 PC00, 4 PC01, 5 NC, 6 VDDANA, 7 PC02, 8 PC03, 9 PA02, 10 PA03, 11 PB04, 12 PB05, 13 PD00, 14 GNDANA, 15 VDDANA, 16 PD01, 17 PB06, 18 PB07, 19 PB08, 20 PB09, 21 PA04, 22 PA05, 23 PA06, 24 PA07, 25 GNDANA, 26 VDDANA, 27 PC04, 28 PC05, 29 PC06, 30 PC07, 31 GND, 32 VDDIO, 33 PA08, 34 PA09, 35 PA10, 36 PA11, 37 VDDIO, 38 GND, 39 PB10, 40 PB11, 41 PB12, 42 PB13, 43 PB14, 44 PB15, 45 GND, 46 VDDIO, 47 PD08, 48 PD09, 49 PD10, 50 PD11, 51 PD12, 52 PC10, 53 GND, 54 VDDIO, 55 PC11, 56 PC12, 57 PC13, 58 PC14, 59 PC15, 60 PA12, 61 PA13, 62 PA14, 63 PA15, 64 GND, 65 VDDIO, 66 PA16, 67 PA17, 68 PA18, 69 PA19, 70 PC16, 71 PC17, 72 PC18, 73 PC19, 74 PC20, 75 PC21, 76 PC22, 77 PC23, 78 GND, 79 VDDIO, 80 PD20, 81 PD21, 82 PB16, 83 PB17, 84 PB18, 85 PB19, 86 PB20, 87 PB21, 88 PA20, 89 PA21, 90 GND, 91 VDDIO, 92 PA22, 93 PA23, 94 PA24, 95 PA25, 96 GND, 97 VDDIO, 98 PB22, 99 PB23, 100 PB24, 101 PB25, 102 PB26, 103 PB27, 104 PB28, 105 PB29, 106 GND, 107 VDDIO, 108 PC24, 109 PC25, 110 PC26, 111 PC27, 112 PC28, 113 PA27, 114 RESET_N, 115 VDDCORE, 116 GND, 117 VSW, 118 VDDIO, 119 PA30, 120 PA31, 121 PB30, 122 PB31, 123 PC30, 124 PC31, 125 PB00, 126 PB01, 127 PB02, 128 PB03
