# PIC32CK2051SG00144 device description
Architecture: CORTEX-M33; Family: PIC32CK; Series: PIC32CKSG00

## Peripheral instances (address, pins/pin function, parameters) (continued)
SERCOM1 at 0x44812000 (SERCOM)
  pins: PAD0 PD08/C set 1 or PD13/C set 2; PAD1 PD09/C set 1 or PD14/C set 2; PAD2 PD10/C set 1 or PD15/C set 2; PAD3 PD11/C set 1 or PD16/C set 2
  parameters: CLK_REDUCTION=1 (Reduce clock options to pin 1 for SPI and USART), DMA=1 (DMA support implemented?), DMAC_ID_RX=7 (Index of DMA RX trigger), DMAC_ID_TX=8 (Index of DMA TX trigger), FIFO_IMPLEMENTED=1 (FIFO Rx/Tx implemented?), FIFO_SIZE=8 (Rx-Tx FIFO size in bytes), FSYNC_IMPLEMENTED=1 (SPI Frame Synch mode implemented?), GCLK_ID_CORE=20, GCLK_ID_SLOW=18, SPI=1 (SPI mode implemented?), TWIM=1 (TWI Master mode implemented?), TWIS=1 (TWI Slave mode implemented?), TWI_HSMODE=1 (TWI HighSpeed mode implemented?), ULTRA_IMPLEMENTATION=0 (ULTRA platform compatibility?), USART=1 (USART mode implemented?), USART_AUTOBAUD=1 (USART autobaud implemented?), USART_IRDA=1 (USART IrDA implemented?), USART_ISO7816=1 (USART ISO7816 mode implemented?), USART_LIN_MASTER=1 (USART LIN Master mode implemented?), USART_RS485=1 (USART RS485 mode implemented?), INSTANCE_ID=41 (Instance index for SERCOM1), MCLK_ID_APB=72 (Index for SERCOM1 APB clock), PAC_ID=41 (Index for SERCOM1 registers write protection), USART_ERROR_INT_SRC=50 (USART/SPI/I2C Error), USART_TX_READY_INT_SRC=51 (USART-SPI Data Register Empty/ I2C Stop Received), USART_TX_COMPLETE_INT_SRC=52 (USART-SPI Transmit Complete/ I2C Address Match), USART_RX_INT_SRC=53 (USART-SPI Receive Complete/ I2C Data Ready), SPI_TX_READY_INT_SRC=51 (USART-SPI Data Register Empty/ I2C Stop Received), SPI_TX_COMPLETE_INT_SRC=52 (USART-SPI Transmit Complete/ I2C Address Match), SPI_RX_INT_SRC=53 (USART-SPI Receive Complete/ I2C Data Ready), I2C_0_INT_SRC=50 (USART/SPI/I2C Error), I2C_1_INT_SRC=53 (USART-SPI Receive Complete/ I2C Data Ready), I2C_2_INT_SRC=54 (USART Receive Start/ SPI Slave Select Low/ I2C TX FIFO Empty), I2C_3_INT_SRC=55 (USART Clear To Send Input Change/ I2C RX FIFO Full)
SERCOM2 at 0x44814000 (SERCOM)
  pins: PAD0 PC11/D set 1 or PC06/C set 4 or PC15/C set 2 or PC21/C set 3; PAD1 PC10/D set 1 or PC07/C set 4 or PC16/C set 2 or PC22/C set 3; PAD2 PC12/D set 1 or PC09/C set 4 or PC14/C set 3 or PC17/C set 2; PAD3 PC13/D set 1 or PC18/C set 2 or PC23/C set 3 or PC26/C set 4
  parameters: CLK_REDUCTION=1 (Reduce clock options to pin 1 for SPI and USART), DMA=1 (DMA support implemented?), DMAC_ID_RX=9 (Index of DMA RX trigger), DMAC_ID_TX=10 (Index of DMA TX trigger), FIFO_IMPLEMENTED=1 (FIFO Rx/Tx implemented?), FIFO_SIZE=8 (Rx-Tx FIFO size in bytes), FSYNC_IMPLEMENTED=1 (SPI Frame Synch mode implemented?), GCLK_ID_CORE=21, GCLK_ID_SLOW=18, SPI=1 (SPI mode implemented?), TWIM=1 (TWI Master mode implemented?), TWIS=1 (TWI Slave mode implemented?), TWI_HSMODE=1 (TWI HighSpeed mode implemented?), ULTRA_IMPLEMENTATION=0 (ULTRA platform compatibility?), USART=1 (USART mode implemented?), USART_AUTOBAUD=1 (USART autobaud implemented?), USART_IRDA=1 (USART IrDA implemented?), USART_ISO7816=1 (USART ISO7816 mode implemented?), USART_LIN_MASTER=1 (USART LIN Master mode implemented?), USART_RS485=1 (USART RS485 mode implemented?), INSTANCE_ID=42 (Instance index for SERCOM2), MCLK_ID_APB=73 (Index for SERCOM2 APB clock), PAC_ID=42 (Index for SERCOM2 registers write protection), USART_ERROR_INT_SRC=56 (USART/SPI/I2C Error), USART_TX_READY_INT_SRC=57 (USART-SPI Data Register Empty/ I2C Stop Received), USART_TX_COMPLETE_INT_SRC=58 (USART-SPI Transmit Complete/ I2C Address Match), USART_RX_INT_SRC=59 (USART-SPI Receive Complete/ I2C Data Ready), SPI_TX_READY_INT_SRC=57 (USART-SPI Data Register Empty/ I2C Stop Received), SPI_TX_COMPLETE_INT_SRC=58 (USART-SPI Transmit Complete/ I2C Address Match), SPI_RX_INT_SRC=59 (USART-SPI Receive Complete/ I2C Data Ready), I2C_0_INT_SRC=56 (USART/SPI/I2C Error), I2C_1_INT_SRC=59 (USART-SPI Receive Complete/ I2C Data Ready), I2C_2_INT_SRC=60 (USART Receive Start/ SPI Slave Select Low/ I2C TX FIFO Empty), I2C_3_INT_SRC=61 (USART Clear To Send Input Change/ I2C RX FIFO Full)
SERCOM3 at 0x44816000 (SERCOM)
  pins: PAD0 PC07/D set 4 or PB16/C set 2 or PB21/C set 3 or PC02/C set 1; PAD1 PC06/D set 4 or PB17/C set 2 or PB22/C set 3 or PC03/C set 1; PAD2 PC09/D set 4 or PB07/C set 2 or PB23/C set 3 or PC04/C set 1; PAD3 PC15/D set 4 or PB08/C set 2 or PB24/C set 3 or PC05/C set 1
  parameters: CLK_REDUCTION=1 (Reduce clock options to pin 1 for SPI and USART), DMA=1 (DMA support implemented?), DMAC_ID_RX=11 (Index of DMA RX trigger), DMAC_ID_TX=12 (Index of DMA TX trigger), FIFO_IMPLEMENTED=1 (FIFO Rx/Tx implemented?), FIFO_SIZE=8 (Rx-Tx FIFO size in bytes), FSYNC_IMPLEMENTED=1 (SPI Frame Synch mode implemented?), GCLK_ID_CORE=22, GCLK_ID_SLOW=18, SPI=1 (SPI mode implemented?), TWIM=1 (TWI Master mode implemented?), TWIS=1 (TWI Slave mode implemented?), TWI_HSMODE=1 (TWI HighSpeed mode implemented?), ULTRA_IMPLEMENTATION=0 (ULTRA platform compatibility?), USART=1 (USART mode implemented?), USART_AUTOBAUD=1 (USART autobaud implemented?), USART_IRDA=1 (USART IrDA implemented?), USART_ISO7816=1 (USART ISO7816 mode implemented?), USART_LIN_MASTER=1 (USART LIN Master mode implemented?), USART_RS485=1 (USART RS485 mode implemented?), INSTANCE_ID=43 (Instance index for SERCOM3), MCLK_ID_APB=74 (Index for SERCOM3 APB clock), PAC_ID=43 (Index for SERCOM3 registers write protection), USART_ERROR_INT_SRC=62 (USART/SPI/I2C Error), USART_TX_READY_INT_SRC=63 (USART-SPI Data Register Empty/ I2C Stop Received), USART_TX_COMPLETE_INT_SRC=64 (USART-SPI Transmit Complete/ I2C Address Match), USART_RX_INT_SRC=65 (USART-SPI Receive Complete/ I2C Data Ready), SPI_TX_READY_INT_SRC=63 (USART-SPI Data Register Empty/ I2C Stop Received), SPI_TX_COMPLETE_INT_SRC=64 (USART-SPI Transmit Complete/ I2C Address Match), SPI_RX_INT_SRC=65 (USART-SPI Receive Complete/ I2C Data Ready), I2C_0_INT_SRC=62 (USART/SPI/I2C Error), I2C_1_INT_SRC=65 (USART-SPI Receive Complete/ I2C Data Ready), I2C_2_INT_SRC=66 (USART Receive Start/ SPI Slave Select Low/ I2C TX FIFO Empty), I2C_3_INT_SRC=67 (USART Clear To Send Input Change/ I2C RX FIFO Full)
SERCOM4 at 0x45000000 (SERCOM)
  pins: PAD0 PB10/D set 4 or PB04/C set 2 or PB09/C set 1 or PB12/C set 3; PAD1 PB09/D set 4 or PB05/C set 2 or PB10/C set 1 or PB18/C set 3; PAD2 PB07/D set 4 or PB13/C set 2 or PB19/C set 3 or PC00/C set 1; PAD3 PB08/D set 4 or PB06/C set 2 or PB20/C set 3 or PC01/C set 1
  parameters: CLK_REDUCTION=1 (Reduce clock options to pin 1 for SPI and USART), DMA=1 (DMA support implemented?), DMAC_ID_RX=41 (Index of DMA RX trigger), DMAC_ID_TX=42 (Index of DMA TX trigger), FIFO_IMPLEMENTED=1 (FIFO Rx/Tx implemented?), FIFO_SIZE=8 (Rx-Tx FIFO size in bytes), FSYNC_IMPLEMENTED=1 (SPI Frame Synch mode implemented?), GCLK_ID_CORE=25, GCLK_ID_SLOW=18, SPI=1 (SPI mode implemented?), TWIM=1 (TWI Master mode implemented?), TWIS=1 (TWI Slave mode implemented?), TWI_HSMODE=1 (TWI HighSpeed mode implemented?), ULTRA_IMPLEMENTATION=0 (ULTRA platform compatibility?), USART=1 (USART mode implemented?), USART_AUTOBAUD=1 (USART autobaud implemented?), USART_IRDA=1 (USART IrDA implemented?), USART_ISO7816=1 (USART ISO7816 mode implemented?), USART_LIN_MASTER=1 (USART LIN Master mode implemented?), USART_RS485=1 (USART RS485 mode implemented?), INSTANCE_ID=64 (Instance index for SERCOM4), MCLK_ID_APB=96 (Index for SERCOM4 APB clock), PAC_ID=64 (Index for SERCOM4 registers write protection), USART_ERROR_INT_SRC=96 (USART/SPI/I2C Error), USART_TX_READY_INT_SRC=97 (USART-SPI Data Register Empty/ I2C Stop Received), USART_TX_COMPLETE_INT_SRC=98 (USART-SPI Transmit Complete/ I2C Address Match), USART_RX_INT_SRC=99 (USART-SPI Receive Complete/ I2C Data Ready), SPI_TX_READY_INT_SRC=97 (USART-SPI Data Register Empty/ I2C Stop Received), SPI_TX_COMPLETE_INT_SRC=98 (USART-SPI Transmit Complete/ I2C Address Match), SPI_RX_INT_SRC=99 (USART-SPI Receive Complete/ I2C Data Ready), I2C_0_INT_SRC=96 (USART/SPI/I2C Error), I2C_1_INT_SRC=99 (USART-SPI Receive Complete/ I2C Data Ready), I2C_2_INT_SRC=100 (USART Receive Start/ SPI Slave Select Low/ I2C TX FIFO Empty), I2C_3_INT_SRC=101 (USART Clear To Send Input Change/ I2C RX FIFO Full)
SERCOM5 at 0x45002000 (SERCOM)
  pins: PAD0 PA05/D set 4 or PA11/C set 1 or PA13/C set 2 or PA24/C set 3; PAD1 PA06/D set 4 or PA12/C set 1 or PA14/C set 2 or PA25/C set 3; PAD2 PA07/D set 4 or PA15/C set 2 or PA26/C set 3 or PB00/C set 1; PAD3 PA08/D set 4 or PA16/C set 2 or PA27/C set 3 or PB01/C set 1
  parameters: CLK_REDUCTION=1 (Reduce clock options to pin 1 for SPI and USART), DMA=1 (DMA support implemented?), DMAC_ID_RX=43 (Index of DMA RX trigger), DMAC_ID_TX=44 (Index of DMA TX trigger), FIFO_IMPLEMENTED=1 (FIFO Rx/Tx implemented?), FIFO_SIZE=8 (Rx-Tx FIFO size in bytes), FSYNC_IMPLEMENTED=1 (SPI Frame Synch mode implemented?), GCLK_ID_CORE=26, GCLK_ID_SLOW=18, SPI=1 (SPI mode implemented?), TWIM=1 (TWI Master mode implemented?), TWIS=1 (TWI Slave mode implemented?), TWI_HSMODE=1 (TWI HighSpeed mode implemented?), ULTRA_IMPLEMENTATION=0 (ULTRA platform compatibility?), USART=1 (USART mode implemented?), USART_AUTOBAUD=1 (USART autobaud implemented?), USART_IRDA=1 (USART IrDA implemented?), USART_ISO7816=1 (USART ISO7816 mode implemented?), USART_LIN_MASTER=1 (USART LIN Master mode implemented?), USART_RS485=1 (USART RS485 mode implemented?), INSTANCE_ID=65 (Instance index for SERCOM5), MCLK_ID_APB=97 (Index for SERCOM5 APB clock), PAC_ID=65 (Index for SERCOM5 registers write protection), USART_ERROR_INT_SRC=102 (USART/SPI/I2C Error), USART_TX_READY_INT_SRC=103 (USART-SPI Data Register Empty/ I2C Stop Received), USART_TX_COMPLETE_INT_SRC=104 (USART-SPI Transmit Complete/ I2C Address Match), USART_RX_INT_SRC=105 (USART-SPI Receive Complete/ I2C Data Ready), SPI_TX_READY_INT_SRC=103 (USART-SPI Data Register Empty/ I2C Stop Received), SPI_TX_COMPLETE_INT_SRC=104 (USART-SPI Transmit Complete/ I2C Address Match), SPI_RX_INT_SRC=105 (USART-SPI Receive Complete/ I2C Data Ready), I2C_0_INT_SRC=102 (USART/SPI/I2C Error), I2C_1_INT_SRC=105 (USART-SPI Receive Complete/ I2C Data Ready), I2C_2_INT_SRC=106 (USART Receive Start/ SPI Slave Select Low/ I2C TX FIFO Empty), I2C_3_INT_SRC=107 (USART Clear To Send Input Change/ I2C RX FIFO Full)
SERCOM6 at 0x45004000 (SERCOM)
  pins: PAD0 PA00/D set 2 or PA18/D set 3 or PA07/C set 1; PAD1 PA01/D set 2 or PA28/D set 3 or PA08/C set 1; PAD2 PA02/D set 2 or PA19/D set 3 or PA09/C set 1; PAD3 PA03/D set 2 or PA09/D set 3 or PA10/C set 1
  parameters: CLK_REDUCTION=1 (Reduce clock options to pin 1 for SPI and USART), DMA=1 (DMA support implemented?), DMAC_ID_RX=45 (Index of DMA RX trigger), DMAC_ID_TX=46 (Index of DMA TX trigger), FIFO_IMPLEMENTED=1 (FIFO Rx/Tx implemented?), FIFO_SIZE=8 (Rx-Tx FIFO size in bytes), FSYNC_IMPLEMENTED=1 (SPI Frame Synch mode implemented?), GCLK_ID_CORE=27, GCLK_ID_SLOW=18, SPI=1 (SPI mode implemented?), TWIM=1 (TWI Master mode implemented?), TWIS=1 (TWI Slave mode implemented?), TWI_HSMODE=1 (TWI HighSpeed mode implemented?), ULTRA_IMPLEMENTATION=0 (ULTRA platform compatibility?), USART=1 (USART mode implemented?), USART_AUTOBAUD=1 (USART autobaud implemented?), USART_IRDA=1 (USART IrDA implemented?), USART_ISO7816=1 (USART ISO7816 mode implemented?), USART_LIN_MASTER=1 (USART LIN Master mode implemented?), USART_RS485=1 (USART RS485 mode implemented?), INSTANCE_ID=66 (Instance index for SERCOM6), MCLK_ID_APB=98 (Index for SERCOM6 APB clock), PAC_ID=66 (Index for SERCOM6 registers write protection), USART_ERROR_INT_SRC=108 (USART/SPI/I2C Error), USART_TX_READY_INT_SRC=109 (USART-SPI Data Register Empty/ I2C Stop Received), USART_TX_COMPLETE_INT_SRC=110 (USART-SPI Transmit Complete/ I2C Address Match), USART_RX_INT_SRC=111 (USART-SPI Receive Complete/ I2C Data Ready), SPI_TX_READY_INT_SRC=109 (USART-SPI Data Register Empty/ I2C Stop Received), SPI_TX_COMPLETE_INT_SRC=110 (USART-SPI Transmit Complete/ I2C Address Match), SPI_RX_INT_SRC=111 (USART-SPI Receive Complete/ I2C Data Ready), I2C_0_INT_SRC=108 (USART/SPI/I2C Error), I2C_1_INT_SRC=111 (USART-SPI Receive Complete/ I2C Data Ready), I2C_2_INT_SRC=112 (USART Receive Start/ SPI Slave Select Low/ I2C TX FIFO Empty), I2C_3_INT_SRC=113 (USART Clear To Send Input Change/ I2C RX FIFO Full)
SERCOM7 at 0x45006000 (SERCOM)
  pins: PAD0 PA12/D set 3 or PB18/D set 4 or PA21/C set 2 or PA01/C set 1; PAD1 PA11/D set 3 or PB12/D set 4 or PA04/C set 1 or PA20/C set 2; PAD2 PB00/D set 3 or PB19/D set 4 or PA05/C set 1 or PA22/C set 2; PAD3 PB01/D set 3 or PB20/D set 4 or PA06/C set 1 or PA23/C set 2
  parameters: CLK_REDUCTION=1 (Reduce clock options to pin 1 for SPI and USART), DMA=1 (DMA support implemented?), DMAC_ID_RX=47 (Index of DMA RX trigger), DMAC_ID_TX=48 (Index of DMA TX trigger), FIFO_IMPLEMENTED=1 (FIFO Rx/Tx implemented?), FIFO_SIZE=8 (Rx-Tx FIFO size in bytes), FSYNC_IMPLEMENTED=1 (SPI Frame Synch mode implemented?), GCLK_ID_CORE=28, GCLK_ID_SLOW=18, SPI=1 (SPI mode implemented?), TWIM=0 (TWI Master mode implemented?), TWIS=0 (TWI Slave mode implemented?), TWI_HSMODE=0 (TWI HighSpeed mode implemented?), ULTRA_IMPLEMENTATION=0 (ULTRA platform compatibility?), USART=1 (USART mode implemented?), USART_AUTOBAUD=1 (USART autobaud implemented?), USART_IRDA=1 (USART IrDA implemented?), USART_ISO7816=1 (USART ISO7816 mode implemented?), USART_LIN_MASTER=1 (USART LIN Master mode implemented?), USART_RS485=1 (USART RS485 mode implemented?), INSTANCE_ID=67 (Instance index for SERCOM7), MCLK_ID_APB=99 (Index for SERCOM7 APB clock), PAC_ID=67 (Index for SERCOM7 registers write protection), USART_ERROR_INT_SRC=114 (USART/SPI/I2C Error), USART_TX_READY_INT_SRC=115 (USART-SPI Data Register Empty/ I2C Stop Received), USART_TX_COMPLETE_INT_SRC=116 (USART-SPI Transmit Complete/ I2C Address Match), USART_RX_INT_SRC=117 (USART-SPI Receive Complete/ I2C Data Ready), SPI_TX_READY_INT_SRC=115 (USART-SPI Data Register Empty/ I2C Stop Received), SPI_TX_COMPLETE_INT_SRC=116 (USART-SPI Transmit Complete/ I2C Address Match), SPI_RX_INT_SRC=117 (USART-SPI Receive Complete/ I2C Data Ready), I2C_0_INT_SRC=114 (USART/SPI/I2C Error), I2C_1_INT_SRC=117 (USART-SPI Receive Complete/ I2C Data Ready), I2C_2_INT_SRC=118 (USART Receive Start/ SPI Slave Select Low/ I2C TX FIFO Empty), I2C_3_INT_SRC=119 (USART Clear To Send Input Change/ I2C RX FIFO Full)
SIG at 0xE000EF00
SIG_NS at 0xE002EF00 (SIG)
SPI_IXS at 0x45016000
  pins: FSYNC PA09/J set 2 or PD06/J set 1 or PD13/J set 3; SCK PA11/J set 2 or PD10/J set 1 or PD14/J set 3; SDI PA12/J set 2 or PD07/J set 1 or PD16/J set 3; SDO PB00/J set 2 or PD08/J set 1 or PD17/J set 3
  parameters: DMAC_ID_RX=65, DMAC_ID_TX=66, GCLK_ID=36 (Index of Generic Clock), TPD_MASTER=0 (Indicates a master or slave number for TPD mode( 1=master,0=slave)), INSTANCE_ID=75 (Instance index for SPI_IXS), MCLK_ID_APB=107 (Index for SPI_IXS APB clock), PAC_ID=75 (Index for SPI_IXS registers write protection)
SQI at 0x0FFFF000
  pins: CLK PD10/H set 1; CS0 PD06/H set 1; CS1 PD05/H set 1; CS2 PA10/H set 1; CS3 PD12/H set 1; DATA0 PD07/H set 1; DATA1 PD11/H set 1; DATA2 PD08/H set 1; DATA3 PD09/H set 1
  parameters: ATSPEED_IMPLEMENTED=1, CBUF_DEPTH=3, GCLK_ID=43 (Index of Generic Clock), SFR_ADDRESS=0x0ffff000, TRXBUF_DEPTH=8, XIP_ADDRESS=0x10, XIP_CS_MSB=3, XIP_HSEL=1, INSTANCE_ID=96 (Instance index for SQI), MCLK_ID_AHB=16 (Index for SQI AHB clock), PAC_ID=96 (Index for SQI registers write protection)
SUPC at 0x44008000
  pins: ATEST_ANA ATEST_ANA; EXT_VREF_ANA EXT_VREF_ANA
  parameters: ADDVREG_NUM=1 (Number of additional capless regulators for USB, PLL, ...), ADDVREG_PLL_NUM=0 (Number of additional capless regulators dedicated to PLL(s) (between 0 and ADDVREG_NUM)), ADDVREG_PLL_START_INDEX=1 (Index of the first additional capless regulator dedicated to a PLL within [ADDVREG_NUM-1:0] range. Must be equal to 1 if ADDVREG_PLL_NUM=0.), BKOUT_NUM=2 (Number of BKOUT output pin), BORVDDUSB_NUM=1 (Number of BOR_USB), CHRG_PUMP_NUM=2 (Number of Charge Pump), IOB_IMPLEMENTED=1 (one if IOB feature is implemented), USER_LDO_IMPLEMENTED=1 (one if USER_LDO feature is implemented), VBAT_IMPLEMENTED=1 (one if VBAT feature (battery backup feature) is implemented.), VREGSW_NUM=2 (Number of main voltage regulator (100mA). Example: 1 for Unicorn, 4 for Riverside.), INSTANCE_ID=4 (Instance index for SUPC), MCLK_ID_APB=36 (Index for SUPC APB clock), PAC_ID=4 (Index for SUPC registers write protection)
SysTick at 0xE000E010
SysTick_NS at 0xE002E010 (SysTick)
  parameters: __SYST_NUM=2 (Number of implemented SysTick timers)
TCC0 at 0x44818000 (TCC)
  pins: WO0 PB10/G set 2 or PB04/F set 1; WO1 PC00/G set 2 or PB05/F set 1; WO2 PC01/G set 2 or PB13/F set 1; WO3 PC02/G set 2 or PB06/F set 1; WO4 PC03/G set 2 or PB14/F set 1; WO5 PC04/G set 2 or PB15/F set 1; WO6 PC21/G set 2 or PB21/F set 1; WO7 PC22/G set 2 or PB22/F set 1
  parameters: CC_NUM=6 (Number of Compare/Capture units), DITHERING=1 (Dithering feature implemented), DMAC_ID_MC_{n}={n+14} (Indexes of DMA Match/Compare triggers {n}) (n=0..5), DMAC_ID_OVF=13 (DMA overflow/underflow/retrigger trigger), DTI=1 (Dead-Time-Insertion feature implemented), GCLK_ID=23 (Index of Generic Clock), MASTER_SLAVE_MODE=1 (TCC type 0 : NA, 1 : Master, 2 : Slave), OTMX=1 (Output Matrix feature implemented), OW_NUM=8 (Number of Output Waveforms), PG=1 (Pattern Generation feature implemented), SIZE=32, SWAP=1 (DTI outputs swap feature implemented), INSTANCE_ID=44 (Instance index for TCC0), MCLK_ID_APB=75 (Index for TCC0 APB clock), PAC_ID=44 (Index for TCC0 registers write protection)
TCC1 at 0x4481A000 (TCC)
  pins: WO0 PC05/G set 2 or PC15/F set 1; WO1 PC06/G set 2 or PC16/F set 1; WO2 PC07/G set 2 or PC17/F set 1; WO3 PC09/G set 2 or PC18/F set 1; WO4 PC15/G set 2 or PC19/F set 1; WO5 PC10/G set 2 or PC20/F set 1; WO6 PC11/G set 2 or PC28/F set 1; WO7 PC12/G set 2 or PC29/F set 1
  parameters: CC_NUM=6 (Number of Compare/Capture units), DITHERING=1 (Dithering feature implemented), DMAC_ID_MC_{n}={n+21} (Indexes of DMA Match/Compare triggers {n}) (n=0..5), DMAC_ID_OVF=20 (DMA overflow/underflow/retrigger trigger), DTI=1 (Dead-Time-Insertion feature implemented), GCLK_ID=23 (Index of Generic Clock), MASTER_SLAVE_MODE=2 (TCC type 0 : NA, 1 : Master, 2 : Slave), OTMX=1 (Output Matrix feature implemented), OW_NUM=8 (Number of Output Waveforms), PG=1 (Pattern Generation feature implemented), SIZE=32, SWAP=1 (DTI outputs swap feature implemented), INSTANCE_ID=45 (Instance index for TCC1), MCLK_ID_APB=76 (Index for TCC1 APB clock), PAC_ID=45 (Index for TCC1 registers write protection)
TCC2 at 0x4481C000 (TCC)
  pins: WO0 PD05/G set 2 or PA00/F set 1; WO1 PD06/G set 2 or PD12/F set 1; WO2 PD07/G set 2 or PD11/F set 1; WO3 PD08/G set 2 or PA01/F set 1; WO4 PD09/G set 2 or PD06/F set 1; WO5 PD10/G set 2 or PD07/F set 1; WO6 PD11/G set 2 or PD13/F set 1; WO7 PD12/G set 2 or PD14/F set 1
  parameters: CC_NUM=6 (Number of Compare/Capture units), DITHERING=1 (Dithering feature implemented), DMAC_ID_MC_{n}={n+28} (Indexes of DMA Match/Compare triggers {n}) (n=0..5), DMAC_ID_OVF=27 (DMA overflow/underflow/retrigger trigger), DTI=1 (Dead-Time-Insertion feature implemented), GCLK_ID=24 (Index of Generic Clock), MASTER_SLAVE_MODE=1 (TCC type 0 : NA, 1 : Master, 2 : Slave), OTMX=1 (Output Matrix feature implemented), OW_NUM=8 (Number of Output Waveforms), PG=1 (Pattern Generation feature implemented), SIZE=32, SWAP=1 (DTI outputs swap feature implemented), INSTANCE_ID=46 (Instance index for TCC2), MCLK_ID_APB=77 (Index for TCC2 APB clock), PAC_ID=46 (Index for TCC2 registers write protection)
TCC3 at 0x4481E000 (TCC)
  pins: WO0 PA09/G set 2 or PA04/F set 1; WO1 PA10/G set 2 or PA05/F set 1; WO2 PA11/G set 2 or PA06/F set 1; WO3 PA12/G set 2 or PA07/F set 1; WO4 PB00/G set 2 or PA08/F set 1; WO5 PB01/G set 2 or PA18/F set 1; WO6 PB11/G set 2 or PA28/F set 1; WO7 PB12/G set 2 or PA19/F set 1
  parameters: CC_NUM=6 (Number of Compare/Capture units), DITHERING=1 (Dithering feature implemented), DMAC_ID_MC_{n}={n+35} (Indexes of DMA Match/Compare triggers {n}) (n=0..5), DMAC_ID_OVF=34 (DMA overflow/underflow/retrigger trigger), DTI=1 (Dead-Time-Insertion feature implemented), GCLK_ID=24 (Index of Generic Clock), MASTER_SLAVE_MODE=2 (TCC type 0 : NA, 1 : Master, 2 : Slave), OTMX=1 (Output Matrix feature implemented), OW_NUM=8 (Number of Output Waveforms), PG=1 (Pattern Generation feature implemented), SIZE=32, SWAP=1 (DTI outputs swap feature implemented), INSTANCE_ID=47 (Instance index for TCC3), MCLK_ID_APB=78 (Index for TCC3 APB clock), PAC_ID=47 (Index for TCC3 registers write protection)
TCC4 at 0x45008000 (TCC)
  pins: WO0 PA11/F set 1 or PA13/F set 2 or PA20/F set 3 or PB12/F set 4; WO1 PA12/F set 1 or PA14/F set 2 or PA21/F set 3 or PB18/F set 4
  parameters: CC_NUM=2 (Number of Compare/Capture units), DITHERING=0 (Dithering feature implemented), DMAC_ID_MC_0=50 (Indexes of DMA Match/Compare triggers 0), DMAC_ID_MC_1=51 (Indexes of DMA Match/Compare triggers 1), DMAC_ID_OVF=49 (DMA overflow/underflow/retrigger trigger), DTI=0 (Dead-Time-Insertion feature implemented), GCLK_ID=29 (Index of Generic Clock), MASTER_SLAVE_MODE=0 (TCC type 0 : NA, 1 : Master, 2 : Slave), OTMX=0 (Output Matrix feature implemented), OW_NUM=2 (Number of Output Waveforms), PG=0 (Pattern Generation feature implemented), SIZE=16, SWAP=0 (DTI outputs swap feature implemented), INSTANCE_ID=68 (Instance index for TCC4), MCLK_ID_APB=100 (Index for TCC4 APB clock), PAC_ID=68 (Index for TCC4 registers write protection)
TCC5 at 0x4500A000 (TCC)
  pins: WO0 PA15/F set 2 or PA22/F set 3 or PB00/F set 1 or PB19/F set 4; WO1 PA16/F set 2 or PA23/F set 3 or PB01/F set 1 or PB20/F set 4
  parameters: CC_NUM=2 (Number of Compare/Capture units), DITHERING=0 (Dithering feature implemented), DMAC_ID_MC_0=53 (Indexes of DMA Match/Compare triggers 0), DMAC_ID_MC_1=54 (Indexes of DMA Match/Compare triggers 1), DMAC_ID_OVF=52 (DMA overflow/underflow/retrigger trigger), DTI=0 (Dead-Time-Insertion feature implemented), GCLK_ID=30 (Index of Generic Clock), MASTER_SLAVE_MODE=0 (TCC type 0 : NA, 1 : Master, 2 : Slave), OTMX=0 (Output Matrix feature implemented), OW_NUM=2 (Number of Output Waveforms), PG=0 (Pattern Generation feature implemented), SIZE=16, SWAP=0 (DTI outputs swap feature implemented), INSTANCE_ID=69 (Instance index for TCC5), MCLK_ID_APB=101 (Index for TCC5 APB clock), PAC_ID=69 (Index for TCC5 registers write protection)
TCC6 at 0x4500C000 (TCC)
  pins: WO0 PB16/F set 2 or PB23/F set 3 or PC01/F set 1; WO1 PB17/F set 2 or PB24/F set 3 or PC02/F set 1
  parameters: CC_NUM=2 (Number of Compare/Capture units), DITHERING=0 (Dithering feature implemented), DMAC_ID_MC_0=56 (Indexes of DMA Match/Compare triggers 0), DMAC_ID_MC_1=57 (Indexes of DMA Match/Compare triggers 1), DMAC_ID_OVF=55 (DMA overflow/underflow/retrigger trigger), DTI=0 (Dead-Time-Insertion feature implemented), GCLK_ID=31 (Index of Generic Clock), MASTER_SLAVE_MODE=0 (TCC type 0 : NA, 1 : Master, 2 : Slave), OTMX=0 (Output Matrix feature implemented), OW_NUM=2 (Number of Output Waveforms), PG=0 (Pattern Generation feature implemented), SIZE=16, SWAP=0 (DTI outputs swap feature implemented), INSTANCE_ID=70 (Instance index for TCC6), MCLK_ID_APB=102 (Index for TCC6 APB clock), PAC_ID=70 (Index for TCC6 registers write protection)
TCC7 at 0x4500E000 (TCC)
  pins: WO0 PB07/F set 1 or PB25/F set 3 or PC03/F set 2; WO1 PB08/F set 1 or PB26/F set 3 or PC04/F set 2
  parameters: CC_NUM=2 (Number of Compare/Capture units), DITHERING=0 (Dithering feature implemented), DMAC_ID_MC_0=59 (Indexes of DMA Match/Compare triggers 0), DMAC_ID_MC_1=60 (Indexes of DMA Match/Compare triggers 1), DMAC_ID_OVF=58 (DMA overflow/underflow/retrigger trigger), DTI=0 (Dead-Time-Insertion feature implemented), GCLK_ID=32 (Index of Generic Clock), MASTER_SLAVE_MODE=0 (TCC type 0 : NA, 1 : Master, 2 : Slave), OTMX=0 (Output Matrix feature implemented), OW_NUM=2 (Number of Output Waveforms), PG=0 (Pattern Generation feature implemented), SIZE=16, SWAP=0 (DTI outputs swap feature implemented), INSTANCE_ID=71 (Instance index for TCC7), MCLK_ID_APB=103 (Index for TCC7 APB clock), PAC_ID=71 (Index for TCC7 registers write protection)
TPIU at 0xE0040000
TRAM at 0x4401E000
  parameters: ADDR_MSB=7 (Value of the MSB bit of physical RAM address), INSTANCE_ID=15 (Instance index for TRAM), MCLK_ID_APB=47 (Index for TRAM APB clock), PAC_ID=15 (Index for TRAM registers write protection)
TRNG at 0x45024000
  parameters: INSTANCE_ID=82 (Instance index for TRNG), MCLK_ID_APB=112 (Index for TRNG APB clock), PAC_ID=82 (Index for TRNG registers write protection)
USB at 0x4502A000
  pins: DM PD03/H set 1; DP PD04/H set 1; SOF_1KHZ PC01/H set 2 or PD02/H set 1
  parameters: AHB_2_USB_FIFO_DEPTH=4 (bytes number, should be at least 2, and 2^n (4,8,16 ...)), AHB_2_USB_RD_DATA_BITS=8 (8, 16 or 32, here : 8-bits is required as UTMI interface should work in 8-bits mode), AHB_2_USB_WR_DATA_BITS=32 (8, 16 or 32 : here, AHB transfer is made in word mode), AHB_2_USB_WR_THRESHOLD=2 (as soon as there are N bytes-free inside the fifo, ahb read transfer is requested), DATA_BUS_16_8=0 (UTMI/SIE data bus size : 0 -> 8 bits, 1 -> 16 bits), EPNUM=8 (parameter for rtl : max of ENDPOINT and PIPE NUM), EPT_NUM=8 (Number of USB end points), GCLK_ID=46 (Index of Generic Clock), INITIAL_CONTROL_QOS=3 (CONTROL QOS RESET value), INITIAL_DATA_QOS=3 (DATA QOS RESET value), MISSING_SOF_DET_IMPLEMENTED=1 (48 mHz xPLL feature implemented), PIPE_NUM=8 (Number of USB pipes), SYSTEM_CLOCK_IS_CKUSB=0 (Dual (1'b0) or Single (1'b1) clock system), USB_2_AHB_FIFO_DEPTH=4 (bytes number, should be at least 2, and 2^n (4,8,16 ...)), USB_2_AHB_RD_DATA_BITS=16 (8, 16 or 32, here : 8-bits is required as UTMI interface should work in 8-bits mode), USB_2_AHB_RD_THRESHOLD=2 (as soon as there are 16 bytes-free inside the fifo, ahb read transfer is requested), USB_2_AHB_WR_DATA_BITS=8 (8, 16 or 32 : here : 8-bits is required as UTMI interface should work in 8-bits mode), INSTANCE_ID=85 (Instance index for USB), MCLK_ID_AHB=19 (Index for USB AHB clock), MCLK_ID_APB=113 (Index for USB APB clock), PAC_ID=85 (Index for USB registers write protection)
USBHS at 0x46000000
  pins: USB0ID USB0ID; USB0PN USB0PN; USB0PP USB0PP; USBRBIAS USRBIAS; VBUS VBUS
  parameters: INSTANCE_ID=97 (Instance index for USBHS), MCLK_ID_AHB=20 (Index for USBHS AHB clock), PAC_ID=97 (Index for USBHS registers write protection)
WDT at 0x44016000
  parameters: FUSES_UPDATE_SUPPORT=0 (WDT Fuse Update Support), INSTANCE_ID=11 (Instance index for WDT), MCLK_ID_APB=43 (Index for WDT APB clock), PAC_ID=11 (Index for WDT registers write protection)

## Interrupts
-15 Reset — Reset Vector, invoked on Power up and warm reset
-14 NonMaskableInt — Non maskable Interrupt, cannot be stopped or preempted
-13 HardFault — Hard Fault, all classes of Fault
-12 MemoryManagement — Memory Management, MPU mismatch, including Access Violation and No Match
-11 BusFault — Bus Fault, Pre-Fetch-, Memory Access Fault, other address/memory related Fault
-10 UsageFault — Usage Fault, i.e. Undef Instruction, Illegal State Transition
-9 SecureFaultMonitor — Secure Fault
-5 SVCall — System Service Call via SVC instruction
-4 DebugMonitor
-2 PendSV — Pendable request for system service
-1 SysTick — System Tick Timer
0 FCR_ERR (FCR) — Flash Read Controller ECC Error
1 FCR_FLT (FCR) — Flash Read Controller CRC Fault
2 FCW — Flash Write Controller Interrupt
3 PM — Power Manager
4 SUPC — Supply Controller
5 OSCCTRL_XOSC (OSCCTRL) — External Oscillator
6 OSCCTRL_DFLL (OSCCTRL) — DFLL
7 OSCCTRL_PLL0 (OSCCTRL) — PLL
8 OSC32KCTRL — 32K Oscillator
9 MCLK — Main Clock
10 FREQM — Frequency Meter
11 WDT — Watchdog Timer
12 RTC
{n+13} EIC_EXTINT_{n} (EIC) (n=0..15) — External Interrupt {n}
29 EIC_NSCHK (EIC) — External Interrupt Non-Secure Check
30 PAC — Peripheral Access Controller
31 TRAM — Trust RAM Interrupt
32 PORT
33 DMA0_PRI0 (DMA0) — DMA 0 Priority 0 Interrupt
34 DMA0_PRI1 (DMA0) — DMA 0 Priority 1 Interrupt
35 DMA0_PRI2 (DMA0) — DMA 0 Priority 2 Interrupt
36 DMA1_PRI0 (DMA1) — DMA 1 Priority 0 Interrupt
37 DMA1_PRI1 (DMA1) — DMA 1 Priority 1 Interrupt
38 HMATRIX
39 EVSYS_0 (EVSYS) — Event System Channel 0
40 EVSYS_1 (EVSYS) — Event System Channel 1
41 EVSYS_2 (EVSYS) — Event System Channel 2
42 EVSYS_3 (EVSYS) — Event System Channel 3
43 EVSYS_OTHER (EVSYS) — Event System Channel 4..X
44 SERCOM0_56 (SERCOM0) — Serial Communication Interface 0
45 SERCOM0_0 (SERCOM0) — Serial Communication Interface 0
46 SERCOM0_1 (SERCOM0) — Serial Communication Interface 0
47 SERCOM0_2 (SERCOM0) — Serial Communication Interface 0
48 SERCOM0_3 (SERCOM0) — Serial Communication Interface 0
49 SERCOM0_4 (SERCOM0) — Serial Communication Interface 0
50 SERCOM1_56 (SERCOM1) — Serial Communication Interface 1
51 SERCOM1_0 (SERCOM1) — Serial Communication Interface 1
52 SERCOM1_1 (SERCOM1) — Serial Communication Interface 1
53 SERCOM1_2 (SERCOM1) — Serial Communication Interface 1
54 SERCOM1_3 (SERCOM1) — Serial Communication Interface 1
55 SERCOM1_4 (SERCOM1) — Serial Communication Interface 1
56 SERCOM2_56 (SERCOM2) — Serial Communication Interface 2
57 SERCOM2_0 (SERCOM2) — Serial Communication Interface 2
58 SERCOM2_1 (SERCOM2) — Serial Communication Interface 2
59 SERCOM2_2 (SERCOM2) — Serial Communication Interface 2
60 SERCOM2_3 (SERCOM2) — Serial Communication Interface 2
61 SERCOM2_4 (SERCOM2) — Serial Communication Interface 2
62 SERCOM3_56 (SERCOM3) — Serial Communication Interface 3
63 SERCOM3_0 (SERCOM3) — Serial Communication Interface 3
64 SERCOM3_1 (SERCOM3) — Serial Communication Interface 3
65 SERCOM3_2 (SERCOM3) — Serial Communication Interface 3
66 SERCOM3_3 (SERCOM3) — Serial Communication Interface 3
67 SERCOM3_4 (SERCOM3) — Serial Communication Interface 3
68 TCC0_OTHER (TCC0) — Error/Overflow/Underflow/Fault Interrupt
69 TCC0_MC0 (TCC0) — TCC Match/Compare 0
70 TCC0_MC1 (TCC0) — TCC Match/Compare 1
71 TCC0_MC2 (TCC0) — TCC Match/Compare 2
72 TCC0_MC3 (TCC0) — TCC Match/Compare 3
73 TCC0_MC4 (TCC0) — TCC Match/Compare 4
74 TCC0_MC5 (TCC0) — TCC Match/Compare 5
75 TCC1_OTHER (TCC1) — Error/Overflow/Underflow/Fault Interrupt
76 TCC1_MC0 (TCC1) — TCC Match/Compare 0
77 TCC1_MC1 (TCC1) — TCC Match/Compare 1
78 TCC1_MC2 (TCC1) — TCC Match/Compare 2
79 TCC1_MC3 (TCC1) — TCC Match/Compare 3
80 TCC1_MC4 (TCC1) — TCC Match/Compare 4
81 TCC1_MC5 (TCC1) — TCC Match/Compare 5
82 TCC2_OTHER (TCC2) — Error/Overflow/Underflow/Fault Interrupt
83 TCC2_MC0 (TCC2) — TCC Match/Compare 0
84 TCC2_MC1 (TCC2) — TCC Match/Compare 1
85 TCC2_MC2 (TCC2) — TCC Match/Compare 2
86 TCC2_MC3 (TCC2) — TCC Match/Compare 3
87 TCC2_MC4 (TCC2) — TCC Match/Compare 4
88 TCC2_MC5 (TCC2) — TCC Match/Compare 5
89 TCC3_OTHER (TCC3) — Error/Overflow/Underflow/Fault Interrupt
90 TCC3_MC0 (TCC3) — TCC Match/Compare 0
91 TCC3_MC1 (TCC3) — TCC Match/Compare 1
92 TCC3_MC2 (TCC3) — TCC Match/Compare 2
93 TCC3_MC3 (TCC3) — TCC Match/Compare 3
94 TCC3_MC4 (TCC3) — TCC Match/Compare 4
95 TCC3_MC5 (TCC3) — TCC Match/Compare 5
96 SERCOM4_56 (SERCOM4) — Serial Communication Interface 4
97 SERCOM4_0 (SERCOM4) — Serial Communication Interface 4
98 SERCOM4_1 (SERCOM4) — Serial Communication Interface 4
99 SERCOM4_2 (SERCOM4) — Serial Communication Interface 4
100 SERCOM4_3 (SERCOM4) — Serial Communication Interface 4
101 SERCOM4_4 (SERCOM4) — Serial Communication Interface 4
102 SERCOM5_56 (SERCOM5) — Serial Communication Interface 5
103 SERCOM5_0 (SERCOM5) — Serial Communication Interface 5
104 SERCOM5_1 (SERCOM5) — Serial Communication Interface 5
105 SERCOM5_2 (SERCOM5) — Serial Communication Interface 5
106 SERCOM5_3 (SERCOM5) — Serial Communication Interface 5
107 SERCOM5_4 (SERCOM5) — Serial Communication Interface 5
108 SERCOM6_56 (SERCOM6) — Serial Communication Interface 6
109 SERCOM6_0 (SERCOM6) — Serial Communication Interface 6
110 SERCOM6_1 (SERCOM6) — Serial Communication Interface 6
111 SERCOM6_2 (SERCOM6) — Serial Communication Interface 6
112 SERCOM6_3 (SERCOM6) — Serial Communication Interface 6
113 SERCOM6_4 (SERCOM6) — Serial Communication Interface 6
114 SERCOM7_56 (SERCOM7) — Serial Communication Interface 7
115 SERCOM7_0 (SERCOM7) — Serial Communication Interface 7
116 SERCOM7_1 (SERCOM7) — Serial Communication Interface 7
117 SERCOM7_2 (SERCOM7) — Serial Communication Interface 7
118 SERCOM7_3 (SERCOM7) — Serial Communication Interface 7
119 SERCOM7_4 (SERCOM7) — Serial Communication Interface 7
120 TCC4_OTHER (TCC4) — Error/Overflow/Underflow/Fault Interrupt
121 TCC4_MC0 (TCC4) — TCC Match/Compare 0
122 TCC4_MC1 (TCC4) — TCC Match/Compare 1
123 TCC5_OTHER (TCC5) — Error/Overflow/Underflow/Fault Interrupt
124 TCC5_MC0 (TCC5) — TCC Match/Compare 0
125 TCC5_MC1 (TCC5) — TCC Match/Compare 1
126 TCC6_OTHER (TCC6) — Error/Overflow/Underflow/Fault Interrupt
127 TCC6_MC0 (TCC6) — TCC Match/Compare 0
128 TCC6_MC1 (TCC6) — TCC Match/Compare 1
129 TCC7_OTHER (TCC7) — Error/Overflow/Underflow/Fault Interrupt
130 TCC7_MC0 (TCC7) — TCC Match/Compare 0
131 TCC7_MC1 (TCC7) — TCC Match/Compare 1
132 ADC_GLOBAL (ADC) — ADC Global Interrupt
133 ADC_CORE1 (ADC) — ADC Core 1 Interrupt
134 Reserved2 (ADC) — ADC Unused/Reserved
135 Reserved3 (ADC) — ADC Unused/Reserved
136 Reserved4 (ADC) — ADC Unused/Reserved
137 Reserved5 (ADC) — ADC Unused/Reserved
138 AC — Analog Comparator Interrupt
139 PTC — Peripheral Touch Controller
140 SPI_IXS — Audio SPI Interrupt
141 PCC
142 PDEC
143 Reserved6 (CAN0) — Controller Area Network 0 Unused/Reserved
144 Reserved7 (CAN1) — Controller Area Network 1 Unused/Reserved
145 ETH — Ethernet MAC Interrupt
146 SQI — Quad SPI Interrupt
147 TRNG — True Random Generator
148 SDMMC0 — SD/MMC Host Controller Interrupt 0
149 SDMMC1 — SD/MMC Host Controller Interrupt 1
150 USB_OTHER (USB) — USB Other Interrupt
151 USB_SOF (USB) — USB SOF Interrupt
152 USB_TRCPT0 (USB) — USB TRCPT0 Interrupt
153 USB_TRCPT1 (USB) — USB TRCPT1 Interrupt
154 USBHS — High Speed USB Interrupt
155 HSM_ERROR (HSM) — Hardware Security Module Error Interrupt
156 HSM_TXINT (HSM) — Hardware Security Module Transmit Interrupt
157 HSM_RXINT (HSM) — Hardware Security Module Receive Interrupt

## Event generators
1 SUPC_LVDET, 2 OSCCTRL_XOSC_FAIL, 3 OSC32KCTRL_XOSC32K_FAIL, 4 FREQM_DONE, 5 FREQM_WINMON, {n+6} RTC_PER_{n} (n=0..7), 14 RTC_PERD, {n+15} RTC_CMP_{n} (n=0..3), 19 RTC_TAMPER, 20 RTC_OVF, {n+21} EIC_EXTINT_{n} (n=0..15), 37 PAC_ACCERR, {n+38} DMA0_CH_{n} (n=0..7), {n+46} DMA1_CH_{n} (n=0..3), {9n+50} TCC{n}_OVF (n=0..4), {9n+51} TCC{n}_TRG (n=0..4), {9n+52} TCC{n}_CNT (n=0..4), {9n+53} TCC{n}_MC_0 (n=0..4), {9n+54} TCC{n}_MC_1 (n=0..4), {9n+55} TCC{n}_MC_2 (n=0..3), {9n+56} TCC{n}_MC_3 (n=0..3), {9n+57} TCC{n}_MC_4 (n=0..3), {9n+58} TCC{n}_MC_5 (n=0..3), {5n+66} TCC{n}_OVF (n=5..7), {5n+67} TCC{n}_TRG (n=5..7), {5n+68} TCC{n}_CNT (n=5..7), {5n+69} TCC{n}_MC_0 (n=5..7), {5n+70} TCC{n}_MC_1 (n=5..7), 106 ADC_CHRDYC_0, 107 ADC_CMP_0, 108 AC_COMP_0, 109 AC_COMP_1, 110 AC_WIN_0, 113 SPI_IXS_GEN, {n+114} CCL_LUTOUT_{n} (n=0..3), 118 PDEC_DIR, 119 PDEC_ERR, 120 PDEC_MC_0, 121 PDEC_MC_1, 122 PDEC_OVF, 123 PDEC_VLC, 125 TRNG_READY

## Event users
0 FREQM_START, 1 RTC_TAMPER, {n+2} PORT_EV_{n} (n=0..3), {n+6} DMA0_CHSTRT_{n} (n=0..7), {n+14} DMA0_CHAUX_{n} (n=0..7), {n+22} DMA1_CHSTRT_{n} (n=0..3), {n+26} DMA1_CHAUX_{n} (n=0..3), {8n+30} TCC{n}_EV_0 (n=0..4), {8n+31} TCC{n}_EV_1 (n=0..4), {8n+32} TCC{n}_MC_0 (n=0..4), {8n+33} TCC{n}_MC_1 (n=0..4), {8n+34} TCC{n}_MC_2 (n=0..3), {8n+35} TCC{n}_MC_3 (n=0..3), {8n+36} TCC{n}_MC_4 (n=0..3), {8n+37} TCC{n}_MC_5 (n=0..3), {4n+46} TCC{n}_EV_0 (n=5..7), {4n+47} TCC{n}_EV_1 (n=5..7), {4n+48} TCC{n}_MC_0 (n=5..7), {4n+49} TCC{n}_MC_1 (n=5..7), {n+78} ADC_TRIGGERS_{n} (n=0..10), 89 AC_SOC_0, 90 AC_SOC_1, {n+93} CCL_LUTIN_{n} (n=0..3), {n+97} PDEC_EVU_{n} (n=0..2), {n+100} HSM_TAMPER_{n} (n=0..3)

## Properties
SIGNATURES: DSU_DID=0x0950c053

## Pinouts (pin number, pad)
P144: 1 PA00, 2 PA01, 3 PA02, 4 PA03, 5 RESET_N, 6 GND, 7 VDDIO, 8 PA20, 9 PA21, 10 PA22, 11 PA23, 12 PA13, 13 PA14, 14 PA15, 15 PA16, 16 PA17, 17 PA24, 18 GND, 19 VDDIO, 20 PA25, 21 PA26, 22 PA27, 23 PA04, 24 PA05, 25 PA06, 26 PA07, 27 PA08, 28 PA18, 29 PA28, 30 GND, 31 VDDIO, 32 EXT, 33 PA09, 34 ATEST, 35 PA11, 36 PA12, 37 PB00, 38 VREFH, 39 PB11, 40 PB12, 41 PB18, 42 PB19, 43 PB20, 44 VSSA, 45 PB02, 46 PB03, 47 VDDA, 48 VDDIO, 49 GND, 50 PB04, 51 PB05, 52 PB13, 53 PB06, 54 PB14, 55 PB15, 56 VDDIO, 57 GND, 58 VDDREG, 59 PB21, 60 PB22, 61 PB23, 62 PB24, 63 PB25, 64 PB26, 65 PB16, 66 VDDIO, 67 GND, 68 PB17, 69 PB07, 70 PB08, 71 PB09, 72 PB10, 73 PC00, 74 PC01, 75 PC02, 76 PC03, 77 PC04, 78 VDDIO, 79 GND, 80 PC21, 81 PC22, 82 PC14, 83 PC23, 84 PC05, 85 PC06, 86 PC07, 87 PC24, 88 PC25, 89 VDDREG, 90 VDDIO, 91 GND, 92 PC26, 93 PC27, 94 PC09, 95 PC15, 96 PC28, 97 PC29, 98 PC16, 99 PC17, 100 PC18, 101 PC10, 102 VDDIO, 103 GND, 104 PC11, 105 PC12, 106 PC13, 107 PC19, 108 PC20, 109 USB0PN, 110 USB0PP, 111 USB0ID, 112 VCCAP3, 113 USBVSSA, 114 VBUS, 115 USRBIAS, 116 VDDREG, 117 VSSIO, 118 VDDIO, 119 PD00, 120 PD01, 121 PD02, 122 PD03, 123 PD04, 124 PD13, 125 PD14, 126 PD15, 127 PD16, 128 GND, 129 VDDIO, 130 PD17, 131 PD18, 132 PD19, 133 PD20, 134 PD21, 135 PD12, 136 PD05, 137 PD06, 138 PD07, 139 GND, 140 VDDIOB, 141 PD08, 142 PD09, 143 PD10, 144 PD11

## Notices in the file
Copyright (c) 2021 Microchip Technology Inc.
SPDX-License-Identifier: Apache-2.0
Licensed under the Apache License, Version 2.0 (the "License");
you may not use this file except in compliance with the License.
You may obtain a copy of the License at
http://www.apache.org/licenses/LICENSE-2.0
Unless required by applicable law or agreed to in writing, software
distributed under the License is distributed on an "AS IS" BASIS,
WITHOUT WARRANTIES OR CONDITIONS OF ANY KIND, either express or implied.
See the License for the specific language governing permissions and
limitations under the License.
