# PIC32CM5164LS00100 device description
Architecture: CORTEX-M23; Family: PIC32CM; Series: PIC32CMLS00
Parameters: NUM_IRQ=71 (Number of interrupt request lines), __ARMv8MBL_REV=0x0000 (Cortex-M23 Core Revision), __BKPT_NUM=4 (Number of FPB breakpoint comparators), __ETM_PRESENT=0 (ETM present or not), __FPU_PRESENT=0 (FPU present or not), __MPU_NS_REGIONS=12 (Number of MPU_NS regions), __MPU_PRESENT=1 (MPU present or not), __MPU_S_REGIONS=12 (Number of MPU_S regions), __MTB_PRESENT=0 (MTB present or not), __NVIC_PRIO_BITS=2 (Number of NVIC Priority bits), __SAU_PRESENT=0 (SAU present or not), __SEC_ENABLED=1 (TrustZone-M enabled or not), __SYST_NUM=2 (Number of SysTick instances), __VTOR_PRESENT=1 (Vector Table Offset Register present or not), __Vendor_SysTickConfig=0 (Set to 1 if different SysTick Config is used), __WPT_NUM=2 (Number of DWT watchpoint comparators), __ARCH_ARM=1, __ARCH_ARM_CORTEX_M=1
Programming and debug interfaces: SWD
Registers are 32-bit, read-write, reset 0x0 unless marked. A register's access mark holds for its fields unless they carry their own. Offsets are from the block's base; lines under a group give offsets from that group; [hi:lo] are bit positions; {n}, {i} and the like mark numbered series; 'fields as' and 'values as' point back to an identical list; <NAME> marks a mode.

## Ordering variants
PIC32CM5164LS00100-I/PF: TQFP100, up to 48 MHz, -40 to 85 C, 1.62 to 3.63 V
PIC32CM5164LS00100-E/PF: TQFP100, up to 48 MHz, -40 to 125 C, 1.62 to 3.63 V

## Memory
base space: start 0 size 0x100000000, little endian
  0x00000000 FLASH size 0x80000 flash, rw, executable, page 64
  0x00804000 AUX0 size 0x100 fuses, rw, page 64
  0x00806000 AUX1 size 0x100 fuses, rw, page 64
  0x00808000 AUX2 size 0x100 fuses, rw, page 64
  0x0080A000 AUX3 size 0x100 fuses, rw, page 64
  0x0080C000 AUX4 size 0x100 fuses, rw, page 64
  0x0080E000 AUX5 size 0x100 fuses, rw, page 64
  0x0080C000 BOCOR size 0x100 fuses, rw, page 64
  0x0080C008 BOCOR1 size 0x8 fuses, ro
  0x00800000 CAL size 0x8 fuses, ro
  0x00400000 DATAFLASH size 0x4000 flash, rw, page 64
  0x00802000 LOCKROW size 0x4 fuses, ro
  0x00806000 OTP1 size 0x8 fuses, ro
  0x00806008 OTP2 size 0x8 fuses, ro
  0x00806010 OTP3 size 0x8 fuses, ro
  0x00806018 OTP4 size 0x8 fuses, ro
  0x00830000 ROM size 0x10000 fuses, rw, page 64
  0x00820000 SHADOW size 0x8 fuses, ro
  0x00806020 SW_CALIB size 0x4 fuses, ro
  0x00810000 TLATCH size 0x10000 fuses, rw, page 64
  0x00804000 USER_PAGE size 0x100 user_page, rw, page 64
  0x20000000 HSRAM size 0x10000 ram, rw, executable
  0x40000000 APBA size 0x8000 io, rw
  0x41000000 APBB size 0x10000 io, rw
  0x42000000 APBC size 0x6000 io, rw
  0xE0000000 PPB size 0x100000 io, rw
fuses space: start 0x00000000 size 0x20000000, little endian

## Peripheral instances (address, pins/pin function, parameters)
AC at 0x40003400
  pins: AIN0 PA04/B; AIN1 PA05/B; AIN2 PA06/B; AIN3 PA07/B; AIN4 PB02/B; AIN5 PB03/B; AIN6 PB04/B; AIN7 PB05/B; CMP0 PA12/H or PA18/H; CMP1 PA13/H or PA19/H; CMP2 PB24/H or PA24/H; CMP3 PB25/H or PA25/H
  parameters: COMPCTRL_MUXNEG_OPAMP=7 (OPAMP selection for MUXNEG), GCLK_ID=29 (Index of Generic Clock), NUM_CMP=4 (Number of comparators), PAIRS=2 (Number of pairs of comparators), INSTANCE_ID=13 (Instance index for AC)
ADC at 0x42003800
  pins: AIN{n} PA{n+2:02}/B (n=0..9); AIN10 PB02/B; AIN11 PB03/B; AIN12 PB04/B; AIN13 PB05/B; AIN14 PB06/B; AIN15 PB07/B; AIN16 PB00/B; AIN17 PB01/B; AIN18 PB08/B; AIN19 PB09/B; AIN20 PC00/B; AIN21 PC01/B; AIN22 PC02/B; AIN23 PC03/B; VREFP PA04/B
  parameters: DMAC_ID_RESRDY=41 (index of DMA RESRDY trigger), EXTCHANNEL_MSB=23 (Number of external channels), GCLK_ID=28 (Index of Generic Clock), INT_CH30=1 (Select OPAMP or CTAT on Channel 30), MASTER_SLAVE_MODE=0 (ADC Master/Slave Mode), INSTANCE_ID=78 (Instance index for ADC), LOAD_CALIB=1 (CALIB register to be loaded from NVM)
CCL at 0x42004800
  pins: IN0 PA04/I or PA16/I or PB22/I; IN1 PA05/I or PA17/I or PB00/I; IN2 PA06/I or PA18/I or PB01/I; IN3 PA08/I or PA30/I; IN4 PA09/I; IN5 PA10/I or PA20/I; IN6 PA22/I or PB06/I; IN7 PA23/I or PB07/I; IN8 PA24/I or PB08/I; IN9 PB14/I; IN10 PB15/I or PC20/I; IN11 PB16/I; OUT0 PA07/I or PA19/I or PB02/I or PB23/I; OUT1 PA11/I or PA31/I; OUT2 PA25/I or PB09/I; OUT3 PB17/I
  parameters: GCLK_ID=32 (GCLK index for CCL), LUT_NUM=4 (Number of LUT in a CCL), SEQ_NUM=2 (Number of SEQ in a CCL), INSTANCE_ID=82 (Instance index for CCL)
CoreDebug at 0xE000EDF0
CoreDebug_NS at 0xE002EDF0 (CoreDebug)
DAC at 0x42003C00
  pins: VOUT0 PA02/B; VOUT1 PA07/B; VREFP PA03/B
  parameters: CHANNEL_SIZE=2 (Number of DACs), DATA_SIZE=12 (Number of bits in data), GCLK_ID=30 (Index of Generic Clock), STEP=7 (Number of steps to reach full scale), INSTANCE_ID=79 (Instance index for DAC), DMAC_ID_EMPTY0=42 (DMAC ID for DAC0 Empty), DMAC_ID_EMPTY1=43 (DMAC ID for DAC1 Empty)
DIB at 0xE000EFB0
DIB_NS at 0xE002EFB0 (DIB)
DMAC at 0x41006000
  parameters: CH_BITS=4 (Number of bits to select channel), CH_NUM=16 (Number of channels), EVIN_NUM=8 (Number of input events), EVOUT_NUM=8 (Number of output events), LVL_BITS=2 (Number of bit to select level priority), LVL_NUM=4 (Enable priority level number), QOSCTRL_D_RESETVALUE=2 (QOS dmac ahb interface reset value), QOSCTRL_F_RESETVALUE=2 (QOS dmac fetch interface reset value), QOSCTRL_WRB_RESETVALUE=2 (QOS dmac write back interface reset value), SPLIT_IRQ_NUM=4 (Number of IRQ split out), TRIG_BITS=6 (Number of bits to select trigger source), TRIG_NUM=51 (Number of peripheral triggers), INSTANCE_ID=35 (Instance index for DMAC), CHANNEL{n}_INT_SRC={n+15} (DMA Channel {n} Interrupt) (n=0..4), CHANNEL{n}_INT_SRC=19 (DMA Channel {n} Interrupt) (n=5..15)
DSU at 0x41002000, DSU_EXT 0x41002100
  parameters: DMAC_ID_DCC0=2 (DMAC ID for DCC0 register), DMAC_ID_DCC1=3 (DMAC ID for DCC1 register), INSTANCE_ID=33 (Instance index for DSU)
DWT at 0xE0001000
  parameters: __WPT_NUM=2 (Number of DWT watchpoint comparators)
EIC at 0x40002800, EIC_SEC 0x40002A00
  pins: EXTINT0 PA09/A or PA19/A or PB00/A or PB16/A or PC08/A or PC24/A or PA00/A; EXTINT1 PA10/A or PA22/A or PB01/A or PB17/A or PC09/A or PC25/A or PA01/A; EXTINT2 PA02/A or PA11/A or PA23/A or PB02/A or PB18/A or PC10/A or PC26/A; EXTINT3 PA03/A or PA14/A or PA24/A or PB03/A or PB19/A or PC11/A or PC27/A; EXTINT4 PA04/A or PA15/A or PA20/A or PA25/A or PB04/A or PB20/A or PC12/A or PC28/A; EXTINT5 PA05/A or PA16/A or PA21/A or PB05/A or PB21/A or PC13/A; EXTINT6 PA06/A or PA17/A or PA30/A or PB06/A or PB22/A or PC14/A; EXTINT7 PA07/A or PA18/A or PA31/A or PB07/A or PB23/A or PC15/A; EXTINT8 PB08/A or PB24/A or PC00/A or PC16/A; EXTINT9 PB09/A or PB25/A or PC01/A or PC17/A; EXTINT10 PC02/A or PC18/A; EXTINT11 PC03/A or PC19/A; EXTINT12 PA12/A or PB12/A or PC20/A; EXTINT13 PA13/A or PB13/A or PC05/A or PC21/A; EXTINT14 PB14/A or PB30/A or PC06/A; EXTINT15 PB15/A or PB31/A or PC07/A; NMI PA08/A
  parameters: EXTINT_NUM=16 (Number of external interrupts), GCLK_ID=4 (Generic Clock index), NUMBER_OF_CONFIG_REGS=2 (Number of CONFIG registers), NUMBER_OF_DPRESCALER_REGS=2 (Number of DPRESCALER registers), NUMBER_OF_INTERRUPTS=16 (Number of external interrupts (obsolete)), SECURE_IMPLEMENTED=1 (Security Configuration implemented?), INSTANCE_ID=10 (Instance index for EIC)
EVSYS at 0x42000000, EVSYS_SEC 0x42000200
  parameters: ASYNCHRONOUS_CHANNELS=0x00000F00 (Mask of Only Asynchronous Channels), CHANNELS=12 (Total Number of Channels), CHANNELS_BITS=4 (Number of bits to select Channel), GCLK_ID_{n}={n+8} (Index of Generic Clock {n}) (n=0..7), GENERATORS=91 (Total Number of Event Generators), GENERATORS_BITS=7 (Number of bits to select Event Generator), SECURE_IMPLEMENTED=1 (Security Configuration implemented?), SYNCH_NUM=8 (Number of Synchronous Channels), SYNCH_NUM_BITS=3 (Number of bits to select Synchronous Channels), USERS=52 (Total Number of Event Users), USERS_BITS=6 (Number of bits to select Event User), USERS_GROUPS=2 (Number of 32-user Groups), USER_CHN_BITS=4 (Number of bits to select Channel in USER register), INSTANCE_ID=64 (Instance index for EVSYS)
FPB at 0xE0002000
  parameters: __BKPT_NUM=4 (Number of FPB breakpoint comparators)
FREQM at 0x40002C00
  parameters: GCLK_ID_MSR=5 (Index of measure generic clock), GCLK_ID_REF=6 (Index of reference generic clock), INSTANCE_ID=11 (Instance index for FREQM)
GCLK at 0x40001C00
  pins: IO0 PA30/H or PB14/H or PB22/H or PA14/H; IO1 PA23/H or PB15/H or PB23/H or PA15/H; IO2 PA16/H or PA22/H or PB16/H; IO3 PA11/H or PA17/H or PB17/H; IO4 PA10/H or PA20/H; IO5 PA21/H; IO6 PB12/H; IO7 PB13/H
  parameters: GENDIV_BITS=16, GEN_BITS=3, GEN_NUM=8 (Number of Generic Clock Generators), GEN_NUM_MSB=7 (Number of Generic Clock Generators - 1), GEN_SOURCE_NUM_MSB=8 (Number of Generic Clock Sources - 1), NUM=35 (Number of Generic Clock Users), SOURCE_BITS=4, SOURCE_NUM=9 (Number of Generic Clock Sources), INSTANCE_ID=7 (Instance index for GCLK)
I2S at 0x42004C00
  pins: FS0 PA11/K set 2 or PA18/K set 1; FS1 PB12/K; MCK0 PA09/K; MCK1 PB13/K; SCK0 PA10/K set 1 or PA20/K set 2; SCK1 PA21/K; SDI PA08/K set 1 or PB16/K set 2; SDO PA19/K
  parameters: CLK_NUM=2 (Number of clock units), GCLK_ID_0=33 (Index of Generic Clock 0), GCLK_ID_1=34 (Index of Generic Clock 1), DMAC_ID_RX_0=47 (Index of DMA RX Trigger 0), DMAC_ID_RX_1=48 (Index of DMA RX Trigger 1), DMAC_ID_TX_0=49 (Index of DMA TX Trigger 0), DMAC_ID_TX_1=50 (Index of DMA TX Trigger 1), MAX_SLOTS=8 (Max number of data slots in frame), MAX_WL_BITS=32 (Max number of bits in data samples), SER_NUM=2 (Number of serializers), INSTANCE_ID=83 (Instance index for I2S)
ICB at 0xE000E000
ICB_NS at 0xE002E000 (ICB)
IDAU at 0x41000000
  parameters: CRYA_AES_DEC_ADDR=0x02006808 (crya_aes_dec function address), CRYA_AES_ENC_ADDR=0x02006804 (crya_aes_enc function address), CRYA_GF_MULT128_ADDR=0x0200680C (crya_gf_mult128 function address), CRYA_SHA_PROCESS_ADDR=0x02006800 (crya_sha_process function address), CRYA_SHA256_FINAL_ADDR=0x02006818 (crya_sha256_final function address), CRYA_SHA256_INIT_ADDR=0x02006810 (crya_sha256_init function address), CRYA_SHA256_UPDATE_ADDR=0x02006814 (crya_sha256_update function address), GRANULARITY_ANSC=0x20 (Application Non-Secure Callable region granularity), GRANULARITY_AS=0x100 (Application Secure region granularity), GRANULARITY_BNSC=0x20 (Boot Flash Non-Secure Callable region granularity), GRANULARITY_BOOTPROT=0x100 (BOOTPROT region granularity), GRANULARITY_BS=0x100 (Boot Flash Secure region granularity), GRANULARITY_DS=0x100 (DS region granularity), GRANULARITY_RS=0x80 (RAM Secure region granularity), REGION_ANS=0x05 (Application Non-Secure region ID), REGION_ANSC=0x04 (Application Non-Secure Callable region ID), REGION_AS=0x03 (Application Secure region ID), REGION_BNSC=0x02 (Boot Flash Non-Secure Callable region ID), REGION_BOOTROM=0x08 (Boot ROM region ID), REGION_BS=0x01 (Boot Flash Secure region ID), REGION_DNS=0x07 (DATAFLASH Non-Secure region ID), REGION_DS=0x06 (DATAFLASH Secure region ID), REGION_IOBUS=0x00 (IOBUS region ID), REGION_OTHER=0x00 (Other region ID), REGION_PERIPHERALS=0x00 (Peripherals region ID), REGION_RNS=0x0A (RAM Non-Secure region ID), REGION_RS=0x09 (RAM Secure region ID), INSTANCE_ID=32 (Instance index for IDAU)
MCLK at 0x40000800
  parameters: MCLK_CLK_APB_NUM=3, SYSTEM_CLOCK=1000000 (System Clock Frequency at Reset), INSTANCE_ID=2 (Instance index for MCLK)
  clocks: AHB APBA bit 0, APBB bit 1, APBC bit 2, DMAC bit 3, DSU bit 4, PAC bit 6, NVMCTRL bit 7, TRAM bit 12, USB bit 13
MPU at 0xE000ED90
MPU_NS at 0xE002ED90 (MPU)
  parameters: __MPU_NS_REGIONS=12 (Number of MPU_NS regions), __MPU_S_REGIONS=12 (Number of MPU_S regions)
NVIC at 0xE000E100
NVIC_NS at 0xE002E100 (NVIC)
  parameters: NUM_IRQ=71 (Number of interrupt request lines)
NVMCTRL at 0x41004000, NVMCTRL_SEC 0x41005000
  pins: MARGIN VMARGIN
  parameters: DATAFLASH_PAGES=256, PMSB=3, PSZ_BITS=6, ROW_PAGES=4, SECURE_IMPLEMENTED=1 (Security Configuration implemented?), FLASH_SIZE=524288, PAGE_SIZE=64, PAGES=8192, PAGES_PR_REGION=512, INSTANCE_ID=34 (Instance index for NVMCTRL)
FUSES at BOCOR_FUSES 0x0080C000 in fuses, OTP1_FUSES 0x00806000 in fuses, OTP2_FUSES 0x00806008 in fuses, SW_CALIB_FUSES 0x00806020 in fuses, USER_FUSES 0x00804000 in fuses
OPAMP at 0x42005000
  pins: OANEG0 PA02/B; OANEG1 PA00/B; OANEG2 PA03/B; OAOUT0 PA07/B; OAOUT1 PB04/B; OAOUT2 PA04/B; OAPOS0 PA06/B; OAPOS1 PA01/B; OAPOS2 PA05/B
  parameters: INSTANCE_ID=84 (Instance index for OPAMP), NUM_OPAMPS=3 (Number of op amps)
OSC32KCTRL at 0x40001400
  pins: XIN32 PA00/XIN32; XOUT32 PA01/XOUT32
  parameters: OSC32K_COARSE_CALIB_MSB=0, INSTANCE_ID=5 (Instance index for OSC32KCTRL)
OSCCTRL at 0x40001000
  pins: XIN PA14/XIN; XOUT PA15/XOUT
  parameters: DFLL48M_COARSE_MSB=5, DFLL48M_FINE_MSB=9, GCLK_ID_DFLLULP=2 (Index of Generic Clock for DFLLULP), GCLK_ID_DFLL48M=3 (Index of Generic Clock for DFLL48M), GCLK_ID_FDPLL=0 (Index of Generic Clock for DPLL), GCLK_ID_FDPLL32K=1 (Index of Generic Clock for DPLL 32K), CFD_VERSION=0x112, DFLLULP_VERSION=0x100, DFLL48M_VERSION=0x3d0, FDPLL_VERSION=0x213, OSC16M_VERSION=0x102, XOSC_VERSION=0x210, INSTANCE_ID=4 (Instance index for OSCCTRL)
PAC at 0x40000000, PAC_SEC 0x40000200
  parameters: HPB_NUM=3 (Number of bridges AHB/APB), SECURE_IMPLEMENTED=1 (Security Configuration implemented?), INSTANCE_ID=0 (Instance index for PAC)
PM at 0x40000400
  pins: RESET_N RESET_N
  parameters: BIAS_RAM_HS=1 (one if RAM HS can be back biased), PD_NUM=1 (Number of switchable Power Domain), INSTANCE_ID=1 (Instance index for PM), HAS_IDLE2_SLEEP_AS_IDLE=1 (IDLE2 Sleep mode is called IDLE), HAS_BBIASTR_BIT=1 (one if RAM HS can be back biased), HAS_DPGPDSW_BIT=1 (one if RAM HS can be back biased), HAS_PLCFG=1 (Performance Level Configuration supported), HAS_PDCFG_BIT=1 (PDCFG bit is present), HAS_PWCFG=1 (PWCFG register is present), HAS_OFF_SLEEP=1 (OFF Sleep mode supported)
PORT at 0x40003000, PORT_SEC 0x40003200, PORT_IOBUS 0x60000000, PORT_IOBUS_SEC 0x60000200
  pins: P{n} PA{n:02} (n=0..25); P30 PA30; P31 PA31; P{n} PB{n-32:02} (n=32..41); P{n} PB{n-32} (n=44..57); P62 PB30; P63 PB31; P64 PC00; P65 PC01; P66 PC02; P67 PC03; P{n} PC{n-64:02} (n=69..85); P88 PC24; P89 PC25; P90 PC26; P91 PC27; P92 PC28
  parameters: BITS=93, DRVSTR=1 (DRVSTR supported?), EV_NUM=4, GROUPS=3, MSB=92, ODRAIN=0 (ODRAIN supported?), PPP_IMPLEMENTED=0 (IOBUS2 implemented?), SECURE_IMPLEMENTED=1 (Secure I/Os supported?), SLEWLIM=0 (SLEWLIM supported?), INSTANCE_ID=12 (Instance index for PORT)
PTC at 0x42004000
  pins: DRV0 PA00/F; DRV1 PA01/F; DRV2 PA02/F; DRV3 PA03/F; DRV4 PA05/F; DRV5 PA06/F; DRV6 PA08/F; DRV7 PA09/F; DRV8 PA10/F; DRV9 PA11/F; DRV10 PA14/F; DRV11 PA15/F; DRV12 PA16/F; DRV13 PA17/F; DRV14 PA18/F; DRV15 PA19/F; DRV16 PA22/F; DRV17 PA23/F; DRV18 PA30/F; DRV19 PA31/F; DRV20 PB08/F; DRV21 PB09/F; DRV22 PA20/F; DRV23 PA21/F; DRV24 PA12/F; DRV25 PA13/F; DRV26 PB04/F; DRV27 PB05/F; DRV28 PB06/F; DRV29 PB07/F; DRV30 PB12/F; DRV31 PB13/F; ECI0 PA03/B; ECI1 PA04/B; ECI2 PA05/B; ECI3 PA06/B; X0 PA00/B; Y0 PA00/B; X1 PA01/B; Y1 PA01/B; X2 PA02/B; Y2 PA02/B; X3 PA03/B; Y3 PA03/B; X4 PA05/B; Y4 PA05/B; X5 PA06/B; Y5 PA06/B; X6 PA08/B; Y6 PA08/B; X7 PA09/B; Y7 PA09/B; X8 PA10/B; Y8 PA10/B; X9 PA11/B; Y9 PA11/B; X10 PA14/B; Y10 PA14/B; X11 PA15/B; Y11 PA15/B; X12 PA16/B; Y12 PA16/B; X13 PA17/B; Y13 PA17/B; X14 PA18/B; Y14 PA18/B; X15 PA19/B; Y15 PA19/B; X16 PA22/B; Y16 PA22/B; X17 PA23/B; Y17 PA23/B; X18 PA30/B; Y18 PA30/B; X19 PA31/B; Y19 PA31/B; X20 PB08/B; Y20 PB08/B; X21 PB09/B; Y21 PB09/B; X22 PA20/B; Y22 PA20/B; X23 PA21/B; Y23 PA21/B; X24 PA12/B; Y24 PA12/B; X25 PA13/B; Y25 PA13/B; X26 PB04/B; Y26 PB04/B; X27 PB05/B; Y27 PB05/B; X28 PB06/B; Y28 PB06/B; X29 PB07/B; Y29 PB07/B; X30 PB12/B; Y30 PB12/B; X31 PB13/B; Y31 PB13/B
  parameters: DMAC_ID_EOC=44 (Index of DMA EOC trigger), DMAC_ID_SEQ=45 (Index of DMA SEQ trigger), DMAC_ID_WCOMP=46 (Index of DMA WCOMP trigger), GCLK_ID=31 (Index of Generic Clock), LINES_MSB=31, LINES_NUM=32 (Number of PTC lines), INSTANCE_ID=80 (Instance index for PTC)
RSTC at 0x40000C00
  parameters: BACKUP_IMPLEMENTED=0, NUMBER_OF_EXTWAKE=0 (number of external wakeup line), INSTANCE_ID=3 (Instance index for RSTC)
RTC at 0x40002400
  pins: IN0 PA08/G; IN1 PA09/G; IN2 PA16/G; IN3 PA17/G; IN4 PB14/G; IN5 PB15/G; IN6 PC14/G; IN7 PC15/G; OUT0 PA18/G; OUT1 PA19/G; OUT2 PA22/G; OUT3 PA23/G; OUT4 PB16/G; OUT5 PB17/G; OUT6 PB18/G; OUT7 PB19/G
  parameters: DMAC_ID_TIMESTAMP=1 (DMA RTC timestamp trigger), GPR_NUM=2 (Number of General-Purpose Registers), NUM_OF_ALARMS=1 (Number of Alarms), NUM_OF_BKREGS=0 (Number of Backup Registers), NUM_OF_COMP16=2 (Number of 16-bit Comparators), NUM_OF_COMP32=1 (Number of 32-bit Comparators), NUM_OF_TAMPERS=8 (Number of Tamper Inputs), PER_NUM=8 (Number of Periodic Intervals), INSTANCE_ID=9 (Instance index for RTC)
SCB at 0xE000ED00
SCB_NS at 0xE002ED00 (SCB)
SERCOM0 at 0x42000400 (SERCOM)
  pins: PAD0 PA04/D set 3 or PA16/D set 4 or PA22/C set 1 or PB24/C set 2; PAD1 PA05/D set 3 or PA17/D set 4 or PA23/C set 1 or PB25/C set 2; PAD2 PA06/D set 3 or PA14/D set 4 or PA18/D set 4 or PA24/C set 1 or PB22/C set 1 2 or PC24/C set 2 or PA02/D set 3; PAD3 PA07/D set 3 or PA15/D set 4 or PA19/D set 4 or PA25/C set 1 or PB23/C set 1 2 or PC25/C set 2 or PA03/D set 3
  parameters: CLK_REDUCTION=1 (Reduce clock options to pin 1 for SPI and USART), DMA=1 (DMA support implemented?), DMAC_ID_RX=4 (Index of DMA RX trigger), DMAC_ID_TX=5 (Index of DMA TX trigger), FIFO_IMPLEMENTED=1 (FIFO Rx/Tx implemented?), FIFO_SIZE=8 (Rx-Tx FIFO size in bytes), FSYNC_IMPLEMENTED=0 (SPI Frame Synch mode implemented?), GCLK_ID_CORE=17, GCLK_ID_SLOW=16, INT_MSB=6, PMSB=3, SPI=1 (SPI mode implemented?), TWIM=1 (TWI Master mode implemented?), TWIS=1 (TWI Slave mode implemented?), TWI_HSMODE=1 (TWI HighSpeed mode implemented?), ULTRA_IMPLEMENTATION=1 (ULTRA platform compatibility?), USART=1 (USART mode implemented?), USART_AUTOBAUD=1 (USART autobaud implemented?), USART_IRDA=1 (USART IrDA implemented?), USART_ISO7816=1 (USART ISO7816 mode implemented?), USART_LIN_MASTER=1 (USART LIN Master mode implemented?), USART_RS485=1 (USART RS485 mode implemented?), INSTANCE_ID=65 (Instance index for SERCOM0), SPI_TX_READY_INT_SRC=31 (SPI TX READY Interrupt), SPI_TX_COMPLETE_INT_SRC=32 (SPI TX COMPLETE Interrupt), SPI_RX_INT_SRC=33 (SPI RX Interrupt), SPI_ERROR_INT_SRC=34 (SPI ERROR Interrupt), I2C_0_INT_SRC=31 (I2C 0 Interrupt), I2C_1_INT_SRC=32 (I2C 1 Interrupt), I2C_2_INT_SRC=33 (I2C 2 Interrupt), I2C_3_INT_SRC=34 (I2C 3 Interrupt), USART_TX_READY_INT_SRC=31 (USART TX READY Interrupt), USART_TX_COMPLETE_INT_SRC=32 (USART TX COMPLETE Interrupt), USART_RX_INT_SRC=33 (USART RX Interrupt), USART_ERROR_INT_SRC=34 (USART ERROR Interrupt)
SERCOM1 at 0x42000800 (SERCOM)
  pins: PAD0 PC27/D set 5 or PA16/C set 3 or PB30/C set 4 or PC12/C set 2 or PA08/C set 1 or PA00/D set 6; PAD1 PC28/D set 5 or PA17/C set 3 or PB31/C set 4 or PC13/C set 2 or PA09/C set 1 or PA01/D set 6; PAD2 PA18/C set 3 or PC10/C set 2 or PA10/C set 1 6 or PA30/D set 4 5; PAD3 PA19/C set 3 or PC11/C set 2 or PA11/C set 1 6 or PA31/D set 4 5
  parameters: CLK_REDUCTION=1 (Reduce clock options to pin 1 for SPI and USART), DMA=1 (DMA support implemented?), DMAC_ID_RX=6 (Index of DMA RX trigger), DMAC_ID_TX=7 (Index of DMA TX trigger), FIFO_IMPLEMENTED=1 (FIFO Rx/Tx implemented?), FIFO_SIZE=8 (Rx-Tx FIFO size in bytes), FSYNC_IMPLEMENTED=0 (SPI Frame Synch mode implemented?), GCLK_ID_CORE=18, GCLK_ID_SLOW=16, INT_MSB=6, PMSB=3, SPI=1 (SPI mode implemented?), TWIM=1 (TWI Master mode implemented?), TWIS=1 (TWI Slave mode implemented?), TWI_HSMODE=1 (TWI HighSpeed mode implemented?), ULTRA_IMPLEMENTATION=1 (ULTRA platform compatibility?), USART=1 (USART mode implemented?), USART_AUTOBAUD=1 (USART autobaud implemented?), USART_IRDA=1 (USART IrDA implemented?), USART_ISO7816=1 (USART ISO7816 mode implemented?), USART_LIN_MASTER=1 (USART LIN Master mode implemented?), USART_RS485=1 (USART RS485 mode implemented?), INSTANCE_ID=66 (Instance index for SERCOM1), SPI_TX_READY_INT_SRC=35 (SPI TX READY Interrupt), SPI_TX_COMPLETE_INT_SRC=36 (SPI TX COMPLETE Interrupt), SPI_RX_INT_SRC=37 (SPI RX Interrupt), SPI_ERROR_INT_SRC=38 (SPI ERROR Interrupt), I2C_0_INT_SRC=35 (I2C 0 Interrupt), I2C_1_INT_SRC=36 (I2C 1 Interrupt), I2C_2_INT_SRC=37 (I2C 2 Interrupt), I2C_3_INT_SRC=38 (I2C 3 Interrupt), USART_TX_READY_INT_SRC=35 (USART TX READY Interrupt), USART_TX_COMPLETE_INT_SRC=36 (USART TX COMPLETE Interrupt), USART_RX_INT_SRC=37 (USART RX Interrupt), USART_ERROR_INT_SRC=38 (USART ERROR Interrupt)
SERCOM2 at 0x42000C00 (SERCOM)
  pins: PAD0 PA08/D set 2 or PA22/D set 3 or PA12/C set 1; PAD1 PA09/D set 2 or PA23/D set 3 or PA13/C set 1; PAD2 PA10/D set 2 or PA20/D set 3 or PA24/D set 3 or PA14/C set 1; PAD3 PA11/D set 2 or PA21/D set 3 or PA25/D set 3 or PA15/C set 1
  parameters: CLK_REDUCTION=1 (Reduce clock options to pin 1 for SPI and USART), DMA=1 (DMA support implemented?), DMAC_ID_RX=8 (Index of DMA RX trigger), DMAC_ID_TX=9 (Index of DMA TX trigger), FIFO_IMPLEMENTED=1 (FIFO Rx/Tx implemented?), FIFO_SIZE=8 (Rx-Tx FIFO size in bytes), FSYNC_IMPLEMENTED=0 (SPI Frame Synch mode implemented?), GCLK_ID_CORE=19, GCLK_ID_SLOW=16, INT_MSB=6, PMSB=3, SPI=1 (SPI mode implemented?), TWIM=1 (TWI Master mode implemented?), TWIS=1 (TWI Slave mode implemented?), TWI_HSMODE=1 (TWI HighSpeed mode implemented?), ULTRA_IMPLEMENTATION=1 (ULTRA platform compatibility?), USART=1 (USART mode implemented?), USART_AUTOBAUD=1 (USART autobaud implemented?), USART_IRDA=1 (USART IrDA implemented?), USART_ISO7816=1 (USART ISO7816 mode implemented?), USART_LIN_MASTER=1 (USART LIN Master mode implemented?), USART_RS485=1 (USART RS485 mode implemented?), INSTANCE_ID=67 (Instance index for SERCOM2), SPI_TX_READY_INT_SRC=39 (SPI TX READY Interrupt), SPI_TX_COMPLETE_INT_SRC=40 (SPI TX COMPLETE Interrupt), SPI_RX_INT_SRC=41 (SPI RX Interrupt), SPI_ERROR_INT_SRC=42 (SPI ERROR Interrupt), I2C_0_INT_SRC=39 (I2C 0 Interrupt), I2C_1_INT_SRC=40 (I2C 1 Interrupt), I2C_2_INT_SRC=41 (I2C 2 Interrupt), I2C_3_INT_SRC=42 (I2C 3 Interrupt), USART_TX_READY_INT_SRC=39 (USART TX READY Interrupt), USART_TX_COMPLETE_INT_SRC=40 (USART TX COMPLETE Interrupt), USART_RX_INT_SRC=41 (USART RX Interrupt), USART_ERROR_INT_SRC=42 (USART ERROR Interrupt)
SERCOM3 at 0x42001000 (SERCOM)
  pins: PAD0 PB08/D set 4 or PB12/C set 1 or PB20/C set 2 or PB02/C set 3; PAD1 PB09/D set 4 or PB13/C set 1 or PB21/C set 2 or PB03/C set 3; PAD2 PB18/D set 2 or PB14/C set 1 4 or PA20/C set 2 3 or PB00/C set 3; PAD3 PB19/D set 2 or PB15/C set 1 4 or PA21/C set 2 3 or PB01/C set 3
  parameters: CLK_REDUCTION=1 (Reduce clock options to pin 1 for SPI and USART), DMA=1 (DMA support implemented?), DMAC_ID_RX=10 (Index of DMA RX trigger), DMAC_ID_TX=11 (Index of DMA TX trigger), FIFO_IMPLEMENTED=1 (FIFO Rx/Tx implemented?), FIFO_SIZE=8 (Rx-Tx FIFO size in bytes), FSYNC_IMPLEMENTED=0 (SPI Frame Synch mode implemented?), GCLK_ID_CORE=20, GCLK_ID_SLOW=16, INT_MSB=6, PMSB=3, SPI=1 (SPI mode implemented?), TWIM=1 (TWI Master mode implemented?), TWIS=1 (TWI Slave mode implemented?), TWI_HSMODE=1 (TWI HighSpeed mode implemented?), ULTRA_IMPLEMENTATION=1 (ULTRA platform compatibility?), USART=1 (USART mode implemented?), USART_AUTOBAUD=1 (USART autobaud implemented?), USART_IRDA=1 (USART IrDA implemented?), USART_ISO7816=1 (USART ISO7816 mode implemented?), USART_LIN_MASTER=1 (USART LIN Master mode implemented?), USART_RS485=1 (USART RS485 mode implemented?), INSTANCE_ID=68 (Instance index for SERCOM3), SPI_TX_READY_INT_SRC=43 (SPI TX READY Interrupt), SPI_TX_COMPLETE_INT_SRC=44 (SPI TX COMPLETE Interrupt), SPI_RX_INT_SRC=45 (SPI RX Interrupt), SPI_ERROR_INT_SRC=46 (SPI ERROR Interrupt), I2C_0_INT_SRC=43 (I2C 0 Interrupt), I2C_1_INT_SRC=44 (I2C 1 Interrupt), I2C_2_INT_SRC=45 (I2C 2 Interrupt), I2C_3_INT_SRC=46 (I2C 3 Interrupt), USART_TX_READY_INT_SRC=43 (USART TX READY Interrupt), USART_TX_COMPLETE_INT_SRC=44 (USART TX COMPLETE Interrupt), USART_RX_INT_SRC=45 (USART RX Interrupt), USART_ERROR_INT_SRC=46 (USART ERROR Interrupt)
SERCOM4 at 0x42001400 (SERCOM)
  pins: PAD0 PA12/D set 2 or PB24/D set 1; PAD1 PA13/D set 2 or PB25/D set 1; PAD2 PC24/D set 1 2; PAD3 PC25/D set 1 2
  parameters: CLK_REDUCTION=1 (Reduce clock options to pin 1 for SPI and USART), DMA=1 (DMA support implemented?), DMAC_ID_RX=12 (Index of DMA RX trigger), DMAC_ID_TX=13 (Index of DMA TX trigger), FIFO_IMPLEMENTED=1 (FIFO Rx/Tx implemented?), FIFO_SIZE=8 (Rx-Tx FIFO size in bytes), FSYNC_IMPLEMENTED=0 (SPI Frame Synch mode implemented?), GCLK_ID_CORE=21, GCLK_ID_SLOW=16, INT_MSB=6, PMSB=3, SPI=1 (SPI mode implemented?), TWIM=1 (TWI Master mode implemented?), TWIS=1 (TWI Slave mode implemented?), TWI_HSMODE=1 (TWI HighSpeed mode implemented?), ULTRA_IMPLEMENTATION=1 (ULTRA platform compatibility?), USART=1 (USART mode implemented?), USART_AUTOBAUD=1 (USART autobaud implemented?), USART_IRDA=1 (USART IrDA implemented?), USART_ISO7816=1 (USART ISO7816 mode implemented?), USART_LIN_MASTER=1 (USART LIN Master mode implemented?), USART_RS485=1 (USART RS485 mode implemented?), INSTANCE_ID=69 (Instance index for SERCOM4), SPI_TX_READY_INT_SRC=47 (SPI TX READY Interrupt), SPI_TX_COMPLETE_INT_SRC=48 (SPI TX COMPLETE Interrupt), SPI_RX_INT_SRC=49 (SPI RX Interrupt), SPI_ERROR_INT_SRC=50 (SPI ERROR Interrupt), I2C_0_INT_SRC=47 (I2C 0 Interrupt), I2C_1_INT_SRC=48 (I2C 1 Interrupt), I2C_2_INT_SRC=49 (I2C 2 Interrupt), I2C_3_INT_SRC=50 (I2C 3 Interrupt), USART_TX_READY_INT_SRC=47 (USART TX READY Interrupt), USART_TX_COMPLETE_INT_SRC=48 (USART TX COMPLETE Interrupt), USART_RX_INT_SRC=49 (USART RX Interrupt), USART_ERROR_INT_SRC=50 (USART ERROR Interrupt)
SERCOM5 at 0x42001800 (SERCOM)
  pins: PAD0 PB02/D set 4 or PB20/D set 2 or PB30/D set 3 or PB16/C set 1; PAD1 PB03/D set 4 or PB21/D set 2 or PB31/D set 3 or PB17/C set 1; PAD2 PB00/D set 3 4 or PB22/D set 2 4 or PB18/C set 1; PAD3 PB01/D set 3 4 or PB23/D set 2 4 or PB19/C set 1
  parameters: CLK_REDUCTION=1 (Reduce clock options to pin 1 for SPI and USART), DMA=1 (DMA support implemented?), DMAC_ID_RX=14 (Index of DMA RX trigger), DMAC_ID_TX=15 (Index of DMA TX trigger), FIFO_IMPLEMENTED=1 (FIFO Rx/Tx implemented?), FIFO_SIZE=8 (Rx-Tx FIFO size in bytes), FSYNC_IMPLEMENTED=0 (SPI Frame Synch mode implemented?), GCLK_ID_CORE=22, GCLK_ID_SLOW=16, INT_MSB=6, PMSB=3, SPI=1 (SPI mode implemented?), TWIM=1 (TWI Master mode implemented?), TWIS=1 (TWI Slave mode implemented?), TWI_HSMODE=1 (TWI HighSpeed mode implemented?), ULTRA_IMPLEMENTATION=1 (ULTRA platform compatibility?), USART=1 (USART mode implemented?), USART_AUTOBAUD=1 (USART autobaud implemented?), USART_IRDA=1 (USART IrDA implemented?), USART_ISO7816=1 (USART ISO7816 mode implemented?), USART_LIN_MASTER=1 (USART LIN Master mode implemented?), USART_RS485=1 (USART RS485 mode implemented?), INSTANCE_ID=70 (Instance index for SERCOM5), SPI_TX_READY_INT_SRC=51 (SPI TX READY Interrupt), SPI_TX_COMPLETE_INT_SRC=52 (SPI TX COMPLETE Interrupt), SPI_RX_INT_SRC=53 (SPI RX Interrupt), SPI_ERROR_INT_SRC=54 (SPI ERROR Interrupt), I2C_0_INT_SRC=51 (I2C 0 Interrupt), I2C_1_INT_SRC=52 (I2C 1 Interrupt), I2C_2_INT_SRC=53 (I2C 2 Interrupt), I2C_3_INT_SRC=54 (I2C 3 Interrupt), USART_TX_READY_INT_SRC=51 (USART TX READY Interrupt), USART_TX_COMPLETE_INT_SRC=52 (USART TX COMPLETE Interrupt), USART_RX_INT_SRC=53 (USART RX Interrupt), USART_ERROR_INT_SRC=54 (USART ERROR Interrupt)
SUPC at 0x40001800
  parameters: BOD12_CALIB_MSB=5, BOD33_CALIB_MSB=5, HAS_STDBYPL0_BIT=1 (STDBYPL0 bit is present), HAS_LPEFF_BIT=1 (LPEFF bit is present), HAS_SEL_BIT=1 (SEL bit is present), HAS_BOD33_REG_NAME=1 (Name of BOD register is BOD33), HAS_VREFSEL_BIT=1 (VREFSEL bit is present), INSTANCE_ID=6 (Instance index for SUPC)
SysTick at 0xE000E010
SysTick_NS at 0xE002E010 (SysTick)
  parameters: __SYST_NUM=2 (Number of implemented SysTick timers)
TC0 at 0x42001C00 (TC)
  pins: WO0 PA22/E or PB08/E or PB12/E or PA14/E; WO1 PA23/E or PB09/E or PB13/E or PA15/E
  parameters: CC_NUM=2, DMAC_ID_OVF=16 (Indexes of DMA Overflow trigger), DMAC_ID_MC0=17 (Indexes of DMA Match/Compare0 trigger), DMAC_ID_MC1=18 (Indexes of DMA Match/Compare1 trigger), EXT=1 (Coding of implemented extended features (keep 0 value)), GCLK_ID=23 (Index of Generic Clock), MASTER_SLAVE_MODE=1 (TC type 0 : NA, 1 : Master, 2 : Slave), OW_NUM=2 (Number of Output Waveforms), INSTANCE_ID=71 (Instance index for TC0)
TC1 at 0x42002000 (TC)
  pins: WO0 PA20/E or PA24/E or PB14/E; WO1 PA25/E or PB15/E
  parameters: CC_NUM=2, DMAC_ID_OVF=19 (Indexes of DMA Overflow trigger), DMAC_ID_MC0=20 (Indexes of DMA Match/Compare0 trigger), DMAC_ID_MC1=21 (Indexes of DMA Match/Compare1 trigger), EXT=1 (Coding of implemented extended features (keep 0 value)), GCLK_ID=23 (Index of Generic Clock), MASTER_SLAVE_MODE=2 (TC type 0 : NA, 1 : Master, 2 : Slave), OW_NUM=2 (Number of Output Waveforms), INSTANCE_ID=72 (Instance index for TC1)
TC2 at 0x42002400 (TC)
  pins: WO0 PA18/E or PB02/E or PB16/E or PC24/E; WO1 PA19/E or PB03/E or PB17/E or PC25/E
  parameters: CC_NUM=2, DMAC_ID_OVF=22 (Indexes of DMA Overflow trigger), DMAC_ID_MC0=23 (Indexes of DMA Match/Compare0 trigger), DMAC_ID_MC1=24 (Indexes of DMA Match/Compare1 trigger), EXT=1 (Coding of implemented extended features (keep 0 value)), GCLK_ID=24 (Index of Generic Clock), MASTER_SLAVE_MODE=0 (TC type 0 : NA, 1 : Master, 2 : Slave), OW_NUM=2 (Number of Output Waveforms), INSTANCE_ID=73 (Instance index for TC2)
TCC0 at 0x42002800 (TCC)
  pins: WO0 PB18/J or PA04/E or PA08/E or PB30/E; WO1 PB19/J or PA05/E or PA09/E or PB31/E; WO2 PA10/J or PA18/J or PB20/J; WO3 PA11/J or PA19/J or PB21/J; WO4 PA22/J or PB16/J or PA14/J; WO5 PA15/J or PA23/J or PB17/J; WO6 PA12/J or PA16/J or PA20/J or PB12/J; WO7 PA13/J or PA17/J or PA21/J or PB13/J
  parameters: CC_NUM=4 (Number of Compare/Capture units), DITHERING=1 (Dithering feature implemented), DMAC_ID_OVF=25 (DMA overflow/underflow/retrigger trigger), DMAC_ID_MC0=26 (Indexes of DMA Match/Compare 0 trigger), DMAC_ID_MC1=27 (Indexes of DMA Match/Compare 1 trigger), DMAC_ID_MC2=28 (Indexes of DMA Match/Compare 2 trigger), DMAC_ID_MC3=29 (Indexes of DMA Match/Compare 3 trigger), DTI=1 (Dead-Time-Insertion feature implemented), GCLK_ID=25 (Index of Generic Clock), MASTER_SLAVE_MODE=1 (TCC type 0 : NA, 1 : Master, 2 : Slave), OTMX=1 (Output Matrix feature implemented), OW_NUM=8 (Number of Output Waveforms), PG=1 (Pattern Generation feature implemented), SIZE=24, SWAP=1 (DTI outputs swap feature implemented), INSTANCE_ID=74 (Instance index for TCC0)
TCC1 at 0x42002C00 (TCC)
  pins: WO0 PA06/E or PA10/E or PA30/E; WO1 PA07/E or PA11/E or PA31/E; WO2 PA08/J or PA24/J or PB30/J; WO3 PA09/J or PA25/J or PB31/J
  parameters: CC_NUM=2 (Number of Compare/Capture units), DITHERING=1 (Dithering feature implemented), DMAC_ID_OVF=30 (DMA overflow/underflow/retrigger trigger), DMAC_ID_MC0=31 (Indexes of DMA Match/Compare 0 trigger), DMAC_ID_MC1=32 (Indexes of DMA Match/Compare 1 trigger), DTI=0 (Dead-Time-Insertion feature implemented), GCLK_ID=25 (Index of Generic Clock), MASTER_SLAVE_MODE=2 (TCC type 0 : NA, 1 : Master, 2 : Slave), OTMX=0 (Output Matrix feature implemented), OW_NUM=4 (Number of Output Waveforms), PG=1 (Pattern Generation feature implemented), SIZE=24, SWAP=0 (DTI outputs swap feature implemented), INSTANCE_ID=75 (Instance index for TCC1)
TCC2 at 0x42003000 (TCC)
  pins: WO0 PA12/E or PA16/E or PA00/E; WO1 PA13/E or PA17/E or PA01/E
  parameters: CC_NUM=2 (Number of Compare/Capture units), DITHERING=0 (Dithering feature implemented), DMAC_ID_OVF=33 (DMA overflow/underflow/retrigger trigger), DMAC_ID_MC0=34 (Indexes of DMA Match/Compare 0 trigger), DMAC_ID_MC1=35 (Indexes of DMA Match/Compare 1 trigger), DTI=0 (Dead-Time-Insertion feature implemented), GCLK_ID=26 (Index of Generic Clock), MASTER_SLAVE_MODE=0 (TCC type 0 : NA, 1 : Master, 2 : Slave), OTMX=0 (Output Matrix feature implemented), OW_NUM=2 (Number of Output Waveforms), PG=0 (Pattern Generation feature implemented), SIZE=16, SWAP=0 (DTI outputs swap feature implemented), INSTANCE_ID=76 (Instance index for TCC2)
TCC3 at 0x42003400 (TCC)
  pins: WO0 PA02/J or PB22/J; WO1 PA03/J or PB23/J; WO2 PA04/J or PB02/J; WO3 PA05/J or PB03/J; WO4 PA06/J or PA30/J; WO5 PA07/J or PA31/J; WO6 PB08/J; WO7 PB09/J
  parameters: CC_NUM=4 (Number of Compare/Capture units), DITHERING=1 (Dithering feature implemented), DMAC_ID_OVF=36 (DMA overflow/underflow/retrigger trigger), DMAC_ID_MC0=37 (Indexes of DMA Match/Compare 0 trigger), DMAC_ID_MC1=38 (Indexes of DMA Match/Compare 1 trigger), DMAC_ID_MC2=39 (Indexes of DMA Match/Compare 2 trigger), DMAC_ID_MC3=40 (Indexes of DMA Match/Compare 3 trigger), DTI=1 (Dead-Time-Insertion feature implemented), GCLK_ID=27 (Index of Generic Clock), MASTER_SLAVE_MODE=0 (TCC type 0 : NA, 1 : Master, 2 : Slave), OTMX=1 (Output Matrix feature implemented), OW_NUM=8 (Number of Output Waveforms), PG=1 (Pattern Generation feature implemented), SIZE=24, SWAP=1 (DTI outputs swap feature implemented), INSTANCE_ID=77 (Instance index for TCC3)
TRAM at 0x42005400
  parameters: ADDR_MSB=6 (Value of the MSB bit of physical RAM address), WORDS=128 (number of 32-bit words in physical RAM), INSTANCE_ID=85 (Instance index for TRAM)
TRNG at 0x42004400
  parameters: INSTANCE_ID=81 (Instance index for TRNG)
USB at 0x4100A000
  pins: DM PA24/G; DP PA25/G; SOF_1KHZ PB22/G
  parameters: AHB_2_USB_FIFO_DEPTH=4 (bytes number, should be at least 2, and 2^n (4,8,16 ...)), AHB_2_USB_RD_DATA_BITS=8 (8, 16 or 32, here : 8-bits is required as UTMI interface should work in 8-bits mode), AHB_2_USB_WR_DATA_BITS=32 (8, 16 or 32 : here, AHB transfer is made in word mode), AHB_2_USB_WR_THRESHOLD=2 (as soon as there are N bytes-free inside the fifo, ahb read transfer is requested), DATA_BUS_16_8=0 (UTMI/SIE data bus size : 0 -> 8 bits, 1 -> 16 bits), EPNUM=8 (parameter for rtl : max of ENDPOINT and PIPE NUM), EPT_NUM=8 (Number of USB end points), GCLK_ID=7 (Index of Generic Clock), INITIAL_CONTROL_QOS=3 (CONTROL QOS RESET value), INITIAL_DATA_QOS=3 (DATA QOS RESET value), MISSING_SOF_DET_IMPLEMENTED=1 (48 mHz xPLL feature implemented), PIPE_NUM=8 (Number of USB pipes), SYSTEM_CLOCK_IS_CKUSB=0 (Dual (1'b0) or Single (1'b1) clock system), USB_2_AHB_FIFO_DEPTH=4 (bytes number, should be at least 2, and 2^n (4,8,16 ...)), USB_2_AHB_RD_DATA_BITS=16 (8, 16 or 32, here : 8-bits is required as UTMI interface should work in 8-bits mode), USB_2_AHB_RD_THRESHOLD=2 (as soon as there are 16 bytes-free inside the fifo, ahb read transfer is requested), USB_2_AHB_WR_DATA_BITS=8 (8, 16 or 32 : here : 8-bits is required as UTMI interface should work in 8-bits mode), INSTANCE_ID=37 (Instance index for USB)
WDT at 0x40002000
  parameters: INSTANCE_ID=8 (Instance index for WDT)

## Interrupts
-15 Reset — Reset Vector, invoked on Power up and warm reset
-14 NonMaskableInt — Non maskable Interrupt, cannot be stopped or preempted
-13 HardFault — Hard Fault, all classes of Fault
-5 SVCall — System Service Call via SVC instruction
-2 PendSV — Pendable request for system service
-1 SysTick — System Tick Timer
0 SYSTEM (MCLK OSCCTRL OSC32KCTRL PM SUPC) — System peripherals shared interrupt
1 WDT — Watchdog Timer
2 RTC — Real Time Counter
{n+3} EIC_EXTINT_{n} (EIC) (n=0..7) — External Channel {n}
11 EIC_OTHER (EIC) — External Channel 8..X
12 FREQM — Frequency Meter
13 NVMCTRL — Non-Volatile Memory Controller
14 PORT — Port Non-Secure Check
15 DMAC_0 (DMAC) — DMA Channel 0
16 DMAC_1 (DMAC) — DMA Channel 1
17 DMAC_2 (DMAC) — DMA Channel 2
18 DMAC_3 (DMAC) — DMA Channel 3
19 DMAC_OTHER (DMAC) — DMA Channel 4..X
20 USB — Universal Serial Bus
{n+21} EVSYS_{n} (EVSYS) (n=0..7) — Event System Channel {n}
29 EVSYS_NSCHK (EVSYS) — Event System Non-Secure Check
30 PAC — Peripheral Access Controller
31 SERCOM0_0 (SERCOM0) — Serial Communication Interface 0
32 SERCOM0_1 (SERCOM0) — Serial Communication Interface 0
33 SERCOM0_2 (SERCOM0) — Serial Communication Interface 0
34 SERCOM0_OTHER (SERCOM0) — Serial Communication Interface 0
35 SERCOM1_0 (SERCOM1) — Serial Communication Interface 1
36 SERCOM1_1 (SERCOM1) — Serial Communication Interface 1
37 SERCOM1_2 (SERCOM1) — Serial Communication Interface 1
38 SERCOM1_OTHER (SERCOM1) — Serial Communication Interface 1
39 SERCOM2_0 (SERCOM2) — Serial Communication Interface 2
40 SERCOM2_1 (SERCOM2) — Serial Communication Interface 2
41 SERCOM2_2 (SERCOM2) — Serial Communication Interface 2
42 SERCOM2_OTHER (SERCOM2) — Serial Communication Interface 2
43 SERCOM3_0 (SERCOM3) — Serial Communication Interface 3
44 SERCOM3_1 (SERCOM3) — Serial Communication Interface 3
45 SERCOM3_2 (SERCOM3) — Serial Communication Interface 3
46 SERCOM3_OTHER (SERCOM3) — Serial Communication Interface 3
47 SERCOM4_0 (SERCOM4) — Serial Communication Interface 4
48 SERCOM4_1 (SERCOM4) — Serial Communication Interface 4
49 SERCOM4_2 (SERCOM4) — Serial Communication Interface 4
50 SERCOM4_OTHER (SERCOM4) — Serial Communication Interface 4
51 SERCOM5_0 (SERCOM5) — Serial Communication Interface 5
52 SERCOM5_1 (SERCOM5) — Serial Communication Interface 5
53 SERCOM5_2 (SERCOM5) — Serial Communication Interface 5
54 SERCOM5_OTHER (SERCOM5) — Serial Communication Interface 5
55 TC0 — Timer Counter 0
56 TC1 — Timer Counter 1
57 TC2 — Timer Counter 2
58 TCC0 — TCC Match/Compare 0
59 TCC1 — TCC Match/Compare 1
60 TCC2 — TCC Match/Compare 2
61 TCC3 — TCC Match/Compare 3
62 ADC_OTHER (ADC) — Analog To Digital Converter
63 ADC_RESRDY (ADC) — ADC Result Ready
64 AC — Analog Comparator
65 DAC_UNDERRUN (DAC) — Digital to Analog Converter
66 DAC_EMPTY (DAC) — DAC Buffer 0 Empty
67 PTC — Peripheral Touch Controller
68 TRNG — True Random Generator
69 I2S — Inter-IC Sound Interface
70 TRAM — Trust Ram

## Event generators
1 OSCCTRL_XOSC_FAIL, 2 OSC32KCTRL_XOSC32K_FAIL, 3 SUPC_BOD33DET, {n+4} RTC_PER_{n} (n=0..7), 12 RTC_CMP_0, 13 RTC_CMP_1, 14 RTC_TAMPER, 15 RTC_OVF, 16 RTC_PERD, {n+17} EIC_EXTINT_{n} (n=0..15), {n+33} DMAC_CH_{n} (n=0..7), {3n+41} TC{n}_OVF (n=0..2), {3n+42} TC{n}_MC_0 (n=0..2), {3n+43} TC{n}_MC_1 (n=0..2), 50 TCC0_TRG, 51 TCC0_CNT, {n+52} TCC0_MC_{n} (n=0..3), {5n+56} TCC{n}_OVF (n=0..2), {5n+52} TCC{n}_TRG (n=1..3), {5n+53} TCC{n}_CNT (n=1..3), 59 TCC1_MC_0, 60 TCC1_MC_1, 64 TCC2_MC_0, 65 TCC2_MC_1, {n+69} TCC3_MC_{n} (n=0..3), 73 TCC3_OVF, 74 ADC_RESRDY, 75 ADC_WINMON, {n+76} AC_COMP_{n} (n=0..3), 80 AC_WIN_0, 81 AC_WIN_1, 82 DAC_EMPTY_0, 83 DAC_EMPTY_1, 84 PTC_EOC, 85 PTC_WCOMP, 86 TRNG_READY, {n+87} CCL_LUTOUT_{n} (n=0..3), 91 PAC_ACCERR

## Event users
0 OSCCTRL_TUNE, 1 RTC_TAMPER, 2 NVMCTRL_PAGEW, {n+3} PORT_EV_{n} (n=0..3), {n+7} DMAC_CH_{n} (n=0..7), {n+15} TC{n}_EVU (n=0..2), 18 TCC0_EV_0, 19 TCC0_EV_1, {n+20} TCC0_MC_{n} (n=0..3), {4n+20} TCC{n}_EV_0 (n=1..3), {4n+21} TCC{n}_EV_1 (n=1..3), 26 TCC1_MC_0, 27 TCC1_MC_1, 30 TCC2_MC_0, 31 TCC2_MC_1, {n+34} TCC3_MC_{n} (n=0..3), 38 ADC_START, 39 ADC_SYNC, {n+40} AC_SOC_{n} (n=0..3), 44 DAC_START_0, 45 DAC_START_1, 46 PTC_STCONV, 47 PTC_DSEQR, {n+48} CCL_LUTIN_{n} (n=0..3)

## Properties
SIGNATURES: DSU_DID=0x20860000

## Pinouts (pin number, pad)
TQFP100: 1 PA00, 2 PA01, 3 PC00, 4 PC01, 5 PC02, 6 PC03, 7 PA02, 8 PA03, 9 PB04, 10 PB05, 11 AVSS, 12 AVDD, 13 PB06, 14 PB07, 15 PB08, 16 PB09, 17 PA04, 18 PA05, 19 PA06, 20 PA07, 21 PC05, 22 PC06, 23 PC07, 24 AVSS, 25 AVDD, 26 PA08, 27 PA09, 28 PA10, 29 PA11, 30 PC08, 31 PC09, 32 PC10, 33 PC11, 34 PC12, 35 PC13, 36 AVSS, 37 VDDIO, 38 GNDIO, 39 VDDCORE, 40 PB12, 41 PB13, 42 PB14, 43 PB15, 44 PC14, 45 PC15, 46 PA12, 47 PA13, 48 PA14, 49 PA15, 50 GNDIO, 51 VDDIO, 52 PA16, 53 PA17, 54 PA18, 55 PA19, 56 PC16, 57 PC17, 58 PC18, 59 PC19, 60 PC20, 61 PC21, 62 GNDIO, 63 VDDIO, 64 PB16, 65 PB17, 66 PB18, 67 PB19, 68 PB20, 69 PB21, 70 PA20, 71 PA21, 72 PA22, 73 PA23, 74 PA24, 75 PA25, 76 GNDIO, 77 VDDIO, 78 PB22, 79 PB23, 80 PB24, 81 PB25, 82 PC24, 83 PC25, 84 PC26, 85 PC27, 86 PC28, 87 GNDIO, 88 RESET_N, 89 VDDCORE, 90 GND, 91 VSW, 92 VDDIO, 93 PA30, 94 PA31, 95 PB30, 96 PB31, 97 PB00, 98 PB01, 99 PB02, 100 PB03

## Notices in the file
Copyright (c) 2019 Microchip Technology Inc.
SPDX-License-Identifier: Apache-2.0
Licensed under the Apache License, Version 2.0 (the "License");
you may not use this file except in compliance with the License.
You may obtain a copy of the License at
http://www.apache.org/licenses/LICENSE-2.0
Unless required by applicable law or agreed to in writing, software
distributed under the License is distributed on an "AS IS" BASIS,
WITHOUT WARRANTIES OR CONDITIONS OF ANY KIND, either express or implied.
See the License for the specific language governing permissions and
limitations under the License.
