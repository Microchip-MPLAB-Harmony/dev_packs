# PIC32MZ1025W104132 register map
Vendor: Microchip
Architecture 32xxxx. Special function registers and configuration words.
Registers are 32-bit, read-write, no defined reset value unless marked. A register's access mark holds for its fields unless they carry their own. Addresses are absolute, and some are shared; only a register's first bit layout is shown; lines under a group give offsets from that group; [hi:lo] are bit positions; {n}, {i} and the like mark numbered series; 'fields as' and 'values as' point back to an identical list; <NAME> marks a mode.

## Further device data
pins=1: GNDDB; 2: pmu_vsense; 3: vpmu_vddc; 4: VDD33; 5: CVDT12/ETXD1/RPC14/IOCC14/RC14; 6: CVDT13/ETXD0/RPC15/IOCC15/RC15; 7: VDD33; 8: CVDT15/EMDIO/RPK13/IOCK13/RK13; 9: CVDT16/EMDC/RPK14/IOCK14/RK14; 10: CVDT14/ERXDV/RPK12/IOCK12/RK12; 11: CVDT7/ERXERR/RPC9/IOCC9/RC9; 12: VREGCAP2; 13: TSTSIBVISI0/SQICS0/CVDT17/RPA0/IOCA0/RA0; 14: VDD15; 15: VREGCAP0/VREGCAP1; 16: TSTSIBVISI1/SQICS1/CVDT18/RPC0/IOCC0/RC0; 17: TSTSIBVISI2/SQID3/CVDT19/RPC1/IOCC1/RC1; 18: TSTSIBVISI3/SQID2/CVDT20/RPC2/IOCC2/RC2; 19: SQID1/CVDT21/RPC3/IOCC3/RC3; 20: VDD33/ENVREG; 21: SCLKI/SQID0/CVDT22/RPC4/IOCC4/RC4; 22: SQICLK/CVDT23/RPC5/IOCC5/RC5; 23: RPC6/SCK1/IOCC6/RC6; 24: RPC7/SDI1/IOCC7/RC7; 25: RPC8/SDO1/IOCC8/RC8; 26: RPA1/SS1/CS1/FSYNC1/IOCA1/RA1; 27: VDD33; 28: RPA2/SCL2/IOCA2/RA2; 29: RPA3/SDA2/IOCA3/RA3; 30: RPA4/SCL1/IOCA4/RA4; 31: RPA5/SDA1/IOCA5/RA5; 32: U1CTSn/IOCA6/RA6; 33: U1RTSn/U1BCLK/IOCA7/RA7; 34: U1RX/IOCA8/RA8; 35: U1TX/IOCA9/RA9; 36: VREGCTRL0/BT_CLK_OUT/RPK4/IOCK4/RK4; 37: MCLR; 38: VREGCTRL1/PTA_WLAN_ACTIVE/RPK5/IOCK5/RK5; 39: PTA_BT_PRIO/RPK6/IOCK6/RK6; 40: PTA_BT_ACTIVE/RPK7/IOCK7/RK7; 41: VDD33; 42: RF_FE_7/RPK8/IOCK8/RK8; 43: RF_FE_8/RPK9/IOCK9/RK9; 44: RF_FE_6/RPK10/IOCK10/RK10; 45: RF_FE_5/RPK11/IOCK11/RK11; 46: spi_vdd15; 47: afe_vdd15; 48: xtal_vdd15; 49: Xtal_in; 50: Xtal_out; 51: iovdd_rf; 52: analog_test; 53: in_tssi; 54: syn_sd_vdd15; 55: syn_pll_vdd15; 56: syn_vco_vdd15; 57: iovdd_rf; 58: mbs_extra_48k; 59: rxr_in2; 60: rxr_fe2_vdd15; 61: rxr_riq_vdd15; 62: rxr_fe1_vdd15; 63: rxr_in1; 64: bb_vdd15; 65: txr_umx_vdd15; 66: txr_lpa_vout; 67: txr_lpa_vdd15; 68: RF_FE_3/RPK0/IOCK0/RK0; 69: RF_FE_4/RPK1/IOCK1/RK1; 70: RF_FE_1/AN19/CVD19/CVDR19/RPK2/IOCK2/RK2; 71: RF_FE_2/AN18/CVD18/CVDR18/RPK3/IOCK3/RK3; 72: VDD33; 73: AN17/CVD17/CVDR17/RPA10/INT0/IOCA10/RA10; 74: RPA11/SCK2/IOCA11/RA11; 75: AN16/CVD16/CVDR16/RPA12/IOCA12/RA12; 76: AN15/ANN1/CVD15/CVDR15/RPA13/IOCA13/RA13; 77: AN14/ANN0/CVD14/CVDR14/RPA14/IOCA14/RA14; 78: AN13/CVD13/CVDR13/RPA15/IOCA15/RA15; 79: AVdd; 80: AN12/CVD12/CVDR12/RPB14/IOCB14/RB14; 81: AN11/CVD11/CVDR11/RPB13/IOCB13/RB13; 82: ANA0/RPB12/IOCB12/RB12; 83: ANB0/RPB11/IOCB11/RB11; 84: AN10/CVD10/CVDR10/LVDIN/RPB10/IOCB10/RB10; 85: Avss; 86: PGD4ENTRY/PGD4/EMUD4/TDI/AN9/CVD9/CVDR9/RPB9/IOCB9/RB9; 87: PGC4ENTRY/PGC4/EMUC4/TCK/AN8/CVD8/CVDR8/RPB8/IOCB8/RB8; 88: TDO/AN7/CVD7/CVDR7/CVDT0/RPB7/IOCB7/RB7; 89: TMS/AN6/CVD6/CVDR6/CVDT1/RPB6/IOCB6/RB6; 90: SOSCO; 91: VDD33; 92: SOSCI; 93: PGD2ENTRY/PGD2/EMUD2/AN5/CVD5/CVDR5/CVDT2/RTCC/RPB5/IOCB5/RB5; 94: Vbat; 95: PGC2ENTRY/PGC2/EMUC2/AN4/CVD4/CVDR4/CVDT3/RPB4/IOCB4/RB4; 96: PGC1ENTRY/PGC1/EMUC1/AN3/CVD3/CVDR3/CVDT4/RPB3/USBOEN/IOCB3/RB3; 97: PGD1ENTRY/PGD1/EMUD1/AN2/CVD2/CVDR2/CVDT5/RPB2/USBID/IOCB2/RB2; 98: TA4A/AN1/CVD1/CVDR1/CVDT6/ETH_EXCLK_OUT/RPB1/VBUSON/IOCB1/RB1; 99: AN0/RPB0/IOCB0/RB0; 100: D-; 101: D+; 102: VUSB3V3; 103: VBUS; 104: VREGCAP3/VREGCAP5/VREGCAP6; 105: VDD15; 106: VREGCAP4/VREGCAP7/VREGCAP8; 107: VDD33; 108: CVDT8/ERXD1/RPC10/IOCC10/RC10; 109: CVDT9/ERXD0/RPC11/IOCC11/RC11; 110: CVDT10/ETH_CLK_OUT/ERXCLK/RPC12/IOCC12/RC12; 111: CVDT11/ETXEN/RPC13/IOCC13/RC13; 112: buk_mdlo_out; 113: vpmu_vddp; 114: vpmu_vddp; 115: buk_bk_lx, interrupts=0 CORE_TIMER — Core Timer; 1 CORE_SOFTWARE_0 — Core Software 0; 2 CORE_SOFTWARE_1 — Core Software 1; 3 EXTERNAL_0 — Ext INT 0; 4 TIMER_1 — Timer1; 5 INPUT_CAPTURE_1_ERROR — Input Capture 1 Error; 6 INPUT_CAPTURE_1 — Input Capture 1; 7 OUTPUT_COMPARE_1 — Output Compare 1; 8 EXTERNAL_1 — Ext INT 1; 9 TIMER_2 — Timer2; 10 INPUT_CAPTURE_2_ERROR — Input Capture 2 Error; 11 INPUT_CAPTURE_2 — Input Capture 2; 12 OUTPUT_COMPARE_2 — Output Compare 2; 13 EXTERNAL_2 — Ext INT 2; 14 TIMER_3 — Timer3; 15 INPUT_CAPTURE_3_ERROR — Input Capture 3 Error; 16 INPUT_CAPTURE_3 — Input Capture 3; 17 OUTPUT_COMPARE_3 — Output Compare 3; 18 EXTERNAL_3 — Ext INT 3; 19 TIMER_4 — Timer4; 20 INPUT_CAPTURE_4_ERROR — Input Capture 4 Error; 21 INPUT_CAPTURE_4 — Input Capture 4; 22 OUTPUT_COMPARE_4 — Output Compare 4; 23 EXTERNAL_4 — Ext INT 4; 24 TIMER_5 — Timer5; 30 FLASH_CONTROL — Flash Control Event; 31 PREFETCH — Prefetch Module SEC Event; 32 PFW_CRC — PFW CRC event; 33 RTCC — REAL_TIME_CLOCK; 34 USB — USB_1; 35 SPI1_FAULT — SPI_1_FAULT; 36 SPI1_RX — SPI_1_RECEIVE; 37 SPI1_TX — SPI_1_TRANSFER; 38 UART1_FAULT — UART_1_FAULT; 39 UART1_RX — UART_1_RECEIVE; 40 UART1_TX — UART_1_TRANSFER; 41 I2C1_BUS — I2C_1_BUS_COLLISION_EVENT; 42 I2C1_SLAVE — I2C_1_SLAVE_EVENT; 43 I2C1_MASTER — I2C_1_MASTER_EVENT; 44 CHANGE_NOTICE_A — PORT_A_INPUT_CHANGE_INTERRUPT; 45 CHANGE_NOTICE_B — PORT_B_INPUT_CHANGE_INTERRUPT; 46 CHANGE_NOTICE_C — PORT_C_INPUT_CHANGE_INTERRUPT; 47 CHANGE_NOTICE_K — PORT_D_INPUT_CHANGE_INTERRUPT; 53 SPI2_FAULT — SPI 2 Fault; 54 SPI2_RX — SPI 2 Receive Done; 55 SPI2_TX — SPI 2 Transfer Done; 56 UART2_FAULT — UART 2 Error; 57 UART2_RX — UART 2 Receiver; 58 UART2_TX — UART 2 Transmitter; 59 I2C2_BUS — I2C 2 Bus Collision Event; 60 I2C2_SLAVE — I2C 2 Slave Event; 61 I2C2_MASTER — I2C 2 Master Event; 62 UART3_FAULT — UART_3_FAULT; 63 UART3_RX — UART_3_RECEIVE; 64 UART3_TX — UART_3_TRANSFER; 68 DMA0 — DMA Channel 0; 69 DMA1 — DMA Channel 1; 70 DMA2 — DMA Channel 2; 71 DMA3 — DMA Channel 3; 72 DMA4 — DMA Channel 4; 73 DMA5 — DMA Channel 5; 74 DMA6 — DMA Channel 6; 75 DMA7 — DMA Channel 7; 76 TIMER_6 — Timer 6; 80 TIMER_7 — Timer 7; 83 RFSMC — WiFi SMC Event; 84 RFMAC — WiFi MAC Event; 85 CTR1_EVENT — CTR1 EVENT; 86 RFTM0 — WiFi Timer 0 Event; 87 RFTM1 — WiFi Timer 1 Event; 88 RFTM2 — WiFi Timer 2 Event; 89 RFTM3 — WiFi Timer 3 Event; 90 CTR1_TRG — CTR1 Trig out event; 91 RFWCOE — WiFi WCOE Event; 92 ADC — ADC global; 94 ADC_DC1 — ADC Digital Comparator 1; 95 ADC_DC2 — ADC Digital Comparator 2; 96 ADC_DF1 — ADC Digital Filter 1; 97 ADC_DF2 — ADC Digital Filter 2; 100 ADC_FAULT — ADC Fault Interrupt; 101 ADC_EOS — ADC EO Scan; 102 ADC_ARDY — ADC Analog Ready; 103 ADC_URDY — ADC Update Rdy after Suspend; 104 ADC_DMA — ADC 1st Class Buffer Transfer; 106 ADC_DATA0 — ADC A Data #0; 107 ADC_DATA1 — ADC A Data #1; 108 ADC_DATA2 — ADC A Data #2; 109 ADC_DATA3 — ADC A Data #3; 110 ADC_DATA4 — ADC A Data #4; 111 ADC_DATA5 — ADC A Data #5; 112 ADC_DATA6 — ADC A Data #6; 113 ADC_DATA7 — ADC A Data #7; 114 ADC_DATA8 — ADC A Data #8; 115 ADC_DATA9 — ADC A Data #9; 116 ADC_DATA10 — ADC A Data #10; 117 ADC_DATA11 — ADC A Data #11; 118 ADC_DATA12 — ADC A Data #12; 119 ADC_DATA13 — ADC A Data #13; 120 ADC_DATA14 — ADC A Data #14; 121 ADC_DATA15 — ADC A Data #15; 122 ADC_DATA16 — ADC A Data #16; 123 ADC_DATA17 — ADC A Data #17; 124 ADC_DATA18 — ADC A Data #18; 125 ADC_DATA19 — ADC A Data #19; 126 ADC_DATA20 — ADC A Data #20; 127 ADC_DATA21 — ADC A Data #21; 128 ADC_DATA22 — ADC A Data #22; 129 ADC_DATA23 — ADC A Data #23; 142 CAN1 — CAN Combined Interrupt; 143 CAN2_RX — CAN2 Receive Interrupt; 144 CAN2_TX — CAN2 Transmit Interrupt; 145 CAN2_MISC — CAN2 Misc Interrupt; 150 SQI1 — SQI Event Completion; 152 PTG0_STEP — PTG Step Complete; 153 PTG0_WDT — PTG Watchdog Timeout; 154 PTG0_TRG0 — PTG Int. Trigger 0; 155 PTG0_TRG1 — PTG Int. Trigger 1; 156 PTG0_TRG2 — PTG Int. Trigger 2; 157 PTG0_TRG3 — PTG Int. Trigger 3; 162 CORE_PERF_COUNT — Core perform. counter event; 163 CORE_FAST_DEBUG_CHAN — Fast Debug Channel Event; 164 CRYPTO — Crypto Engine Event; 165 ETHERNET — Ethernet; 166 CRYPTO1 — Asymmetric Crypto Engine End Event; 167 CRYPTO1_FAULT — Asymmetric Crypto Engine Error Event; 168 CVD_EVENT — cvd event
