# PIC32MX440F128L device description
Architecture: MIPS; Family: PIC32MX; Series: PIC32MX
Parameters: __NUM_OSC=1 (Number of oscillators present), __INT_PRIO_LEVELS=7 (Number of interrupt priority levels), __INT_SUBPRIO_LEVELS=4 (Number of interrupt subpriority levels), __INT_NUM_SHADOW_SETS=1 (Number of interrupt shadow register sets), __SYS_DEF_FREQ=80000000 (System Clock Default Frequency), __PB_DEF_FREQ=80000000 (Peripheral Bus Default Clock Frequency), __POSC_DEF_FREQ=8000000 (Primary Oscillator Input Default Frequency), __SOSC_DEF_FREQ=32768 (Secondary Oscillator Input Default Frequency), __PB_DEF_DIV=1 (Peripheral Bus Default Divider Value), __NUM_DMA_CHANNELS=4 (Number of DMA Channels)
Programming and debug interfaces: JTAG, SWD
Registers are 32-bit, read-write, no defined reset value unless marked. A register's access mark holds for its fields unless they carry their own. Offsets are from the block's base; lines under a group give offsets from that group; [hi:lo] are bit positions; {n}, {i} and the like mark numbered series; 'fields as' and 'values as' point back to an identical list; <NAME> marks a mode.

## Ordering variants
PIC32MX440F128L: TQFP100, up to 80 MHz, -40 to 105 C, 2.3 to 3.6 V
PIC32MX440F128L: XBGA121, up to 80 MHz, -40 to 105 C, 2.3 to 3.6 V

## Memory
base space: start 0 size 0x100000000, little endian
  0x1FC02FF0 devid size 0x0
  0x1d000000 code size 0x20000
  0x1fc00000 bootconfig size 0x2ff0
  0xA0000000 kseg1_data_mem size 0x8000
  0x1f800000 periph size 0x100000
config space: start 0x1fc02ff0 size 0x10

## Peripheral instances (address, pins/pin function, parameters)
ADC at 0x1f808ff4 in periph0
BMX at 0x1f882000 in periph2
CFG at 0x1f80f200 in periph1
CMP at 0x1f809ff4 in periph0
CORE at 0x0
CVR at 0x1f8097f4 in periph0
DDPSTAT at 0x1f880140 in periph2
DMAC at 0x1f883000 in periph2
I2C1 at I2C 0x1f804ff4 in periph0
I2C2
ICAP1 at ICAP 0x1f801ff4 in periph0
  parameters: TMR_SRC_0=0 (Timer 3), TMR_SRC_1=1 (Timer 2)
ICAP{n} (n=2..5)
  parameters: TMR_SRC_0=0 (Timer 3), TMR_SRC_1=1 (Timer 2)
INT at 0x1f881000 in periph2
NVM at 0x1f80f400 in periph1
  parameters: PAGE_SIZE=4096, ROW_SIZE=512
OCMP1 at OCMP 0x1f802ff4 in periph0
  parameters: TMR_SRC_0=0 (Timer 2), TMR_SRC_1=1 (Timer 3)
OCMP{n} (n=2..5)
  parameters: TMR_SRC_0=0 (Timer 2), TMR_SRC_1=1 (Timer 3)
OSC at 0x1f80f000 in periph1
PCACHE at 0x1f884000 in periph2
PMP at 0x1f806ff4 in periph0
PORT at 0x1f886000 in periph2
  parameters: CN_PIN_COUNT=22, AN_PIN_COUNT=16
RCON at 0x1f80f600 in periph1
RTCC at 0x1f8001f4 in periph0
SPI1 at SPI 0x1f8057f4 in periph0
SPI2
TMR1 at 0x1f8005f4 in periph0
TMR2 at TMR 0x1f8007f4 in periph0
TMR{n} (n=3..5)
UART1 at UART 0x1f805ff4 in periph0
UART2
USB at 0x1f885040 in periph2
WDT at 0x1f800000 in periph0

## Interrupts
0 CORE_TIMER
1 CORE_SOFTWARE_0
2 CORE_SOFTWARE_1
3 EXTERNAL_0 — Ext INT 0
4 TIMER_1
5 INPUT_CAPTURE_1
6 OUTPUT_COMPARE_1
7 EXTERNAL_1 — Ext INT 1
8 TIMER_2
9 INPUT_CAPTURE_2
10 OUTPUT_COMPARE_2
11 EXTERNAL_2 — Ext INT 2
12 TIMER_3
13 INPUT_CAPTURE_3
14 OUTPUT_COMPARE_3
15 EXTERNAL_3 — Ext INT 3
16 TIMER_4
17 INPUT_CAPTURE_4
18 OUTPUT_COMPARE_4
19 EXTERNAL_4 — Ext INT 4
20 TIMER_5
21 INPUT_CAPTURE_5
22 OUTPUT_COMPARE_5
23 SPI_1, IRQ 23 SPI1_ERR — SPI1 Fault
23 SPI_1, IRQ 25 SPI1_RX — SPI1 Receive Done
23 SPI_1, IRQ 24 SPI1_TX — SPI1 Transmit Done
24 UART_1, IRQ 26 UART1_ERR — UART1 Error
24 UART_1, IRQ 27 UART1_RX — UART1 Receiver
24 UART_1, IRQ 28 UART1_TX — UART1 Trasmitter
25 I2C_1, IRQ 29 I2C1_BUS — I2C1 Bus Collision Event
25 I2C_1, IRQ 30 I2C1_SLAVE — I2C1 Slave Event
25 I2C_1, IRQ 31 I2C1_MASTER — I2C1 Master Event
26 CHANGE_NOTICE, IRQ 32 CHANGE_NOTICE
27 ADC, IRQ 33 ADC — ADC1 Convert Done
28 PMP, IRQ 34 PMP — Parallel Master Port
29 COMPARATOR_1, IRQ 35 COMPARATOR_1
30 COMPARATOR_2, IRQ 36 COMPARATOR_2
31 SPI_2, IRQ 37 SPI2_ERR — SPI2 Error
31 SPI_2, IRQ 39 SPI2_RX — SPI2 Receiver
31 SPI_2, IRQ 38 SPI2_TX — SPI2 Trasmitter
32 UART_2, IRQ 40 UART2_ERR — UART2 Error
32 UART_2, IRQ 41 UART2_RX — UART2 Receiver
32 UART_2, IRQ 42 UART2_TX — UART2 Trasmitter
33 I2C_2, IRQ 43 I2C2_BUS — I2C2 Bus Collision Event
33 I2C_2, IRQ 44 I2C2_SLAVE — I2C2 Slave Event
33 I2C_2, IRQ 45 I2C2_MASTER — I2C2 Master Event
34 FAIL_SAFE_MONITOR, IRQ 46 FAIL_SAFE_MONITOR — Fail Safe Clock Monitor
35 RTCC, IRQ 47 RTCC — Real Time Clock Calendar
36 DMA_0, IRQ 48 DMA0
37 DMA_1, IRQ 49 DMA1
38 DMA_2, IRQ 50 DMA2
39 DMA_3, IRQ 51 DMA3
44 FCE, IRQ 56 FLASH_CONTROL
45 USB_1, IRQ 57 USB

## Notices in the file
Copyright (c) 2019 Microchip Technology Inc.
SPDX-License-Identifier: Apache-2.0
Licensed under the Apache License, Version 2.0 (the "License");
you may not use this file except in compliance with the License.
You may obtain a copy of the License at
http://www.apache.org/licenses/LICENSE-2.0
Unless required by applicable law or agreed to in writing, software
distributed under the License is distributed on an "AS IS" BASIS,
WITHOUT WARRANTIES OR CONDITIONS OF ANY KIND, either express or implied.
See the License for the specific language governing permissions and
limitations under the License.
