# PIC32MM0128GPM048 register map
Vendor: Microchip
Architecture 32xxxx. Special function registers and configuration words.
Registers are 32-bit, read-write, reset 0x0 unless marked. A register's access mark holds for its fields unless they carry their own. Addresses are absolute, and some are shared; only a register's first bit layout is shown; lines under a group give offsets from that group; [hi:lo] are bit positions; {n}, {i} and the like mark numbered series; 'fields as' and 'values as' point back to an identical list; <NAME> marks a mode.

## Further device data
pins=1: TMS/RP14/SDA1/OCM1B/INT2/RB9; 2: RP23/RC6; 3: RP20/RC7; 4: AN14/LVDIN/C2INC/RC8; 5: PGEC3/TDO/RP18/ASCL1/USBOEN/RC9; 6: VSS; 7: VCAP; 8: RTCC/RA15; 9: D-/RB10; 10: D+/RB11; 11: VUSB3V3; 12: AN8/RP15/SCL3/RB13; 13: RP22/SCK3/RA10; 14: RP21/SDI3/RA7; 15: CVREF/AN9/C3INB/RP16/VBUSON/SDI1/OCM3B/INT1/RB14; 16: AN10/C3INA/REFCLKO/RP17/SS1/FSYNC1/INT0/RB1; 17: AVSS/VSS; 18: AVDD/VDD; 19: MCLR; 20: AN19/U1RX/RA6; 21: PGEC2/VREF+/CVREF+/AN0/RP1/RA0; 22: PGED2/VREF-/AN1/RP2/OCM1F/RA1; 23: PGED1/AN2/C1IND/C2INB/C3INC/RP6/OCM2C/RB0; 24: PGEC1/AN3/C1INC/C2INA/RP7/OCM2D/RB1; 25: AN4/C1INB/RP8/SDA2/OCM2E/RB2; 26: TDI/AN11/C1INA/RP9/SCL2/OCM2F/RB3; 27: AN12/C2IND/T2CK/T2G/RC0; 28: AN12/C2IND/T2CK/T2G/RC1; 29: RP19/OCM2A/RC2; 30: VDD; 31: VSS; 32: OSC1/CLKI/AN5/RP3/OCM1C/RA2; 33: OSC2/CLKO/AN6/C3IND/RP4/RA3; 34: SDO3/RA8; 35: SOSCI/AN7/RP10/OCM3C/RB4; 36: SOSCO/SCLKI/RP5/PWRLCLK/OCM3D/RA4; 37: RP24/OCM3A/RA9; 38: REFCLKI/T1CK/T1G/U1RTS/U1BCLK/SDO1/RD0; 39: OCM2B/RC3; 40: OCM1E/INT3/RC4; 41: AN15/OCM1D/RC5; 42: VSS; 43: VDD; 44: U1TX/RC12; 45: PGEC2/VREF+/CVREF+/AN0/RP1/RA0; 46: VBUS/RB6; 47: RP12/SDA3/OCM3F/RB7; 48: TCK/RP13/SCL1/U1CTS/SCK1/OCM1A/RB8, interrupts=0 CORE_TIMER — Core Timer; 1 CORE_SOFTWARE_0 — Core Software 0; 2 CORE_SOFTWARE_1 — Core Software 1; 3 EXTERNAL_0 — External 0; 4 EXTERNAL_1 — External 1; 5 EXTERNAL_2 — External 2; 6 EXTERNAL_3 — External 3; 7 EXTERNAL_4 — External 4; 8 CHANGE_NOTICE_A — PORT A Change Notification; 9 CHANGE_NOTICE_B — PORT B Change Notification; 10 CHANGE_NOTICE_C — PORT C Change Notification; 11 CHANGE_NOTICE_D — PORT D Change Notification; 17 TIMER_1 — Timer 1; 18 TIMER_2 — Timer 2; 19 TIMER_3 — Timer 3; 23 COMPARATOR_1 — Comparator 1; 24 COMPARATOR_2 — Comparator 2; 25 COMPARATOR_3 — Comparator 3; 29 USB — USB; 32 RTCC — Real Time Clock Alarm; 33 ADC — ADC Conversion Done; 36 HLVD — HLVD; 37 CLC1 — Logic Cell 1; 38 CLC2 — Logic Cell 2; 39 CLC3 — Logic Cell 3; 40 CLC4 — Logic Cell 4; 41 SPI1_ERR — SPI 1 Error; 42 SPI1_TX — SPI 1 Transmission; 43 SPI1_RX — SPI 1 Reception; 44 SPI2_ERR — SPI 2 Error; 45 SPI2_TX — SPI 2 Transmission; 46 SPI2_RX — SPI 2 Reception; 47 SPI3_ERR — SPI 3 Error; 48 SPI3_TX — SPI 3 Transmission; 49 SPI3_RX — SPI 3 Reception; 53 UART1_RX — UART 1 Reception; 54 UART1_TX — UART 1 Transmission; 55 UART1_ERR — UART 1 Error; 56 UART2_RX — UART 2 Reception; 57 UART2_TX — UART 2 Transmission; 58 UART2_ERR — UART 2 Error; 59 UART3_RX — UART 3 Reception; 60 UART3_TX — UART 3 Transmission; 61 UART3_ERR — UART 3 Error; 65 I2C1_SLAVE — I2C 1 Slave; 66 I2C1_MASTER — I2C 1 Master; 67 I2C1_BUS — I2C 1 Bus Collision; 68 I2C2_SLAVE — I2C 2 Slave; 69 I2C2_MASTER — I2C 2 Master; 70 I2C2_BUS — I2C 2 Bus Collision; 71 I2C3_SLAVE — I2C 3 Slave; 72 I2C3_MASTER — I2C 3 Master; 73 I2C3_BUS — I2C 3 Bus Collision; 74 CCP1 — CCP 1 Input Capture or Output Compare; 75 CCT1 — CCP 1 Timer; 76 CCP2 — CCP 2 Input Capture or Output Compare; 77 CCT2 — CCP 2 Timer; 78 CCP3 — CCP 3 Input Capture or Output Compare; 79 CCT3 — CCP 3 Timer; 80 CCP4 — CCP 4 Input Capture or Output Compare; 81 CCT4 — CCP 4 Timer; 82 CCP5 — CCP 5 Input Capture or Output Compare; 83 CCT5 — CCP 5 Timer; 84 CCP6 — CCP 6 Input Capture or Output Compare; 85 CCT6 — CCP 6 Timer; 86 CCP7 — CCP 7 Input Capture or Output Compare; 87 CCT7 — CCP 7 Timer; 88 CCP8 — CCP 8 Input Capture or Output Compare; 89 CCT8 — CCP 8 Timer; 90 CCP9 — CCP 9 Input Capture or Output Compare; 91 CCT9 — CCP 9 Timer; 92 FRC_TUNE — FRC Tune; 94 NVM — NVM Program or Erase Complete; 95 PERFORMANCE_COUNTER — Core Performance Counter; 97 ECCSB_ERR — ECC Single Bit error; 98 DMA0 — DMA channel 0; 99 DMA1 — DMA channel 1; 100 DMA2 — DMA channel 2; 101 DMA3 — DMA channel 3
