# PIC32MK0128MCA032 device description
Architecture: MIPS; Family: PIC32MK; Series: PIC32MK
Parameters: __INT_PRIO_LEVELS=7 (Number of interrupt priority levels), __INT_SUBPRIO_LEVELS=4 (Number of interrupt subpriority levels), __SYS_DEF_FREQ=120000000 (System Clock Default Frequency), __NUM_DMA_CHANNELS=8 (Number of DMA Channels), __DAC_RESOLUTION=12 (DAC resolution in bits), __NUM_CMP_CHANNELS=3 (Number of Comparator Channels), __PB1_DEF_FREQ=60000000 (Peripheral Bus 1 Default Clock Frequency), __PB2_DEF_FREQ=60000000 (Peripheral Bus 2 Default Clock Frequency), __PB4_DEF_FREQ=60000000 (Peripheral Bus 4 Default Clock Frequency), __PB6_DEF_FREQ=30000000 (Peripheral Bus 6 Default Clock Frequency), __REFCLK1_DEF_FREQ=120000000 (Reference Clock 1 Default Frequency), __REFCLK2_DEF_FREQ=120000000 (Reference Clock 2 Default Frequency), __REFCLK3_DEF_FREQ=120000000 (Reference Clock 3 Default Frequency), __REFCLK4_DEF_FREQ=120000000 (Reference Clock 4 Default Frequency), __POSC_DEF_FREQ=8000000 (Primary Oscillator Input Default Frequency), __SOSC_DEF_FREQ=32768 (Secondary Oscillator Input Default Frequency), __PB1_DEF_DIV=2 (Peripheral Bus 1 Default Divider Value), __PB2_DEF_DIV=2 (Peripheral Bus 2 Default Divider Value), __PB4_DEF_DIV=2 (Peripheral Bus 4 Default Divider Value), __PB5_DEF_DIV=2 (Peripheral Bus 5 Default Divider Value), __PB6_DEF_DIV=4 (Peripheral Bus 6 Default Divider Value), __INT_NUM_SHADOW_SETS=7 (Number of interrupt shadow register sets)
Programming and debug interfaces: JTAG
Registers are 32-bit, read-write, no defined reset value unless marked. A register's access mark holds for its fields unless they carry their own. Offsets are from the block's base; lines under a group give offsets from that group; [hi:lo] are bit positions; {n}, {i} and the like mark numbered series; 'fields as' and 'values as' point back to an identical list; <NAME> marks a mode.

## Ordering variants
PIC32MK0128MCA032: VQFN32, up to 120 MHz, -40 to 85 C, 2.3 to 3.6 V

## Memory
base space: start 0 size 0x100000000, little endian
  0xff300000 emulation size 0x100000
  0xffffffff devid size 0x0
  0x1d000000 code size 0x20000
  0x1fc42000 testmem size 0x1000
  0x1fc00000 lowerbootalias size 0x3f30
  0x1fc04000 lowerbootaliaslastpage size 0x1000
  0x1fc40000 boot1 size 0x3f30
  0x1fc44000 boot1lastpage size 0x1000
  0x1fc03f30 lowerbootaliasaltconfig size 0x50
  0x1fc43f30 altboot1config size 0x50
  0x1fc43fb0 boot1config size 0x50
  0x00000000 kseg0_data_mem size 0x8000
  0x1f800000 periph_pb1_std size 0x2000
  0x1f810000 periph_pb1_fast size 0x2000
  0x1f820000 periph_pb2_std size 0xe200
  0x1f860000 periph_pb4_std size 0x700
  0x1f880000 periph_pb5_std size 0xb000
  0x1f8c0000 periph_pb6_std size 0x400
  0x1f8f0000 periph_ssx size 0x10000
lowerbootaliasconfig space: start 0x1fc03fb0 size 0x50
adccal space: start 0x1fc45000 size 0x1c
serial space: start 0x1fc45020 size 0x10

## Peripheral instances (address, pins/pin function, parameters)
ADCHS at 0x1f887000 in periph_pb5_std
CDAC1 at CDAC 0x1f82c600 in periph_pb2_std
CFG at 0x1f800000 in periph_pb1_std
CLC1 at CLC 0x1f82d200 in periph_pb2_std
CMP at 0x1f82c000 in periph_pb2_std
CORE at 0x0
CRU at 0x1f801200 in periph_pb1_std
CTMU at 0x1f82d000 in periph_pb2_std
DMAC at 0x1f811000 in periph_pb1_fast
DMT at 0x1f800e00 in periph_pb1_std
GPIO at 0x1f860000 in periph_pb4_std
HLVD at 0x1f801800 in periph_pb1_std
I2C1 at I2C 0x1f826000 in periph_pb2_std
I2C2
ICAP1 at ICAP 0x1f822000 in periph_pb2_std
  parameters: TMR_SRC_0=0 (Timer 3), TMR_SRC_1=1 (Timer 2), TMR_ALTERNATE_SRC_0=0 (Timer 5), TMR_ALTERNATE_SRC_1=1 (Timer 4)
ICAP2
  parameters: TMR_SRC_0=0 (Timer 3), TMR_SRC_1=1 (Timer 2), TMR_ALTERNATE_SRC_0=0 (Timer 5), TMR_ALTERNATE_SRC_1=1 (Timer 4)
ICAP3
  parameters: TMR_SRC_0=0 (Timer 3), TMR_SRC_1=1 (Timer 2), TMR_ALTERNATE_SRC_0=0 (Timer 5), TMR_ALTERNATE_SRC_1=1 (Timer 4)
ICAP4
  parameters: TMR_SRC_0=0 (Timer 3), TMR_SRC_1=1 (Timer 2), TMR_ALTERNATE_SRC_0=0 (Timer 3), TMR_ALTERNATE_SRC_1=1 (Timer 2)
INT at 0x1f810000 in periph_pb1_fast
JTAG at 0x1f801000 in periph_pb1_std
MCPWM at 0x1f82a000 in periph_pb2_std
  parameters: MCPWM_CH1_OUTPUTS=2, MCPWM_CH2_OUTPUTS=2, MCPWM_CH3_OUTPUTS=2, MCPWM_CH4_OUTPUTS=2
NVM at 0x1f800a00 in periph_pb1_std
  parameters: PAGE_SIZE=4096, ROW_SIZE=512
OCMP1 at OCMP 0x1f824000 in periph_pb2_std
  parameters: TMR_SRC_0=0 (Timer 2), TMR_SRC_1=1 (Timer 3), TMR_ALTERNATE_SRC_0=0 (Timer 4), TMR_ALTERNATE_SRC_1=1 (Timer 5)
OCMP2
  parameters: TMR_SRC_0=0 (Timer 2), TMR_SRC_1=1 (Timer 3), TMR_ALTERNATE_SRC_0=0 (Timer 4), TMR_ALTERNATE_SRC_1=1 (Timer 5)
OCMP3
  parameters: TMR_SRC_0=0 (Timer 2), TMR_SRC_1=1 (Timer 3), TMR_ALTERNATE_SRC_0=0 (Timer 4), TMR_ALTERNATE_SRC_1=1 (Timer 5)
OCMP4
  parameters: TMR_SRC_0=0 (Timer 2), TMR_SRC_1=1 (Timer 3), TMR_ALTERNATE_SRC_0=0 (Timer 2), TMR_ALTERNATE_SRC_1=1 (Timer 3)
PCACHE at 0x1f800800 in periph_pb1_std
QEI1 at QEI 0x1f82b200 in periph_pb2_std
QEI2
RCON at 0x1f801240 in periph_pb1_std
RPIN at 0x1f801404 in periph_pb1_std
RPOR at 0x1f801600 in periph_pb1_std
RTCC at 0x1f8c0000 in periph_pb6_std
SB at 0x1f8f0510 in periph_ssx
SPI1 at SPI 0x1f827000 in periph_pb2_std
SPI2
TMR1 at 0x1f820000 in periph_pb2_std
TMR2 at TMR 0x1f820200 in periph_pb2_std
TMR{n} (n=3..5)
UART1 at UART 0x1f828000 in periph_pb2_std
UART2
WDT at 0x1f800c00 in periph_pb1_std

## Interrupts
0 CORE_TIMER — Core Timer Interrupt
1 CORE_SOFTWARE_0 — Core Software Interrupt 0
2 CORE_SOFTWARE_1 — Core Software Interrupt 1
3 EXTERNAL_0 — External Interrupt 0
4 TIMER_1
5 INPUT_CAPTURE_1_ERROR
6 INPUT_CAPTURE_1
7 OUTPUT_COMPARE_1
8 EXTERNAL_1 — External Interrupt 1
9 TIMER_2
10 INPUT_CAPTURE_2_ERROR
11 INPUT_CAPTURE_2
12 OUTPUT_COMPARE_2
13 EXTERNAL_2 — External Interrupt 2
14 TIMER_3
15 INPUT_CAPTURE_3_ERROR
16 INPUT_CAPTURE_3
17 OUTPUT_COMPARE_3
18 EXTERNAL_3 — External Interrupt 3
19 TIMER_4
20 INPUT_CAPTURE_4_ERROR
21 INPUT_CAPTURE_4
22 OUTPUT_COMPARE_4
23 EXTERNAL_4 — External Interrupt 4
24 TIMER_5
30 RTCC — Real Time Clock
31 FLASH_CONTROL — Flash Control Event
32 COMPARATOR_1 — Comparator 1 Interrupt
33 COMPARATOR_2 — Comparator 2 Interrupt
35 SPI1_FAULT
36 SPI1_RX — SPI1 Receive Done
37 SPI1_TX — SPI1 Transfer Done
38 UART1_FAULT
39 UART1_RX — UART1 Receive Done
40 UART1_TX — UART1 Transfer Done
41 I2C1_BUS — I2C1 Bus Collision Event
42 I2C1_SLAVE — I2C1 Slave Event
43 I2C1_MASTER — I2C1 Master Event
44 CHANGE_NOTICE_A — PORTA Input Change Interrupt
45 CHANGE_NOTICE_B — PORTB Input Change Interrupt
46 CHANGE_NOTICE_C — PORTC Input Change Interrupt
47 CHANGE_NOTICE_D — PORTD Input Change Interrupt
53 SPI2_FAULT
54 SPI2_RX — SPI2 Receive Done
55 SPI2_TX — SPI2 Transfer Done
56 UART2_FAULT
57 UART2_RX — UART2 Receive Done
58 UART2_TX — UART2 Transfer Done
59 I2C2_BUS — I2C2 Bus Collision Event
60 I2C2_SLAVE — I2C2 Slave Event
61 I2C2_MASTER — I2C2 Master Event
71 CTMU — CTMU Interrupt
72 DMA0 — DMA Channel 0
73 DMA1 — DMA Channel 1
74 DMA2 — DMA Channel 2
75 DMA3 — DMA Channel 3
92 ADC — ADC Global Interrupt
94 ADC_DC1 — ADC Digital Comparator 1
95 ADC_DC2 — ADC Digital Comparator 2
96 ADC_DF1 — ADC Digital Filter 1
97 ADC_DF2 — ADC Digital Filter 2
100 ADC_FAULT
101 ADC_EOS — ADC End of Scan
102 ADC_ARDY — ADC Ready
103 ADC_URDY — ADC Update Ready After Suspend
104 ADC_DMA — ADC First Class Channels DMA
105 ADC_EARLY — ADC Early Group Interrupt
106 ADC_DATA0
107 ADC_DATA1
108 ADC_DATA2
109 ADC_DATA3
110 ADC_DATA4
111 ADC_DATA5
115 ADC_DATA9
118 ADC_DATA12
119 ADC_DATA13
121 ADC_DATA15
122 ADC_DATA16
123 ADC_DATA17
156 ADC_DATA50
159 ADC_DATA53
160 COMPARATOR_3 — Comparator 3 Interrupt
169 QEI1 — QEI 1 Interrupt
170 QEI2 — QEI 2 Interrupt
171 PWM_PRI — PWM Primary Event
172 PWM_SEC — PWM Secondary Event
173 PWM1 — PWM 1 Interrupt
174 PWM2 — PWM 2 Interrupt
175 PWM3 — PWM 3 Interrupt
176 PWM4 — PWM 4 Interrupt
182 DMA4 — DMA Channel 4
183 DMA5 — DMA Channel 5
184 DMA6 — DMA Channel 6
185 DMA7 — DMA Channel 7
230 SYSTEM_BUS_PROTECTION — System Bus Protection Violation
247 PCACHE — P - Cache Event Interrupt
249 CLC1 — CLC 1 Interrupt
254 CORE_PERF_COUNT — MPU Core Performance Counter Event
255 CORE_FAST_DEBUG_CHAN — Core Fast Debug Channel

## Notices in the file
Copyright (c) 2019 Microchip Technology Inc.
SPDX-License-Identifier: Apache-2.0
Licensed under the Apache License, Version 2.0 (the "License");
you may not use this file except in compliance with the License.
You may obtain a copy of the License at
http://www.apache.org/licenses/LICENSE-2.0
Unless required by applicable law or agreed to in writing, software
distributed under the License is distributed on an "AS IS" BASIS,
WITHOUT WARRANTIES OR CONDITIONS OF ANY KIND, either express or implied.
See the License for the specific language governing permissions and
limitations under the License.
