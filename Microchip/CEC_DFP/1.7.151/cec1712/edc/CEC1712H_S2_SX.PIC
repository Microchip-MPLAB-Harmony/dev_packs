# CEC1712H_S2_SX register map
Vendor: Microchip
Architecture arm32bit. Special function registers and configuration words.
Registers are 32-bit, read-write, reset 0x0 unless marked. A register's access mark holds for its fields unless they carry their own. Addresses are absolute, and some are shared; only a register's first bit layout is shown; lines under a group give offsets from that group; [hi:lo] are bit positions; {n}, {i} and the like mark numbered series; 'fields as' and 'values as' point back to an identical list; <NAME> marks a mode.

## Further device data
pins=1: nRESET_IN; 2: GPIO057/VCC_PWRGD; 3: GPIO106/PWROK; 4: GPIO051/ICT1_TACH1/ICT1_TACH1/ICT1_TACH1; 5: GPIO050/ICT0_TACH0/ICT0_TACH0; 6: GPIO200/ADC00; 7: GPIO201/ADC01; 8: GPIO202/ADC02; 9: GPIO203/ADC03; 10: GPIO204/ADC04; 11: GPIO065/ICT5; 12: GPIO070/SDA14/SDA14/SDA14/SDA14/SDA14/SDA14/SDA14/SDA14; 13: GPIO071/SCL14/SCL14/SCL14/SCL14/SCL14/SCL14/SCL14/SCL14; 14: GPIO063/PWM6/ICT8; 15: GPIO224/SHD_IO10; 16: GPIO016/SHD_IO30/ICT3; 17: GPIO227/SHD_IO20; 18: GPIO223/SHD_IO00; 19: GPIO055/PWM2/SHD_CS0_n0; 20: GPIO056/PWM3/SHD_CLK0; 21: GPIO012/SDA7/SDA7/SDA7/SDA7/SDA7/SDA7/SDA7/SDA7; 22: GPIO013/SCL7/SCL7/SCL7/SCL7/SCL7/SCL7/SCL7/SCL7; 23: GPIO130/SDA1/SDA1/SDA1/SDA1/SDA1/SDA1/SDA1/SDA1; 24: GPIO131/SCL1/SCL1/SCL1/SCL1/SCL1/SCL1/SCL1/SCL1; 25: GPIO020; 26: GPIO021; 27: GPIO002/PWM5/SHD_CS1_n0; 28: GPIO015/PWM7/ICT10; 29: GPIO032; 30: GPIO132/SDA6/SDA6/SDA6/SDA6/SDA6/SDA6/SDA6/SDA6; 31: GPIO140/SCL6/SCL6/SCL6/SCL6/SCL6/SCL6/SCL6/SCL6/ICT5; 32: GPIO026/SDA12/SDA12/SDA12/SDA12/SDA12/SDA12/SDA12/SDA12; 33: GPIO053/PWM0; 34: GPIO027/SCL12/SCL12/SCL12/SCL12/SCL12/SCL12/SCL12/SCL12; 35: GPIO030/SDA10/SDA10/SDA10/SDA10/SDA10/SDA10/SDA10/SDA10; 36: GPIO107/SCL10/SCL10/SCL10/SCL10/SCL10/SCL10/SCL10/SCL10; 37: GPIO120; 38: GPIO112; 39: GPIO113/ICT9; 40: GPIO034; 41: GPIO170/UART1_TX; 42: GPIO171/UART1_RX; 43: JTAG_RST_n; 44: GPIO104/UART0_TX/TFDP_CLK0; 45: GPIO105/UART0_RX/TFDP_DATA0; 46: GPIO046/ICT11; 47: GPIO047/PWM3/ICT13; 48: GPIO121/PVT_IO00; 49: GPIO122/PVT_IO10; 50: GPIO123/PVT_IO20; 51: GPIO126/PVT_IO30; 52: GPIO124/PVT_CS_n0/ICT12; 53: GPIO125/PVT_CLK0; 54: GPIO127; 55: GPIO156/LED0; 56: GPIO157/LED1; 57: GPIO045/PWM2/ICT14; 58: GPIO165/CLK32kHz_IN; 59: GPIO145/SDA9/SDA9/SDA9/SDA9/SDA9/SDA9/SDA9/SDA9/UART2_RX; 60: GPIO146/SCL9/SCL9/SCL9/SCL9/SCL9/SCL9/SCL9/SCL9/UART2_TX; 61: GPIO147/SDA15/SDA15/SDA15/SDA15/SDA15/SDA15/SDA15/SDA15; 62: GPIO150/SCL15/SCL15/SCL15/SCL15/SCL15/SCL15/SCL15/SCL15; 63: GPIO143/SDA4/SDA4/SDA4/SDA4/SDA4/SDA4/SDA4/SDA4/UART0_CTS_n; 64: GPIO144/SCL4/SCL4/SCL4/SCL4/SCL4/SCL4/SCL4/SCL4/UART0_RTS_n; 65: GPIO004/SCL0/SCL0/SCL0/SCL0/SCL0/SCL0/SCL0/SCL0; 66: GPIO003/SDA0/SDA0/SDA0/SDA0/SDA0/SDA0/SDA0/SDA0; 67: SYSPWR_PRES_VCI_IN3_n/GPIO000; 68: VCI_IN0_n/GPIO163; 69: GPIO253/BGPO0; 70: VCI_OUT/GPIO250; 71: XTAL1; 72: XTAL2; 73: VSS_ANALOG; 74: VTR_PLL; 75: VBAT; 76: VSS; 77: VTR_REG; 78: VREF_ADC; 79: VSS; 80: VTR1; 81: VTR_ANALOG; 82: VR_CAP; 83: VTR2; 84: VSS_ADC, interrupts=-15 Reset — Reset Vector, invoked on Power up and warm reset; -14 NonMaskableInt — Non maskable Interrupt, cannot be stopped or preempted; -13 HardFault — Hard Fault, all classes of Fault; -11 BusFault — Bus Fault, Pre-Fetch-, Memory Access Fault, other address/memory related Fault; -10 UsageFault — Usage Fault, i.e. Undef Instruction, Illegal State Transition; -5 SVCall — System Service Call via SVC instruction; -4 DebugMonitor — Debug Monitor; -2 PendSV — Pendable request for system service; -1 SysTick — System Tick Timer; 0 GIRQ08; 1 GIRQ09; 2 GIRQ10; 3 GIRQ11; 4 GIRQ12; 5 GIRQ13; 6 GIRQ14; 7 GIRQ15; 8 GIRQ16; 10 GIRQ18; 12 GIRQ20; 13 GIRQ21; 14 GIRQ23; 17 GIRQ26; 20 I2CSMB0; 21 I2CSMB1; 22 I2CSMB2; 23 I2CSMB3; 24 DMA_CH00; 25 DMA_CH01; 26 DMA_CH02; 27 DMA_CH03; 28 DMA_CH04; 29 DMA_CH05; 30 DMA_CH06; 31 DMA_CH07; 32 DMA_CH08; 33 DMA_CH09; 34 DMA_CH10; 35 DMA_CH11; 40 UART0; 41 UART1; 44 UART2; 65 PKE_ERR; 66 PKE_END; 67 RNG; 68 AES; 69 HASH; 71 TACH0; 72 TACH1; 78 ADC_SNGL; 79 ADC_RPT; 83 LED0; 84 LED1; 91 QMSPI; 111 TMR; 112 HTMR0; 113 HTMR1; 114 WK; 115 WKSUB; 116 WKSEC; 117 WKSUBSEC; 118 SYSPWR; 119 RTC; 120 RTC_ALARM; 122 VCI_IN0; 123 VCI_IN1; 129 PS2_0A_WAKE; 136 TIMER16_0; 137 TIMER16_1; 140 TIMER32_0; 141 TIMER32_1; 146 CCT; 147 CCT_CAP0; 148 CCT_CAP1; 149 CCT_CAP2; 150 CCT_CAP3; 151 CCT_CAP4; 152 CCT_CAP5; 153 CCT_CMP0; 154 CCT_CMP1; 158 I2CSMB4; 168 I2C0; 169 I2C1; 170 I2C2; 171 WDT
