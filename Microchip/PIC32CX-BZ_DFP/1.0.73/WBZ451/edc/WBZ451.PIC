# WBZ451 register map
Vendor: Microchip
Architecture arm32bit. Special function registers and configuration words.
Registers are 32-bit, read-write, reset 0x0 unless marked. A register's access mark holds for its fields unless they carry their own. Addresses are absolute, and some are shared; only a register's first bit layout is shown; lines under a group give offsets from that group; [hi:lo] are bit positions; {n}, {i} and the like mark numbered series; 'fields as' and 'values as' point back to an identical list; <NAME> marks a mode.

## Further device data
pins=1: GND; 2: GND; 3: NMCLR; 4: PB0; 5: PB3; 6: PB5; 7: AVDD; 8: GND; 9: PA11/IN1/IN4/EXTINT1/IN0/IN3/EXTINT0; 10: PA12/IN2/IN5/EXTINT2/IN1/IN4/EXTINT1; 11: GND; 12: PB6; 13: PB7; 14: PB8; 15: PB9; 16: PA4; 17: PB10/RPB10/EXTINT3/NMI/OUT0/OUT1/IN2/IN5/EXTINT2/QSPI_CS; 18: PB11/RPB11/IN0/IN3/EXTINT0/OUT1/EXTINT3/NMI/QSPI_SCK; 19: GND; 20: PA0; 21: PA1; 22: PB12/RPB12/IN1/IN4/EXTINT1/IN0/IN3/EXTINT0/QSPI_DATA0; 23: PB13/RPB13/IN2/IN5/EXTINT2/OUT0/IN1/IN4/EXTINT1/QSPI_DATA1/RTC_EVENT; 24: PA5; 25: PA6; 26: GND; 27: VDD; 28: VDD; 29: PA8; 30: PA9; 31: PA7; 32: PA10/RPA10/IN0/IN3/EXTINT0/EXTINT3/NMI/OUT1/RTC_OUT_ALT/SERCOM1_PAD3; 33: PA13/RPA13/EXTINT3/NMI/OUT0/OUT1/IN2/IN5/EXTINT2/SERCOM2_PAD0; 34: PA14/RPA14/IN0/IN3/EXTINT0/OUT1/EXTINT3/NMI/SERCOM2_PAD1; 35: PA2; 36: PA3; 37: PB2; 38: PB1; 39: PB4, interrupts=-15 Reset — Reset Vector, invoked on Power up and warm reset; -14 NonMaskableInt — Non maskable Interrupt, cannot be stopped or preempted; -13 HardFault — Hard Fault, all classes of Fault; -12 MemoryManagement — Memory Management, MPU mismatch, including Access Violation and No Match; -11 BusFault — Bus Fault, Pre-Fetch-, Memory Access Fault, other address/memory related Fault; -10 UsageFault — Usage Fault, i.e. Undef Instruction, Illegal State Transition; -5 SVCall — System Service Call via SVC instruction; -4 DebugMonitor — Debug Monitor; -2 PendSV — Pendable request for system service; -1 SysTick — System Tick Timer; 0 RTC — Real Time Counter; 1 EIC — External Interrupt Controller; 2 FREQM — Frequency Meter; 3 FLASH_CONTROL — Non-Volatile Memory; 4 CHANGE_NOTICE_A — PORT_A_INPUT_CHANGE_INTERRUPT; 5 CHANGE_NOTICE_B — PORT_B_INPUT_CHANGE_INTERRUPT; 6 DMAC_0_3 — DMA Channel 0..3; 7 DMAC_4_15 — DMA Channel 4..X; 8 EVSYS_0_3 — Event System Channel 0..3; 9 EVSYS_4_11 — Event System Channel 4..X; 10 PAC — Peripheral Access Controller; 11 RAMECC — RAM Error Correction Code; 12 SERCOM0 — Serial Communication Interface 0; 13 SERCOM1 — Serial Communication Interface 1; 14 SERCOM2 — Serial Communication Interface 2; 15 SERCOM3 — Serial Communication Interface 3; 16 TCC0 — Timer/Counter for Control Applications 0; 17 TCC1 — Timer/Counter for Control Applications 1; 18 TCC2 — Timer/Counter for Control Applications 2; 19 TC0 — Timer/Counter 0; 20 TC1 — Timer/Counter 1; 21 TC2 — Timer/Counter 2; 22 TC3 — Timer/Counter 3; 23 ADCHS — Analog-to-Digital Converter; 24 AC — Analog Comparators; 25 AES — Advanced Encryption Standard; 26 TRNG — True Random Generator; 27 ICM — Integrity Check Monitor; 28 PUKCC — Public-Key Cryptography Controller; 29 QSPI — Quad SPI interface; 30 ZB_INT0 — ZIGBEE; 31 BT_INT0 — Bluetooth 0; 32 BT_INT1 — Bluetooth 0; 33 ARBITER — Radio Arbiter; 34 ADC_FAULT — ADC Fault Interrupt; 35 ADC_FCC — ADC FCC Interrupt; 36 ADC_BGVR_RDY — ADC BGVR Ready; 37 CLKI_WAKEUP_NMI — Bluetooth WAKEUP; 38 BT_LC — Bluetooth LC; 39 BT_RC — Bluetooth RC
